VERSION "3"

NS_ :

BS_:

BU_: MyECU ACM

BO_ 156 ICM_Object_Prot5_B: 64 MyECU
 SG_ ICM_Object_Prot5_B_Header : 0|16@1+ (1,0) [0|65535] ""  ACM
 SG_ OBJ_Relative_Long_Velocity_5 : 16|13@1+ (0.05,-120) [-120|130] "MPS"  ACM
 SG_ OBJ_Relative_Long_Velocity_V_5 : 29|1@1+ (1,0) [0|1] "bool"  ACM
 SG_ OBJ_Relative_Long_Vel_STD_5 : 30|12@1+ (0.05,0) [0|130] "MPS"  ACM
 SG_ OBJ_Rel_Long_Vel_STD_V_5 : 42|1@1+ (1,0) [0|1] "bool"  ACM
 SG_ OBJ_Relative_Lat_Velocity_5 : 48|11@1+ (0.05,-50) [-50|50] "MPS"  ACM
 SG_ OBJ_Relative_Lat_Velocity_V_5 : 59|1@1+ (1,0) [0|1] "bool"  ACM
 SG_ OBJ_Relative_Lat_Velocity_STD_5 : 60|10@1+ (0.05,0) [0|50] "MPS"  ACM
 SG_ OBJ_Rel_Lat_Vel_STD_V_5 : 70|1@1+ (1,0) [0|1] "bool"  ACM
 SG_ OBJ_Long_Distance_5 : 80|14@1+ (0.05,-200) [-200|250] "m"  ACM
 SG_ OBJ_Long_Distance_V_5 : 94|1@1+ (1,0) [0|1] "bool"  ACM
 SG_ OBJ_Long_Distance_STD_5 : 95|13@1+ (0.05,0) [0|250] "m"  ACM
 SG_ OBJ_Long_Distance_STD_V_5 : 108|1@1+ (1,0) [0|1] "bool"  ACM
 SG_ OBJ_Lat_Distance_5 : 112|12@1+ (0.05,-100) [-100|100] "m"  ACM
 SG_ OBJ_Lat_Distance_V_5 : 124|1@1+ (1,0) [0|1] "bool"  ACM
 SG_ OBJ_Lat_Distance_STD_5 : 125|11@1+ (0.05,0) [0|100] "m"  ACM
 SG_ OBJ_Lat_Distance_STD_V_5 : 136|1@1+ (1,0) [0|1] "bool"  ACM
 SG_ OBJ_Absolute_Speed_5 : 144|12@1+ (0.05,-65) [-65|65] "MPS"  ACM
 SG_ OBJ_Absolute_Speed_V_5 : 156|1@1+ (1,0) [0|1] "bool"  ACM
 SG_ OBJ_Absolute_Speed_STD_5 : 157|11@1+ (0.05,0) [0|65] "MPS"  ACM
 SG_ OBJ_Absolute_Speed_STD_V_5 : 168|1@1+ (1,0) [0|1] "bool"  ACM
 SG_ OBJ_Heading_5 : 176|10@1+ (0.01,-3.14) [-3.14|3.14] "rad"  ACM
 SG_ OBJ_Heading_V_5 : 186|1@1+ (1,0) [0|1] "bool"  ACM
 SG_ OBJ_Heading_STD_5 : 187|9@1+ (0.01,0) [0|3.14] "rad"  ACM
 SG_ OBJ_Heading_STD_V_5 : 196|1@1+ (1,0) [0|1] "bool"  ACM
 SG_ OBJ_Angle_Rate_STD_5 : 197|11@1+ (0.002,0) [0|2.2318] "RPS"  ACM
 SG_ OBJ_Angle_Rate_STD_V_5 : 208|1@1+ (1,0) [0|1] "bool"  ACM
 SG_ OBJ_Angle_Rate_5 : 209|12@1+ (0.002,-2.234) [-2.234|2.2318] "RPS"  ACM
 SG_ OBJ_Angle_Rate_V_5 : 221|1@1+ (1,0) [0|1] "bool"  ACM
 SG_ OBJ_Angle_Right_5 : 222|14@1+ (0.0002,-1.571) [-1.571|1.571] "rad "  ACM
 SG_ OBJ_Angle_Right_V_5 : 236|1@1+ (1,0) [0|1] "bool"  ACM
 SG_ OBJ_Angle_Right_STD_5 : 240|13@1+ (0.0002,0) [0|1.571] "rad "  ACM
 SG_ OBJ_Angle_Right_STD_V_5 : 253|1@1+ (1,0) [0|1] "bool"  ACM
 SG_ OBJ_Angle_Left_5 : 254|14@1+ (0.0002,-1.571) [-1.571|1.571] "rad "  ACM
 SG_ OBJ_Angle_Left_V_5 : 268|1@1+ (1,0) [0|1] "bool"  ACM
 SG_ OBJ_Angle_Left_STD_5 : 272|13@1+ (0.0002,0) [0|1.571] "rad"  ACM
 SG_ OBJ_Angle_Left_STD_V_5 : 285|1@1+ (1,0) [0|1] "bool"  ACM
 SG_ OBJ_Angle_Side_5 : 286|14@1+ (0.0002,-1.571) [-1.571|1.571] "rad"  ACM
 SG_ OBJ_Angle_Side_V_5 : 300|1@1+ (1,0) [0|1] "bool"  ACM
 SG_ OBJ_Angle_Side_STD_5 : 304|13@1+ (0.0002,0) [0|1.571] "rad"  ACM
 SG_ OBJ_Angle_Side_STD_V_5 : 317|1@1+ (1,0) [0|1] "bool"  ACM
 SG_ OBJ_Angle_Mid_V_5 : 318|1@1+ (1,0) [0|1] "bool"  ACM
 SG_ OBJ_Angle_Mid_5 : 319|14@1+ (0.0002,-1.571) [-1.571|1.571] "rad"  ACM
 SG_ OBJ_Angle_Mid_STD_5 : 336|13@1+ (0.0002,0) [0|1.571] "rad"  ACM
 SG_ OBJ_Angle_Mid_STD_V_5 : 349|1@1+ (1,0) [0|1] "bool"  ACM
 SG_ OBJ_Angle_Bottom_V_5 : 350|1@1+ (1,0) [0|1] "bool"  ACM
 SG_ OBJ_Angle_Bottom_5 : 351|14@1+ (0.0002,-1.571) [-1.571|1.571] "rad"  ACM
 SG_ OBJ_Angle_Bottom_STD_5 : 368|13@1+ (0.0002,0) [0|1.571] "rad"  ACM
 SG_ OBJ_Angle_Bottom_STD_V_5 : 381|1@1+ (1,0) [0|1] "bool"  ACM
 SG_ OBJ_Visibility_Side_V_5 : 382|1@1+ (1,0) [0|1] "bool"  ACM
 SG_ OBJ_Visibility_Side_5 : 383|2@1+ (1,0) [0|2] "ENUM"  ACM
 SG_ OBJ_Is_In_Drivable_Area_5 : 385|1@1+ (1,0) [0|1] "bool"  ACM
 SG_ OBJ_Is_In_Drivable_Area_V_5 : 386|1@1+ (1,0) [0|1] "bool"  ACM
 SG_ OBJ_Is_VeryClose_5 : 387|1@1+ (1,0) [0|1] "bool"  ACM
 SG_ OBJ_Is_VeryClose_V_5 : 388|1@1+ (1,0) [0|1] "bool"  ACM
 SG_ OBJ_Buffer_5 : 389|11@1+ (1,0) [0|0] "NA"  ACM

BO_ 155 ICM_Object_Prot5_A: 64 MyECU
 SG_ ICM_Object_Prot5_A_Header : 0|16@1+ (1,0) [0|65535] ""  ACM
 SG_ OBJ_CRC_5 : 16|32@1+ (1,0) [0|4294967295] "NA"  ACM
 SG_ OBJ_ID_5 : 48|8@1+ (1,0) [0|255] "NA"  ACM
 SG_ OBJ_Existence_Probability_5 : 56|8@1+ (0.01,0) [0|1] "NA"  ACM
 SG_ OBJ_Fusion_Source_5 : 64|16@1+ (1,0) [0|65535] "BITWIZE"  ACM
 SG_ OBJ_Triggered_SDM_5 : 80|2@1+ (1,0) [0|2] "ENUM"  ACM
 SG_ OBJ_Motion_Category_5 : 82|4@1+ (1,0) [0|13] "ENUM "  ACM
 SG_ OBJ_Moving_IN_Probability_5 : 86|7@1+ (1,0) [0|0] "NA"  ACM
 SG_ OBJ_Object_Age_5 : 93|11@1+ (1,0) [0|2047] "Frame"  ACM
 SG_ OBJ_Measuring_Status_5 : 104|3@1+ (1,0) [0|7] "BITWIZE"  ACM
 SG_ OBJ_Object_Class_5 : 107|4@1+ (1,0) [0|8] "ENUM"  ACM
 SG_ OBJ_Class_Probability_5 : 112|7@1+ (0.01,0) [0|1] "NA"  ACM
 SG_ OBJ_Car_Probability_5 : 119|7@1+ (1,0) [0|0] "NA"  ACM
 SG_ OBJ_Truck_Probability_5 : 126|7@1+ (1,0) [0|0] "NA"  ACM
 SG_ OBJ_Bike_Probability_5 : 133|7@1+ (1,0) [0|0] "NA"  ACM
 SG_ OBJ_Camera_Source_5 : 140|4@1+ (1,0) [0|15] "ENUM"  ACM
 SG_ OBJ_Motion_Status_5 : 144|3@1+ (1,0) [0|5] "ENUM "  ACM
 SG_ OBJ_Motion_Orientation_5 : 147|4@1+ (1,0) [0|13] "ENUM "  ACM
 SG_ OBJ_Has_Cut_Lane_5 : 151|1@1+ (1,0) [0|1] "bool"  ACM
 SG_ OBJ_Has_Cut_Path_5 : 152|1@1+ (1,0) [0|1] "bool"  ACM
 SG_ OBJ_Brake_Light_5 : 153|1@1+ (1,0) [0|1] "bool"  ACM
 SG_ OBJ_Turn_Indicator_Right_5 : 154|1@1+ (1,0) [0|1] "bool"  ACM
 SG_ OBJ_Turn_Indicator_Left_5 : 155|1@1+ (1,0) [0|1] "bool"  ACM
 SG_ OBJ_Light_Indicator_Validity_5 : 156|1@1+ (1,0) [0|1] "bool"  ACM
 SG_ OBJ_Right_Out_Of_Image_5 : 157|1@1+ (1,0) [0|1] "bool"  ACM
 SG_ OBJ_Left_Out_Of_Image_5 : 158|1@1+ (1,0) [0|1] "bool"  ACM
 SG_ OBJ_Right_Out_Of_Image_V_5 : 159|1@1+ (1,0) [0|1] "bool"  ACM
 SG_ OBJ_Left_Out_Of_Image_V_5 : 160|1@1+ (1,0) [0|1] "bool"  ACM
 SG_ OBJ_Top_Out_Of_Image_5 : 161|1@1+ (1,0) [0|1] "bool"  ACM
 SG_ OBJ_Bottom_Out_Of_Image_5 : 162|1@1+ (1,0) [0|1] "bool"  ACM
 SG_ OBJ_Top_Out_Of_Image_V_5 : 163|1@1+ (1,0) [0|1] "bool"  ACM
 SG_ OBJ_Bottom_Out_Of_Image_V_5 : 164|1@1+ (1,0) [0|1] "bool"  ACM
 SG_ OBJ_Lane_Assignment_5 : 165|3@1+ (1,0) [0|5] "ENUM"  ACM
 SG_ OBJ_Lane_Assignment_V_5 : 168|1@1+ (1,0) [0|1] "bool"  ACM
 SG_ OBJ_Age_Seconds_5 : 169|7@1+ (1,0) [0|100] "s"  ACM
 SG_ OBJ_Age_Seconds_V_5 : 176|1@1+ (1,0) [0|1] "bool"  ACM
 SG_ OBJ_Width_5 : 177|9@1+ (0.01,0) [0.4|2.95] "m"  ACM
 SG_ OBJ_Width_V_5 : 186|1@1+ (1,0) [0|1] "bool"  ACM
 SG_ OBJ_Width_STD_5 : 187|8@1+ (0.01,0) [0|2] "m"  ACM
 SG_ OBJ_Width_STD_V_5 : 195|1@1+ (1,0) [0|1] "bool"  ACM
 SG_ OBJ_Length_5 : 196|9@1+ (0.05,0) [1.2|21] "m"  ACM
 SG_ OBJ_Length_V_5 : 205|1@1+ (1,0) [0|1] "bool"  ACM
 SG_ OBJ_Length_STD_5 : 208|8@1+ (0.05,0) [0|10] "m"  ACM
 SG_ OBJ_Length_STD_V_5 : 216|1@1+ (1,0) [0|1] "bool"  ACM
 SG_ OBJ_Height_5 : 217|9@1+ (0.01,0) [0|2.95] "m"  ACM
 SG_ OBJ_Height_V_5 : 226|1@1+ (1,0) [0|1] "bool"  ACM
 SG_ OBJ_Height_STD_5 : 227|8@1+ (0.01,0) [0|2] "m"  ACM
 SG_ OBJ_Height_STD_V_5 : 235|1@1+ (1,0) [0|1] "bool"  ACM
 SG_ OBJ_Abs_Long_Velocity_5 : 240|12@1+ (0.05,-30) [-30|100] "MPS"  ACM
 SG_ OBJ_Abs_Long_Velocity_V_5 : 252|1@1+ (1,0) [0|1] "bool"  ACM
 SG_ OBJ_Abs_Long_Velocity_STD_5 : 253|11@1+ (0.05,0) [0|65] "MPS"  ACM
 SG_ OBJ_Abs_Long_Vel_STD_V_5 : 264|1@1+ (1,0) [0|1] "bool"  ACM
 SG_ OBJ_Abs_Lat_Velocity_5 : 272|11@1+ (0.05,-50) [-50|50] "MPS"  ACM
 SG_ OBJ_Abs_Lat_Velocity_V_5 : 283|1@1+ (1,0) [0|1] "bool"  ACM
 SG_ OBJ_Abs_Lat_Velocity_STD_5 : 284|10@1+ (0.05,0) [0|50] "MPS"  ACM
 SG_ OBJ_Abs_Lat_Vel_STD_V_5 : 294|1@1+ (1,0) [0|1] "bool"  ACM
 SG_ OBJ_Abs_Long_Acc_5 : 295|9@1+ (0.05,-10.3) [-10.3|7.3] "MPS2"  ACM
 SG_ OBJ_Abs_Long_Acc_V_5 : 304|1@1+ (1,0) [0|1] "bool"  ACM
 SG_ OBJ_Abs_Long_Acc_STD_5 : 305|8@1+ (0.05,0) [0|7.3] "MPS2"  ACM
 SG_ OBJ_Abs_Long_Acc_STD_V_5 : 313|1@1+ (1,0) [0|1] "bool"  ACM
 SG_ OBJ_Abs_Lat_Acc_5 : 314|9@1+ (0.05,-10.3) [-10.3|7.3] "MPS2"  ACM
 SG_ OBJ_Abs_Lat_Acc_V_5 : 323|1@1+ (1,0) [0|1] "bool"  ACM
 SG_ OBJ_Abs_Lat_Acc_STD_5 : 324|8@1+ (0.05,0) [0|7.3] "MPS2"  ACM
 SG_ OBJ_Abs_Lat_Acc_STD_V_5 : 332|1@1+ (1,0) [0|1] "bool"  ACM
 SG_ OBJ_Abs_Acceleration_5 : 336|9@1+ (0.05,-10.3) [-10.3|7.3] "MPS2"  ACM
 SG_ OBJ_Abs_Acceleration_V_5 : 345|1@1+ (1,0) [0|1] "bool"  ACM
 SG_ OBJ_Abs_Acc_STD_5 : 346|8@1+ (0.05,0) [0|7.3] "MPS2"  ACM
 SG_ OBJ_Abs_Acc_STD_V_5 : 354|1@1+ (1,0) [0|1] "bool"  ACM
 SG_ OBJ_Inv_TTC_5 : 355|11@1+ (0.01,-8) [-8|8] "INV(s)"  ACM
 SG_ OBJ_Inv_TTC_V_5 : 366|1@1+ (1,0) [0|1] "bool"  ACM
 SG_ OBJ_Inv_TTC_STD_5 : 368|11@1+ (0.01,0) [0|4] "INV(s)"  ACM
 SG_ OBJ_Inv_TTC_STD_V_5 : 379|1@1+ (1,0) [0|1] "bool"  ACM
 SG_ OBJ_Relative_Long_Acc_5 : 380|9@1+ (0.05,-10.3) [-10.3|7.3] "MPS2"  ACM
 SG_ OBJ_Relative_Long_Acc_V_5 : 389|1@1+ (1,0) [0|1] "bool"  ACM
 SG_ OBJ_Relative_Long_Acc_STD_5 : 390|8@1+ (0.05,0) [0|7.3] "MPS2"  ACM
 SG_ OBJ_Rel_Long_Acc_STD_V_5 : 398|1@1+ (1,0) [0|1] "bool"  ACM

BO_ 154 ICM_Object_Prot4_B: 64 MyECU
 SG_ ICM_Object_Prot4_B_Header : 0|16@1+ (1,0) [0|65535] ""  ACM
 SG_ OBJ_Relative_Long_Velocity_4 : 16|13@1+ (0.05,-120) [-120|130] "MPS"  ACM
 SG_ OBJ_Relative_Long_Velocity_V_4 : 29|1@1+ (1,0) [0|1] "bool"  ACM
 SG_ OBJ_Relative_Long_Vel_STD_4 : 30|12@1+ (0.05,0) [0|130] "MPS"  ACM
 SG_ OBJ_Rel_Long_Vel_STD_V_4 : 42|1@1+ (1,0) [0|1] "bool"  ACM
 SG_ OBJ_Relative_Lat_Velocity_4 : 48|11@1+ (0.05,-50) [-50|50] "MPS"  ACM
 SG_ OBJ_Relative_Lat_Velocity_V_4 : 59|1@1+ (1,0) [0|1] "bool"  ACM
 SG_ OBJ_Relative_Lat_Velocity_STD_4 : 60|10@1+ (0.05,0) [0|50] "MPS"  ACM
 SG_ OBJ_Rel_Lat_Vel_STD_V_4 : 70|1@1+ (1,0) [0|1] "bool"  ACM
 SG_ OBJ_Long_Distance_4 : 80|14@1+ (0.05,-200) [-200|250] "m"  ACM
 SG_ OBJ_Long_Distance_V_4 : 94|1@1+ (1,0) [0|1] "bool"  ACM
 SG_ OBJ_Long_Distance_STD_4 : 95|13@1+ (0.05,0) [0|250] "m"  ACM
 SG_ OBJ_Long_Distance_STD_V_4 : 108|1@1+ (1,0) [0|1] "bool"  ACM
 SG_ OBJ_Lat_Distance_4 : 112|12@1+ (0.05,-100) [-100|100] "m"  ACM
 SG_ OBJ_Lat_Distance_V_4 : 124|1@1+ (1,0) [0|1] "bool"  ACM
 SG_ OBJ_Lat_Distance_STD_4 : 125|11@1+ (0.05,0) [0|100] "m"  ACM
 SG_ OBJ_Lat_Distance_STD_V_4 : 136|1@1+ (1,0) [0|1] "bool"  ACM
 SG_ OBJ_Absolute_Speed_4 : 144|12@1+ (0.05,-65) [-65|65] "MPS"  ACM
 SG_ OBJ_Absolute_Speed_V_4 : 156|1@1+ (1,0) [0|1] "bool"  ACM
 SG_ OBJ_Absolute_Speed_STD_4 : 157|11@1+ (0.05,0) [0|65] "MPS"  ACM
 SG_ OBJ_Absolute_Speed_STD_V_4 : 168|1@1+ (1,0) [0|1] "bool"  ACM
 SG_ OBJ_Heading_4 : 176|10@1+ (0.01,-3.14) [-3.14|3.14] "rad"  ACM
 SG_ OBJ_Heading_V_4 : 186|1@1+ (1,0) [0|1] "bool"  ACM
 SG_ OBJ_Heading_STD_4 : 187|9@1+ (0.01,0) [0|3.14] "rad"  ACM
 SG_ OBJ_Heading_STD_V_4 : 196|1@1+ (1,0) [0|1] "bool"  ACM
 SG_ OBJ_Angle_Rate_STD_4 : 197|11@1+ (0.002,0) [0|2.2318] "RPS"  ACM
 SG_ OBJ_Angle_Rate_STD_V_4 : 208|1@1+ (1,0) [0|1] "bool"  ACM
 SG_ OBJ_Angle_Rate_4 : 209|12@1+ (0.002,-2.234) [-2.234|2.2318] "RPS"  ACM
 SG_ OBJ_Angle_Rate_V_4 : 221|1@1+ (1,0) [0|1] "bool"  ACM
 SG_ OBJ_Angle_Right_4 : 222|14@1+ (0.0002,-1.571) [-1.571|1.571] "rad "  ACM
 SG_ OBJ_Angle_Right_V_4 : 236|1@1+ (1,0) [0|1] "bool"  ACM
 SG_ OBJ_Angle_Right_STD_4 : 240|13@1+ (0.0002,0) [0|1.571] "rad "  ACM
 SG_ OBJ_Angle_Right_STD_V_4 : 253|1@1+ (1,0) [0|1] "bool"  ACM
 SG_ OBJ_Angle_Left_4 : 254|14@1+ (0.0002,-1.571) [-1.571|1.571] "rad "  ACM
 SG_ OBJ_Angle_Left_V_4 : 268|1@1+ (1,0) [0|1] "bool"  ACM
 SG_ OBJ_Angle_Left_STD_4 : 272|13@1+ (0.0002,0) [0|1.571] "rad"  ACM
 SG_ OBJ_Angle_Left_STD_V_4 : 285|1@1+ (1,0) [0|1] "bool"  ACM
 SG_ OBJ_Angle_Side_4 : 286|14@1+ (0.0002,-1.571) [-1.571|1.571] "rad"  ACM
 SG_ OBJ_Angle_Side_V_4 : 300|1@1+ (1,0) [0|1] "bool"  ACM
 SG_ OBJ_Angle_Side_STD_4 : 304|13@1+ (0.0002,0) [0|1.571] "rad"  ACM
 SG_ OBJ_Angle_Side_STD_V_4 : 317|1@1+ (1,0) [0|1] "bool"  ACM
 SG_ OBJ_Angle_Mid_V_4 : 318|1@1+ (1,0) [0|1] "bool"  ACM
 SG_ OBJ_Angle_Mid_4 : 319|14@1+ (0.0002,-1.571) [-1.571|1.571] "rad"  ACM
 SG_ OBJ_Angle_Mid_STD_4 : 336|13@1+ (0.0002,0) [0|1.571] "rad"  ACM
 SG_ OBJ_Angle_Mid_STD_V_4 : 349|1@1+ (1,0) [0|1] "bool"  ACM
 SG_ OBJ_Angle_Bottom_V_4 : 350|1@1+ (1,0) [0|1] "bool"  ACM
 SG_ OBJ_Angle_Bottom_4 : 351|14@1+ (0.0002,-1.571) [-1.571|1.571] "rad"  ACM
 SG_ OBJ_Angle_Bottom_STD_4 : 368|13@1+ (0.0002,0) [0|1.571] "rad"  ACM
 SG_ OBJ_Angle_Bottom_STD_V_4 : 381|1@1+ (1,0) [0|1] "bool"  ACM
 SG_ OBJ_Visibility_Side_V_4 : 382|1@1+ (1,0) [0|1] "bool"  ACM
 SG_ OBJ_Visibility_Side_4 : 383|2@1+ (1,0) [0|2] "ENUM"  ACM
 SG_ OBJ_Is_In_Drivable_Area_4 : 385|1@1+ (1,0) [0|1] "bool"  ACM
 SG_ OBJ_Is_In_Drivable_Area_V_4 : 386|1@1+ (1,0) [0|1] "bool"  ACM
 SG_ OBJ_Is_VeryClose_4 : 387|1@1+ (1,0) [0|1] "bool"  ACM
 SG_ OBJ_Is_VeryClose_V_4 : 388|1@1+ (1,0) [0|1] "bool"  ACM
 SG_ OBJ_Buffer_4 : 389|11@1+ (1,0) [0|0] "NA"  ACM

BO_ 153 ICM_Object_Prot4_A: 64 MyECU
 SG_ ICM_Object_Prot4_A_Header : 0|16@1+ (1,0) [0|65535] ""  ACM
 SG_ OBJ_CRC_4 : 16|32@1+ (1,0) [0|4294967295] "NA"  ACM
 SG_ OBJ_ID_4 : 48|8@1+ (1,0) [0|255] "NA"  ACM
 SG_ OBJ_Existence_Probability_4 : 56|8@1+ (0.01,0) [0|1] "NA"  ACM
 SG_ OBJ_Fusion_Source_4 : 64|16@1+ (1,0) [0|65535] "BITWIZE"  ACM
 SG_ OBJ_Triggered_SDM_4 : 80|2@1+ (1,0) [0|2] "ENUM"  ACM
 SG_ OBJ_Motion_Category_4 : 82|4@1+ (1,0) [0|13] "ENUM "  ACM
 SG_ OBJ_Moving_IN_Probability_4 : 86|7@1+ (1,0) [0|0] "NA"  ACM
 SG_ OBJ_Object_Age_4 : 93|11@1+ (1,0) [0|2047] "Frame"  ACM
 SG_ OBJ_Measuring_Status_4 : 104|3@1+ (1,0) [0|7] "BITWIZE"  ACM
 SG_ OBJ_Object_Class_4 : 107|4@1+ (1,0) [0|8] "ENUM"  ACM
 SG_ OBJ_Class_Probability_4 : 112|7@1+ (0.01,0) [0|1] "NA"  ACM
 SG_ OBJ_Car_Probability_4 : 119|7@1+ (1,0) [0|0] "NA"  ACM
 SG_ OBJ_Truck_Probability_4 : 126|7@1+ (1,0) [0|0] "NA"  ACM
 SG_ OBJ_Bike_Probability_4 : 133|7@1+ (1,0) [0|0] "NA"  ACM
 SG_ OBJ_Camera_Source_4 : 140|4@1+ (1,0) [0|15] "ENUM"  ACM
 SG_ OBJ_Motion_Status_4 : 144|3@1+ (1,0) [0|5] "ENUM "  ACM
 SG_ OBJ_Motion_Orientation_4 : 147|4@1+ (1,0) [0|13] "ENUM "  ACM
 SG_ OBJ_Has_Cut_Lane_4 : 151|1@1+ (1,0) [0|1] "bool"  ACM
 SG_ OBJ_Has_Cut_Path_4 : 152|1@1+ (1,0) [0|1] "bool"  ACM
 SG_ OBJ_Brake_Light_4 : 153|1@1+ (1,0) [0|1] "bool"  ACM
 SG_ OBJ_Turn_Indicator_Right_4 : 154|1@1+ (1,0) [0|1] "bool"  ACM
 SG_ OBJ_Turn_Indicator_Left_4 : 155|1@1+ (1,0) [0|1] "bool"  ACM
 SG_ OBJ_Light_Indicator_Validity_4 : 156|1@1+ (1,0) [0|1] "bool"  ACM
 SG_ OBJ_Right_Out_Of_Image_4 : 157|1@1+ (1,0) [0|1] "bool"  ACM
 SG_ OBJ_Left_Out_Of_Image_4 : 158|1@1+ (1,0) [0|1] "bool"  ACM
 SG_ OBJ_Right_Out_Of_Image_V_4 : 159|1@1+ (1,0) [0|1] "bool"  ACM
 SG_ OBJ_Left_Out_Of_Image_V_4 : 160|1@1+ (1,0) [0|1] "bool"  ACM
 SG_ OBJ_Top_Out_Of_Image_4 : 161|1@1+ (1,0) [0|1] "bool"  ACM
 SG_ OBJ_Bottom_Out_Of_Image_4 : 162|1@1+ (1,0) [0|1] "bool"  ACM
 SG_ OBJ_Top_Out_Of_Image_V_4 : 163|1@1+ (1,0) [0|1] "bool"  ACM
 SG_ OBJ_Bottom_Out_Of_Image_V_4 : 164|1@1+ (1,0) [0|1] "bool"  ACM
 SG_ OBJ_Lane_Assignment_4 : 165|3@1+ (1,0) [0|5] "ENUM"  ACM
 SG_ OBJ_Lane_Assignment_V_4 : 168|1@1+ (1,0) [0|1] "bool"  ACM
 SG_ OBJ_Age_Seconds_4 : 169|7@1+ (1,0) [0|100] "s"  ACM
 SG_ OBJ_Age_Seconds_V_4 : 176|1@1+ (1,0) [0|1] "bool"  ACM
 SG_ OBJ_Width_4 : 177|9@1+ (0.01,0) [0.4|2.95] "m"  ACM
 SG_ OBJ_Width_V_4 : 186|1@1+ (1,0) [0|1] "bool"  ACM
 SG_ OBJ_Width_STD_4 : 187|8@1+ (0.01,0) [0|2] "m"  ACM
 SG_ OBJ_Width_STD_V_4 : 195|1@1+ (1,0) [0|1] "bool"  ACM
 SG_ OBJ_Length_4 : 196|9@1+ (0.05,0) [1.2|21] "m"  ACM
 SG_ OBJ_Length_V_4 : 205|1@1+ (1,0) [0|1] "bool"  ACM
 SG_ OBJ_Length_STD_4 : 208|8@1+ (0.05,0) [0|10] "m"  ACM
 SG_ OBJ_Length_STD_V_4 : 216|1@1+ (1,0) [0|1] "bool"  ACM
 SG_ OBJ_Height_4 : 217|9@1+ (0.01,0) [0|2.95] "m"  ACM
 SG_ OBJ_Height_V_4 : 226|1@1+ (1,0) [0|1] "bool"  ACM
 SG_ OBJ_Height_STD_4 : 227|8@1+ (0.01,0) [0|2] "m"  ACM
 SG_ OBJ_Height_STD_V_4 : 235|1@1+ (1,0) [0|1] "bool"  ACM
 SG_ OBJ_Abs_Long_Velocity_4 : 240|12@1+ (0.05,-30) [-30|100] "MPS"  ACM
 SG_ OBJ_Abs_Long_Velocity_V_4 : 252|1@1+ (1,0) [0|1] "bool"  ACM
 SG_ OBJ_Abs_Long_Velocity_STD_4 : 253|11@1+ (0.05,0) [0|65] "MPS"  ACM
 SG_ OBJ_Abs_Long_Vel_STD_V_4 : 264|1@1+ (1,0) [0|1] "bool"  ACM
 SG_ OBJ_Abs_Lat_Velocity_4 : 272|11@1+ (0.05,-50) [-50|50] "MPS"  ACM
 SG_ OBJ_Abs_Lat_Velocity_V_4 : 283|1@1+ (1,0) [0|1] "bool"  ACM
 SG_ OBJ_Abs_Lat_Velocity_STD_4 : 284|10@1+ (0.05,0) [0|50] "MPS"  ACM
 SG_ OBJ_Abs_Lat_Vel_STD_V_4 : 294|1@1+ (1,0) [0|1] "bool"  ACM
 SG_ OBJ_Abs_Long_Acc_4 : 295|9@1+ (0.05,-10.3) [-10.3|7.3] "MPS2"  ACM
 SG_ OBJ_Abs_Long_Acc_V_4 : 304|1@1+ (1,0) [0|1] "bool"  ACM
 SG_ OBJ_Abs_Long_Acc_STD_4 : 305|8@1+ (0.05,0) [0|7.3] "MPS2"  ACM
 SG_ OBJ_Abs_Long_Acc_STD_V_4 : 313|1@1+ (1,0) [0|1] "bool"  ACM
 SG_ OBJ_Abs_Lat_Acc_4 : 314|9@1+ (0.05,-10.3) [-10.3|7.3] "MPS2"  ACM
 SG_ OBJ_Abs_Lat_Acc_V_4 : 323|1@1+ (1,0) [0|1] "bool"  ACM
 SG_ OBJ_Abs_Lat_Acc_STD_4 : 324|8@1+ (0.05,0) [0|7.3] "MPS2"  ACM
 SG_ OBJ_Abs_Lat_Acc_STD_V_4 : 332|1@1+ (1,0) [0|1] "bool"  ACM
 SG_ OBJ_Abs_Acceleration_4 : 336|9@1+ (0.05,-10.3) [-10.3|7.3] "MPS2"  ACM
 SG_ OBJ_Abs_Acceleration_V_4 : 345|1@1+ (1,0) [0|1] "bool"  ACM
 SG_ OBJ_Abs_Acc_STD_4 : 346|8@1+ (0.05,0) [0|7.3] "MPS2"  ACM
 SG_ OBJ_Abs_Acc_STD_V_4 : 354|1@1+ (1,0) [0|1] "bool"  ACM
 SG_ OBJ_Inv_TTC_4 : 355|11@1+ (0.01,-8) [-8|8] "INV(s)"  ACM
 SG_ OBJ_Inv_TTC_V_4 : 366|1@1+ (1,0) [0|1] "bool"  ACM
 SG_ OBJ_Inv_TTC_STD_4 : 368|11@1+ (0.01,0) [0|4] "INV(s)"  ACM
 SG_ OBJ_Inv_TTC_STD_V_4 : 379|1@1+ (1,0) [0|1] "bool"  ACM
 SG_ OBJ_Relative_Long_Acc_4 : 380|9@1+ (0.05,-10.3) [-10.3|7.3] "MPS2"  ACM
 SG_ OBJ_Relative_Long_Acc_V_4 : 389|1@1+ (1,0) [0|1] "bool"  ACM
 SG_ OBJ_Relative_Long_Acc_STD_4 : 390|8@1+ (0.05,0) [0|7.3] "MPS2"  ACM
 SG_ OBJ_Rel_Long_Acc_STD_V_4 : 398|1@1+ (1,0) [0|1] "bool"  ACM

BO_ 152 ICM_Object_Prot3_B: 64 MyECU
 SG_ ICM_Object_Prot3_B_Header : 0|16@1+ (1,0) [0|65535] ""  ACM
 SG_ OBJ_Relative_Long_Velocity_3 : 16|13@1+ (0.05,-120) [-120|130] "MPS"  ACM
 SG_ OBJ_Relative_Long_Velocity_V_3 : 29|1@1+ (1,0) [0|1] "bool"  ACM
 SG_ OBJ_Relative_Long_Vel_STD_3 : 30|12@1+ (0.05,0) [0|130] "MPS"  ACM
 SG_ OBJ_Rel_Long_Vel_STD_V_3 : 42|1@1+ (1,0) [0|1] "bool"  ACM
 SG_ OBJ_Relative_Lat_Velocity_3 : 48|11@1+ (0.05,-50) [-50|50] "MPS"  ACM
 SG_ OBJ_Relative_Lat_Velocity_V_3 : 59|1@1+ (1,0) [0|1] "bool"  ACM
 SG_ OBJ_Relative_Lat_Velocity_STD_3 : 60|10@1+ (0.05,0) [0|50] "MPS"  ACM
 SG_ OBJ_Rel_Lat_Vel_STD_V_3 : 70|1@1+ (1,0) [0|1] "bool"  ACM
 SG_ OBJ_Long_Distance_3 : 80|14@1+ (0.05,-200) [-200|250] "m"  ACM
 SG_ OBJ_Long_Distance_V_3 : 94|1@1+ (1,0) [0|1] "bool"  ACM
 SG_ OBJ_Long_Distance_STD_3 : 95|13@1+ (0.05,0) [0|250] "m"  ACM
 SG_ OBJ_Long_Distance_STD_V_3 : 108|1@1+ (1,0) [0|1] "bool"  ACM
 SG_ OBJ_Lat_Distance_3 : 112|12@1+ (0.05,-100) [-100|100] "m"  ACM
 SG_ OBJ_Lat_Distance_V_3 : 124|1@1+ (1,0) [0|1] "bool"  ACM
 SG_ OBJ_Lat_Distance_STD_3 : 125|11@1+ (0.05,0) [0|100] "m"  ACM
 SG_ OBJ_Lat_Distance_STD_V_3 : 136|1@1+ (1,0) [0|1] "bool"  ACM
 SG_ OBJ_Absolute_Speed_3 : 144|12@1+ (0.05,-65) [-65|65] "MPS"  ACM
 SG_ OBJ_Absolute_Speed_V_3 : 156|1@1+ (1,0) [0|1] "bool"  ACM
 SG_ OBJ_Absolute_Speed_STD_3 : 157|11@1+ (0.05,0) [0|65] "MPS"  ACM
 SG_ OBJ_Absolute_Speed_STD_V_3 : 168|1@1+ (1,0) [0|1] "bool"  ACM
 SG_ OBJ_Heading_3 : 176|10@1+ (0.01,-3.14) [-3.14|3.14] "rad"  ACM
 SG_ OBJ_Heading_V_3 : 186|1@1+ (1,0) [0|1] "bool"  ACM
 SG_ OBJ_Heading_STD_3 : 187|9@1+ (0.01,0) [0|3.14] "rad"  ACM
 SG_ OBJ_Heading_STD_V_3 : 196|1@1+ (1,0) [0|1] "bool"  ACM
 SG_ OBJ_Angle_Rate_STD_3 : 197|11@1+ (0.002,0) [0|2.2318] "RPS"  ACM
 SG_ OBJ_Angle_Rate_STD_V_3 : 208|1@1+ (1,0) [0|1] "bool"  ACM
 SG_ OBJ_Angle_Rate_3 : 209|12@1+ (0.002,-2.234) [-2.234|2.2318] "RPS"  ACM
 SG_ OBJ_Angle_Rate_V_3 : 221|1@1+ (1,0) [0|1] "bool"  ACM
 SG_ OBJ_Angle_Right_3 : 222|14@1+ (0.0002,-1.571) [-1.571|1.571] "rad "  ACM
 SG_ OBJ_Angle_Right_V_3 : 236|1@1+ (1,0) [0|1] "bool"  ACM
 SG_ OBJ_Angle_Right_STD_3 : 240|13@1+ (0.0002,0) [0|1.571] "rad "  ACM
 SG_ OBJ_Angle_Right_STD_V_3 : 253|1@1+ (1,0) [0|1] "bool"  ACM
 SG_ OBJ_Angle_Left_3 : 254|14@1+ (0.0002,-1.571) [-1.571|1.571] "rad "  ACM
 SG_ OBJ_Angle_Left_V_3 : 268|1@1+ (1,0) [0|1] "bool"  ACM
 SG_ OBJ_Angle_Left_STD_3 : 272|13@1+ (0.0002,0) [0|1.571] "rad"  ACM
 SG_ OBJ_Angle_Left_STD_V_3 : 285|1@1+ (1,0) [0|1] "bool"  ACM
 SG_ OBJ_Angle_Side_3 : 286|14@1+ (0.0002,-1.571) [-1.571|1.571] "rad"  ACM
 SG_ OBJ_Angle_Side_V_3 : 300|1@1+ (1,0) [0|1] "bool"  ACM
 SG_ OBJ_Angle_Side_STD_3 : 304|13@1+ (0.0002,0) [0|1.571] "rad"  ACM
 SG_ OBJ_Angle_Side_STD_V_3 : 317|1@1+ (1,0) [0|1] "bool"  ACM
 SG_ OBJ_Angle_Mid_V_3 : 318|1@1+ (1,0) [0|1] "bool"  ACM
 SG_ OBJ_Angle_Mid_3 : 319|14@1+ (0.0002,-1.571) [-1.571|1.571] "rad"  ACM
 SG_ OBJ_Angle_Mid_STD_3 : 336|13@1+ (0.0002,0) [0|1.571] "rad"  ACM
 SG_ OBJ_Angle_Mid_STD_V_3 : 349|1@1+ (1,0) [0|1] "bool"  ACM
 SG_ OBJ_Angle_Bottom_V_3 : 350|1@1+ (1,0) [0|1] "bool"  ACM
 SG_ OBJ_Angle_Bottom_3 : 351|14@1+ (0.0002,-1.571) [-1.571|1.571] "rad"  ACM
 SG_ OBJ_Angle_Bottom_STD_3 : 368|13@1+ (0.0002,0) [0|1.571] "rad"  ACM
 SG_ OBJ_Angle_Bottom_STD_V_3 : 381|1@1+ (1,0) [0|1] "bool"  ACM
 SG_ OBJ_Visibility_Side_V_3 : 382|1@1+ (1,0) [0|1] "bool"  ACM
 SG_ OBJ_Visibility_Side_3 : 383|2@1+ (1,0) [0|2] "ENUM"  ACM
 SG_ OBJ_Is_In_Drivable_Area_3 : 385|1@1+ (1,0) [0|1] "bool"  ACM
 SG_ OBJ_Is_In_Drivable_Area_V_3 : 386|1@1+ (1,0) [0|1] "bool"  ACM
 SG_ OBJ_Is_VeryClose_3 : 387|1@1+ (1,0) [0|1] "bool"  ACM
 SG_ OBJ_Is_VeryClose_V_3 : 388|1@1+ (1,0) [0|1] "bool"  ACM
 SG_ OBJ_Buffer_3 : 389|11@1+ (1,0) [0|0] "NA"  ACM

BO_ 151 ICM_Object_Prot3_A: 64 MyECU
 SG_ ICM_Object_Prot3_A_Header : 0|16@1+ (1,0) [0|65535] ""  ACM
 SG_ OBJ_CRC_3 : 16|32@1+ (1,0) [0|4294967295] "NA"  ACM
 SG_ OBJ_ID_3 : 48|8@1+ (1,0) [0|255] "NA"  ACM
 SG_ OBJ_Existence_Probability_3 : 56|8@1+ (0.01,0) [0|1] "NA"  ACM
 SG_ OBJ_Fusion_Source_3 : 64|16@1+ (1,0) [0|65535] "BITWIZE"  ACM
 SG_ OBJ_Triggered_SDM_3 : 80|2@1+ (1,0) [0|2] "ENUM"  ACM
 SG_ OBJ_Motion_Category_3 : 82|4@1+ (1,0) [0|13] "ENUM "  ACM
 SG_ OBJ_Moving_IN_Probability_3 : 86|7@1+ (1,0) [0|0] "NA"  ACM
 SG_ OBJ_Object_Age_3 : 93|11@1+ (1,0) [0|2047] "Frame"  ACM
 SG_ OBJ_Measuring_Status_3 : 104|3@1+ (1,0) [0|7] "BITWIZE"  ACM
 SG_ OBJ_Object_Class_3 : 107|4@1+ (1,0) [0|8] "ENUM"  ACM
 SG_ OBJ_Class_Probability_3 : 112|7@1+ (0.01,0) [0|1] "NA"  ACM
 SG_ OBJ_Car_Probability_3 : 119|7@1+ (1,0) [0|0] "NA"  ACM
 SG_ OBJ_Truck_Probability_3 : 126|7@1+ (1,0) [0|0] "NA"  ACM
 SG_ OBJ_Bike_Probability_3 : 133|7@1+ (1,0) [0|0] "NA"  ACM
 SG_ OBJ_Camera_Source_3 : 140|4@1+ (1,0) [0|15] "ENUM"  ACM
 SG_ OBJ_Motion_Status_3 : 144|3@1+ (1,0) [0|5] "ENUM "  ACM
 SG_ OBJ_Motion_Orientation_3 : 147|4@1+ (1,0) [0|13] "ENUM "  ACM
 SG_ OBJ_Has_Cut_Lane_3 : 151|1@1+ (1,0) [0|1] "bool"  ACM
 SG_ OBJ_Has_Cut_Path_3 : 152|1@1+ (1,0) [0|1] "bool"  ACM
 SG_ OBJ_Brake_Light_3 : 153|1@1+ (1,0) [0|1] "bool"  ACM
 SG_ OBJ_Turn_Indicator_Right_3 : 154|1@1+ (1,0) [0|1] "bool"  ACM
 SG_ OBJ_Turn_Indicator_Left_3 : 155|1@1+ (1,0) [0|1] "bool"  ACM
 SG_ OBJ_Light_Indicator_Validity_3 : 156|1@1+ (1,0) [0|1] "bool"  ACM
 SG_ OBJ_Right_Out_Of_Image_3 : 157|1@1+ (1,0) [0|1] "bool"  ACM
 SG_ OBJ_Left_Out_Of_Image_3 : 158|1@1+ (1,0) [0|1] "bool"  ACM
 SG_ OBJ_Right_Out_Of_Image_V_3 : 159|1@1+ (1,0) [0|1] "bool"  ACM
 SG_ OBJ_Left_Out_Of_Image_V_3 : 160|1@1+ (1,0) [0|1] "bool"  ACM
 SG_ OBJ_Top_Out_Of_Image_3 : 161|1@1+ (1,0) [0|1] "bool"  ACM
 SG_ OBJ_Bottom_Out_Of_Image_3 : 162|1@1+ (1,0) [0|1] "bool"  ACM
 SG_ OBJ_Top_Out_Of_Image_V_3 : 163|1@1+ (1,0) [0|1] "bool"  ACM
 SG_ OBJ_Bottom_Out_Of_Image_V_3 : 164|1@1+ (1,0) [0|1] "bool"  ACM
 SG_ OBJ_Lane_Assignment_3 : 165|3@1+ (1,0) [0|5] "ENUM"  ACM
 SG_ OBJ_Lane_Assignment_V_3 : 168|1@1+ (1,0) [0|1] "bool"  ACM
 SG_ OBJ_Age_Seconds_3 : 169|7@1+ (1,0) [0|100] "s"  ACM
 SG_ OBJ_Age_Seconds_V_3 : 176|1@1+ (1,0) [0|1] "bool"  ACM
 SG_ OBJ_Width_3 : 177|9@1+ (0.01,0) [0.4|2.95] "m"  ACM
 SG_ OBJ_Width_V_3 : 186|1@1+ (1,0) [0|1] "bool"  ACM
 SG_ OBJ_Width_STD_3 : 187|8@1+ (0.01,0) [0|2] "m"  ACM
 SG_ OBJ_Width_STD_V_3 : 195|1@1+ (1,0) [0|1] "bool"  ACM
 SG_ OBJ_Length_3 : 196|9@1+ (0.05,0) [1.2|21] "m"  ACM
 SG_ OBJ_Length_V_3 : 205|1@1+ (1,0) [0|1] "bool"  ACM
 SG_ OBJ_Length_STD_3 : 208|8@1+ (0.05,0) [0|10] "m"  ACM
 SG_ OBJ_Length_STD_V_3 : 216|1@1+ (1,0) [0|1] "bool"  ACM
 SG_ OBJ_Height_3 : 217|9@1+ (0.01,0) [0|2.95] "m"  ACM
 SG_ OBJ_Height_V_3 : 226|1@1+ (1,0) [0|1] "bool"  ACM
 SG_ OBJ_Height_STD_3 : 227|8@1+ (0.01,0) [0|2] "m"  ACM
 SG_ OBJ_Height_STD_V_3 : 235|1@1+ (1,0) [0|1] "bool"  ACM
 SG_ OBJ_Abs_Long_Velocity_3 : 240|12@1+ (0.05,-30) [-30|100] "MPS"  ACM
 SG_ OBJ_Abs_Long_Velocity_V_3 : 252|1@1+ (1,0) [0|1] "bool"  ACM
 SG_ OBJ_Abs_Long_Velocity_STD_3 : 253|11@1+ (0.05,0) [0|65] "MPS"  ACM
 SG_ OBJ_Abs_Long_Vel_STD_V_3 : 264|1@1+ (1,0) [0|1] "bool"  ACM
 SG_ OBJ_Abs_Lat_Velocity_3 : 272|11@1+ (0.05,-50) [-50|50] "MPS"  ACM
 SG_ OBJ_Abs_Lat_Velocity_V_3 : 283|1@1+ (1,0) [0|1] "bool"  ACM
 SG_ OBJ_Abs_Lat_Velocity_STD_3 : 284|10@1+ (0.05,0) [0|50] "MPS"  ACM
 SG_ OBJ_Abs_Lat_Vel_STD_V_3 : 294|1@1+ (1,0) [0|1] "bool"  ACM
 SG_ OBJ_Abs_Long_Acc_3 : 295|9@1+ (0.05,-10.3) [-10.3|7.3] "MPS2"  ACM
 SG_ OBJ_Abs_Long_Acc_V_3 : 304|1@1+ (1,0) [0|1] "bool"  ACM
 SG_ OBJ_Abs_Long_Acc_STD_3 : 305|8@1+ (0.05,0) [0|7.3] "MPS2"  ACM
 SG_ OBJ_Abs_Long_Acc_STD_V_3 : 313|1@1+ (1,0) [0|1] "bool"  ACM
 SG_ OBJ_Abs_Lat_Acc_3 : 314|9@1+ (0.05,-10.3) [-10.3|7.3] "MPS2"  ACM
 SG_ OBJ_Abs_Lat_Acc_V_3 : 323|1@1+ (1,0) [0|1] "bool"  ACM
 SG_ OBJ_Abs_Lat_Acc_STD_3 : 324|8@1+ (0.05,0) [0|7.3] "MPS2"  ACM
 SG_ OBJ_Abs_Lat_Acc_STD_V_3 : 332|1@1+ (1,0) [0|1] "bool"  ACM
 SG_ OBJ_Abs_Acceleration_3 : 336|9@1+ (0.05,-10.3) [-10.3|7.3] "MPS2"  ACM
 SG_ OBJ_Abs_Acceleration_V_3 : 345|1@1+ (1,0) [0|1] "bool"  ACM
 SG_ OBJ_Abs_Acc_STD_3 : 346|8@1+ (0.05,0) [0|7.3] "MPS2"  ACM
 SG_ OBJ_Abs_Acc_STD_V_3 : 354|1@1+ (1,0) [0|1] "bool"  ACM
 SG_ OBJ_Inv_TTC_3 : 355|11@1+ (0.01,-8) [-8|8] "INV(s)"  ACM
 SG_ OBJ_Inv_TTC_V_3 : 366|1@1+ (1,0) [0|1] "bool"  ACM
 SG_ OBJ_Inv_TTC_STD_3 : 368|11@1+ (0.01,0) [0|4] "INV(s)"  ACM
 SG_ OBJ_Inv_TTC_STD_V_3 : 379|1@1+ (1,0) [0|1] "bool"  ACM
 SG_ OBJ_Relative_Long_Acc_3 : 380|9@1+ (0.05,-10.3) [-10.3|7.3] "MPS2"  ACM
 SG_ OBJ_Relative_Long_Acc_V_3 : 389|1@1+ (1,0) [0|1] "bool"  ACM
 SG_ OBJ_Relative_Long_Acc_STD_3 : 390|8@1+ (0.05,0) [0|7.3] "MPS2"  ACM
 SG_ OBJ_Rel_Long_Acc_STD_V_3 : 398|1@1+ (1,0) [0|1] "bool"  ACM

BO_ 149 ICM_Object_Prot2_A: 64 MyECU
 SG_ ICM_Object_Prot2_A_Header : 0|16@1+ (1,0) [0|65535] ""  ACM
 SG_ OBJ_CRC_2 : 16|32@1+ (1,0) [0|4294967295] "NA"  ACM
 SG_ OBJ_ID_2 : 48|8@1+ (1,0) [0|255] "NA"  ACM
 SG_ OBJ_Existence_Probability_2 : 56|8@1+ (0.01,0) [0|1] "NA"  ACM
 SG_ OBJ_Fusion_Source_2 : 64|16@1+ (1,0) [0|65535] "BITWIZE"  ACM
 SG_ OBJ_Triggered_SDM_2 : 80|2@1+ (1,0) [0|2] "ENUM"  ACM
 SG_ OBJ_Motion_Category_2 : 82|4@1+ (1,0) [0|13] "ENUM "  ACM
 SG_ OBJ_Moving_IN_Probability_2 : 86|7@1+ (1,0) [0|0] "NA"  ACM
 SG_ OBJ_Object_Age_2 : 93|11@1+ (1,0) [0|2047] "Frame"  ACM
 SG_ OBJ_Measuring_Status_2 : 104|3@1+ (1,0) [0|7] "BITWIZE"  ACM
 SG_ OBJ_Object_Class_2 : 107|4@1+ (1,0) [0|8] "ENUM"  ACM
 SG_ OBJ_Class_Probability_2 : 112|7@1+ (0.01,0) [0|1] "NA"  ACM
 SG_ OBJ_Car_Probability_2 : 119|7@1+ (1,0) [0|0] "NA"  ACM
 SG_ OBJ_Truck_Probability_2 : 126|7@1+ (1,0) [0|0] "NA"  ACM
 SG_ OBJ_Bike_Probability_2 : 133|7@1+ (1,0) [0|0] "NA"  ACM
 SG_ OBJ_Camera_Source_2 : 140|4@1+ (1,0) [0|15] "ENUM"  ACM
 SG_ OBJ_Motion_Status_2 : 144|3@1+ (1,0) [0|5] "ENUM "  ACM
 SG_ OBJ_Motion_Orientation_2 : 147|4@1+ (1,0) [0|13] "ENUM "  ACM
 SG_ OBJ_Has_Cut_Lane_2 : 151|1@1+ (1,0) [0|1] "bool"  ACM
 SG_ OBJ_Has_Cut_Path_2 : 152|1@1+ (1,0) [0|1] "bool"  ACM
 SG_ OBJ_Brake_Light_2 : 153|1@1+ (1,0) [0|1] "bool"  ACM
 SG_ OBJ_Turn_Indicator_Right_2 : 154|1@1+ (1,0) [0|1] "bool"  ACM
 SG_ OBJ_Turn_Indicator_Left_2 : 155|1@1+ (1,0) [0|1] "bool"  ACM
 SG_ OBJ_Light_Indicator_Validity_2 : 156|1@1+ (1,0) [0|1] "bool"  ACM
 SG_ OBJ_Right_Out_Of_Image_2 : 157|1@1+ (1,0) [0|1] "bool"  ACM
 SG_ OBJ_Left_Out_Of_Image_2 : 158|1@1+ (1,0) [0|1] "bool"  ACM
 SG_ OBJ_Right_Out_Of_Image_V_2 : 159|1@1+ (1,0) [0|1] "bool"  ACM
 SG_ OBJ_Left_Out_Of_Image_V_2 : 160|1@1+ (1,0) [0|1] "bool"  ACM
 SG_ OBJ_Top_Out_Of_Image_2 : 161|1@1+ (1,0) [0|1] "bool"  ACM
 SG_ OBJ_Bottom_Out_Of_Image_2 : 162|1@1+ (1,0) [0|1] "bool"  ACM
 SG_ OBJ_Top_Out_Of_Image_V_2 : 163|1@1+ (1,0) [0|1] "bool"  ACM
 SG_ OBJ_Bottom_Out_Of_Image_V_2 : 164|1@1+ (1,0) [0|1] "bool"  ACM
 SG_ OBJ_Lane_Assignment_2 : 165|3@1+ (1,0) [0|5] "ENUM"  ACM
 SG_ OBJ_Lane_Assignment_V_2 : 168|1@1+ (1,0) [0|1] "bool"  ACM
 SG_ OBJ_Age_Seconds_2 : 169|7@1+ (1,0) [0|100] "s"  ACM
 SG_ OBJ_Age_Seconds_V_2 : 176|1@1+ (1,0) [0|1] "bool"  ACM
 SG_ OBJ_Width_2 : 177|9@1+ (0.01,0) [0.4|2.95] "m"  ACM
 SG_ OBJ_Width_V_2 : 186|1@1+ (1,0) [0|1] "bool"  ACM
 SG_ OBJ_Width_STD_2 : 187|8@1+ (0.01,0) [0|2] "m"  ACM
 SG_ OBJ_Width_STD_V_2 : 195|1@1+ (1,0) [0|1] "bool"  ACM
 SG_ OBJ_Length_2 : 196|9@1+ (0.05,0) [1.2|21] "m"  ACM
 SG_ OBJ_Length_V_2 : 205|1@1+ (1,0) [0|1] "bool"  ACM
 SG_ OBJ_Length_STD_2 : 208|8@1+ (0.05,0) [0|10] "m"  ACM
 SG_ OBJ_Length_STD_V_2 : 216|1@1+ (1,0) [0|1] "bool"  ACM
 SG_ OBJ_Height_2 : 217|9@1+ (0.01,0) [0|2.95] "m"  ACM
 SG_ OBJ_Height_V_2 : 226|1@1+ (1,0) [0|1] "bool"  ACM
 SG_ OBJ_Height_STD_2 : 227|8@1+ (0.01,0) [0|2] "m"  ACM
 SG_ OBJ_Height_STD_V_2 : 235|1@1+ (1,0) [0|1] "bool"  ACM
 SG_ OBJ_Abs_Long_Velocity_2 : 240|12@1+ (0.05,-30) [-30|100] "MPS"  ACM
 SG_ OBJ_Abs_Long_Velocity_V_2 : 252|1@1+ (1,0) [0|1] "bool"  ACM
 SG_ OBJ_Abs_Long_Velocity_STD_2 : 253|11@1+ (0.05,0) [0|65] "MPS"  ACM
 SG_ OBJ_Abs_Long_Vel_STD_V_2 : 264|1@1+ (1,0) [0|1] "bool"  ACM
 SG_ OBJ_Abs_Lat_Velocity_2 : 272|11@1+ (0.05,-50) [-50|50] "MPS"  ACM
 SG_ OBJ_Abs_Lat_Velocity_V_2 : 283|1@1+ (1,0) [0|1] "bool"  ACM
 SG_ OBJ_Abs_Lat_Velocity_STD_2 : 284|10@1+ (0.05,0) [0|50] "MPS"  ACM
 SG_ OBJ_Abs_Lat_Vel_STD_V_2 : 294|1@1+ (1,0) [0|1] "bool"  ACM
 SG_ OBJ_Abs_Long_Acc_2 : 295|9@1+ (0.05,-10.3) [-10.3|7.3] "MPS2"  ACM
 SG_ OBJ_Abs_Long_Acc_V_2 : 304|1@1+ (1,0) [0|1] "bool"  ACM
 SG_ OBJ_Abs_Long_Acc_STD_2 : 305|8@1+ (0.05,0) [0|7.3] "MPS2"  ACM
 SG_ OBJ_Abs_Long_Acc_STD_V_2 : 313|1@1+ (1,0) [0|1] "bool"  ACM
 SG_ OBJ_Abs_Lat_Acc_2 : 314|9@1+ (0.05,-10.3) [-10.3|7.3] "MPS2"  ACM
 SG_ OBJ_Abs_Lat_Acc_V_2 : 323|1@1+ (1,0) [0|1] "bool"  ACM
 SG_ OBJ_Abs_Lat_Acc_STD_2 : 324|8@1+ (0.05,0) [0|7.3] "MPS2"  ACM
 SG_ OBJ_Abs_Lat_Acc_STD_V_2 : 332|1@1+ (1,0) [0|1] "bool"  ACM
 SG_ OBJ_Abs_Acceleration_2 : 336|9@1+ (0.05,-10.3) [-10.3|7.3] "MPS2"  ACM
 SG_ OBJ_Abs_Acceleration_V_2 : 345|1@1+ (1,0) [0|1] "bool"  ACM
 SG_ OBJ_Abs_Acc_STD_2 : 346|8@1+ (0.05,0) [0|7.3] "MPS2"  ACM
 SG_ OBJ_Abs_Acc_STD_V_2 : 354|1@1+ (1,0) [0|1] "bool"  ACM
 SG_ OBJ_Inv_TTC_2 : 355|11@1+ (0.01,-8) [-8|8] "INV(s)"  ACM
 SG_ OBJ_Inv_TTC_V_2 : 366|1@1+ (1,0) [0|1] "bool"  ACM
 SG_ OBJ_Inv_TTC_STD_2 : 368|11@1+ (0.01,0) [0|4] "INV(s)"  ACM
 SG_ OBJ_Inv_TTC_STD_V_2 : 379|1@1+ (1,0) [0|1] "bool"  ACM
 SG_ OBJ_Relative_Long_Acc_2 : 380|9@1+ (0.05,-10.3) [-10.3|7.3] "MPS2"  ACM
 SG_ OBJ_Relative_Long_Acc_V_2 : 389|1@1+ (1,0) [0|1] "bool"  ACM
 SG_ OBJ_Relative_Long_Acc_STD_2 : 390|8@1+ (0.05,0) [0|7.3] "MPS2"  ACM
 SG_ OBJ_Rel_Long_Acc_STD_V_2 : 398|1@1+ (1,0) [0|1] "bool"  ACM

BO_ 150 ICM_Object_Prot2_B: 64 MyECU
 SG_ ICM_Object_Prot2_B_Header : 0|16@1+ (1,0) [0|65535] ""  ACM
 SG_ OBJ_Relative_Long_Velocity_2 : 16|13@1+ (0.05,-120) [-120|130] "MPS"  ACM
 SG_ OBJ_Relative_Long_Velocity_V_2 : 29|1@1+ (1,0) [0|1] "bool"  ACM
 SG_ OBJ_Relative_Long_Vel_STD_2 : 30|12@1+ (0.05,0) [0|130] "MPS"  ACM
 SG_ OBJ_Rel_Long_Vel_STD_V_2 : 42|1@1+ (1,0) [0|1] "bool"  ACM
 SG_ OBJ_Relative_Lat_Velocity_2 : 48|11@1+ (0.05,-50) [-50|50] "MPS"  ACM
 SG_ OBJ_Relative_Lat_Velocity_V_2 : 59|1@1+ (1,0) [0|1] "bool"  ACM
 SG_ OBJ_Relative_Lat_Velocity_STD_2 : 60|10@1+ (0.05,0) [0|50] "MPS"  ACM
 SG_ OBJ_Rel_Lat_Vel_STD_V_2 : 70|1@1+ (1,0) [0|1] "bool"  ACM
 SG_ OBJ_Long_Distance_2 : 80|14@1+ (0.05,-200) [-200|250] "m"  ACM
 SG_ OBJ_Long_Distance_V_2 : 94|1@1+ (1,0) [0|1] "bool"  ACM
 SG_ OBJ_Long_Distance_STD_2 : 95|13@1+ (0.05,0) [0|250] "m"  ACM
 SG_ OBJ_Long_Distance_STD_V_2 : 108|1@1+ (1,0) [0|1] "bool"  ACM
 SG_ OBJ_Lat_Distance_2 : 112|12@1+ (0.05,-100) [-100|100] "m"  ACM
 SG_ OBJ_Lat_Distance_V_2 : 124|1@1+ (1,0) [0|1] "bool"  ACM
 SG_ OBJ_Lat_Distance_STD_2 : 125|11@1+ (0.05,0) [0|100] "m"  ACM
 SG_ OBJ_Lat_Distance_STD_V_2 : 136|1@1+ (1,0) [0|1] "bool"  ACM
 SG_ OBJ_Absolute_Speed_2 : 144|12@1+ (0.05,-65) [-65|65] "MPS"  ACM
 SG_ OBJ_Absolute_Speed_V_2 : 156|1@1+ (1,0) [0|1] "bool"  ACM
 SG_ OBJ_Absolute_Speed_STD_2 : 157|11@1+ (0.05,0) [0|65] "MPS"  ACM
 SG_ OBJ_Absolute_Speed_STD_V_2 : 168|1@1+ (1,0) [0|1] "bool"  ACM
 SG_ OBJ_Heading_2 : 176|10@1+ (0.01,-3.14) [-3.14|3.14] "rad"  ACM
 SG_ OBJ_Heading_V_2 : 186|1@1+ (1,0) [0|1] "bool"  ACM
 SG_ OBJ_Heading_STD_2 : 187|9@1+ (0.01,0) [0|3.14] "rad"  ACM
 SG_ OBJ_Heading_STD_V_2 : 196|1@1+ (1,0) [0|1] "bool"  ACM
 SG_ OBJ_Angle_Rate_STD_2 : 197|11@1+ (0.002,0) [0|2.2318] "RPS"  ACM
 SG_ OBJ_Angle_Rate_STD_V_2 : 208|1@1+ (1,0) [0|1] "bool"  ACM
 SG_ OBJ_Angle_Rate_2 : 209|12@1+ (0.002,-2.234) [-2.234|2.2318] "RPS"  ACM
 SG_ OBJ_Angle_Rate_V_2 : 221|1@1+ (1,0) [0|1] "bool"  ACM
 SG_ OBJ_Angle_Right_2 : 222|14@1+ (0.0002,-1.571) [-1.571|1.571] "rad "  ACM
 SG_ OBJ_Angle_Right_V_2 : 236|1@1+ (1,0) [0|1] "bool"  ACM
 SG_ OBJ_Angle_Right_STD_2 : 240|13@1+ (0.0002,0) [0|1.571] "rad "  ACM
 SG_ OBJ_Angle_Right_STD_V_2 : 253|1@1+ (1,0) [0|1] "bool"  ACM
 SG_ OBJ_Angle_Left_2 : 254|14@1+ (0.0002,-1.571) [-1.571|1.571] "rad "  ACM
 SG_ OBJ_Angle_Left_V_2 : 268|1@1+ (1,0) [0|1] "bool"  ACM
 SG_ OBJ_Angle_Left_STD_2 : 272|13@1+ (0.0002,0) [0|1.571] "rad"  ACM
 SG_ OBJ_Angle_Left_STD_V_2 : 285|1@1+ (1,0) [0|1] "bool"  ACM
 SG_ OBJ_Angle_Side_2 : 286|14@1+ (0.0002,-1.571) [-1.571|1.571] "rad"  ACM
 SG_ OBJ_Angle_Side_V_2 : 300|1@1+ (1,0) [0|1] "bool"  ACM
 SG_ OBJ_Angle_Side_STD_2 : 304|13@1+ (0.0002,0) [0|1.571] "rad"  ACM
 SG_ OBJ_Angle_Side_STD_V_2 : 317|1@1+ (1,0) [0|1] "bool"  ACM
 SG_ OBJ_Angle_Mid_V_2 : 318|1@1+ (1,0) [0|1] "bool"  ACM
 SG_ OBJ_Angle_Mid_2 : 319|14@1+ (0.0002,-1.571) [-1.571|1.571] "rad"  ACM
 SG_ OBJ_Angle_Mid_STD_2 : 336|13@1+ (0.0002,0) [0|1.571] "rad"  ACM
 SG_ OBJ_Angle_Mid_STD_V_2 : 349|1@1+ (1,0) [0|1] "bool"  ACM
 SG_ OBJ_Angle_Bottom_V_2 : 350|1@1+ (1,0) [0|1] "bool"  ACM
 SG_ OBJ_Angle_Bottom_2 : 351|14@1+ (0.0002,-1.571) [-1.571|1.571] "rad"  ACM
 SG_ OBJ_Angle_Bottom_STD_2 : 368|13@1+ (0.0002,0) [0|1.571] "rad"  ACM
 SG_ OBJ_Angle_Bottom_STD_V_2 : 381|1@1+ (1,0) [0|1] "bool"  ACM
 SG_ OBJ_Visibility_Side_V_2 : 382|1@1+ (1,0) [0|1] "bool"  ACM
 SG_ OBJ_Visibility_Side_2 : 383|2@1+ (1,0) [0|2] "ENUM"  ACM
 SG_ OBJ_Is_In_Drivable_Area_2 : 385|1@1+ (1,0) [0|1] "bool"  ACM
 SG_ OBJ_Is_In_Drivable_Area_V_2 : 386|1@1+ (1,0) [0|1] "bool"  ACM
 SG_ OBJ_Is_VeryClose_2 : 387|1@1+ (1,0) [0|1] "bool"  ACM
 SG_ OBJ_Is_VeryClose_V_2 : 388|1@1+ (1,0) [0|1] "bool"  ACM
 SG_ OBJ_Buffer_2 : 389|11@1+ (1,0) [0|0] "NA"  ACM

BO_ 147 ICM_Object_Prot1_A: 64 MyECU
 SG_ ICM_Object_Prot1_A_Header : 0|16@1+ (1,0) [0|65535] ""  ACM
 SG_ OBJ_CRC_1 : 16|32@1+ (1,0) [0|4294967295] "NA"  ACM
 SG_ OBJ_ID_1 : 48|8@1+ (1,0) [0|255] "NA"  ACM
 SG_ OBJ_Existence_Probability_1 : 56|8@1+ (0.01,0) [0|1] "NA"  ACM
 SG_ OBJ_Fusion_Source_1 : 64|16@1+ (1,0) [0|65535] "BITWIZE"  ACM
 SG_ OBJ_Triggered_SDM_1 : 80|2@1+ (1,0) [0|2] "ENUM"  ACM
 SG_ OBJ_Motion_Category_1 : 82|4@1+ (1,0) [0|13] "ENUM "  ACM
 SG_ OBJ_Moving_IN_Probability_1 : 86|7@1+ (1,0) [0|0] "NA"  ACM
 SG_ OBJ_Object_Age_1 : 93|11@1+ (1,0) [0|2047] "Frame"  ACM
 SG_ OBJ_Measuring_Status_1 : 104|3@1+ (1,0) [0|7] "BITWIZE"  ACM
 SG_ OBJ_Object_Class_1 : 107|4@1+ (1,0) [0|8] "ENUM"  ACM
 SG_ OBJ_Class_Probability_1 : 112|7@1+ (0.01,0) [0|1] "NA"  ACM
 SG_ OBJ_Car_Probability_1 : 119|7@1+ (1,0) [0|0] "NA"  ACM
 SG_ OBJ_Truck_Probability_1 : 126|7@1+ (1,0) [0|0] "NA"  ACM
 SG_ OBJ_Bike_Probability_1 : 133|7@1+ (1,0) [0|0] "NA"  ACM
 SG_ OBJ_Camera_Source_1 : 140|4@1+ (1,0) [0|15] "ENUM"  ACM
 SG_ OBJ_Motion_Status_1 : 144|3@1+ (1,0) [0|5] "ENUM "  ACM
 SG_ OBJ_Motion_Orientation_1 : 147|4@1+ (1,0) [0|13] "ENUM "  ACM
 SG_ OBJ_Has_Cut_Lane_1 : 151|1@1+ (1,0) [0|1] "bool"  ACM
 SG_ OBJ_Has_Cut_Path_1 : 152|1@1+ (1,0) [0|1] "bool"  ACM
 SG_ OBJ_Brake_Light_1 : 153|1@1+ (1,0) [0|1] "bool"  ACM
 SG_ OBJ_Turn_Indicator_Right_1 : 154|1@1+ (1,0) [0|1] "bool"  ACM
 SG_ OBJ_Turn_Indicator_Left_1 : 155|1@1+ (1,0) [0|1] "bool"  ACM
 SG_ OBJ_Light_Indicator_Validity_1 : 156|1@1+ (1,0) [0|1] "bool"  ACM
 SG_ OBJ_Right_Out_Of_Image_1 : 157|1@1+ (1,0) [0|1] "bool"  ACM
 SG_ OBJ_Left_Out_Of_Image_1 : 158|1@1+ (1,0) [0|1] "bool"  ACM
 SG_ OBJ_Right_Out_Of_Image_V_1 : 159|1@1+ (1,0) [0|1] "bool"  ACM
 SG_ OBJ_Left_Out_Of_Image_V_1 : 160|1@1+ (1,0) [0|1] "bool"  ACM
 SG_ OBJ_Top_Out_Of_Image_1 : 161|1@1+ (1,0) [0|1] "bool"  ACM
 SG_ OBJ_Bottom_Out_Of_Image_1 : 162|1@1+ (1,0) [0|1] "bool"  ACM
 SG_ OBJ_Top_Out_Of_Image_V_1 : 163|1@1+ (1,0) [0|1] "bool"  ACM
 SG_ OBJ_Bottom_Out_Of_Image_V_1 : 164|1@1+ (1,0) [0|1] "bool"  ACM
 SG_ OBJ_Lane_Assignment_1 : 165|3@1+ (1,0) [0|5] "ENUM"  ACM
 SG_ OBJ_Lane_Assignment_V_1 : 168|1@1+ (1,0) [0|1] "bool"  ACM
 SG_ OBJ_Age_Seconds_1 : 169|7@1+ (1,0) [0|100] "s"  ACM
 SG_ OBJ_Age_Seconds_V_1 : 176|1@1+ (1,0) [0|1] "bool"  ACM
 SG_ OBJ_Width_1 : 177|9@1+ (0.01,0) [0.4|2.95] "m"  ACM
 SG_ OBJ_Width_V_1 : 186|1@1+ (1,0) [0|1] "bool"  ACM
 SG_ OBJ_Width_STD_1 : 187|8@1+ (0.01,0) [0|2] "m"  ACM
 SG_ OBJ_Width_STD_V_1 : 195|1@1+ (1,0) [0|1] "bool"  ACM
 SG_ OBJ_Length_1 : 196|9@1+ (0.05,0) [1.2|21] "m"  ACM
 SG_ OBJ_Length_V_1 : 205|1@1+ (1,0) [0|1] "bool"  ACM
 SG_ OBJ_Length_STD_1 : 208|8@1+ (0.05,0) [0|10] "m"  ACM
 SG_ OBJ_Length_STD_V_1 : 216|1@1+ (1,0) [0|1] "bool"  ACM
 SG_ OBJ_Height_1 : 217|9@1+ (0.01,0) [0|2.95] "m"  ACM
 SG_ OBJ_Height_V_1 : 226|1@1+ (1,0) [0|1] "bool"  ACM
 SG_ OBJ_Height_STD_1 : 227|8@1+ (0.01,0) [0|2] "m"  ACM
 SG_ OBJ_Height_STD_V_1 : 235|1@1+ (1,0) [0|1] "bool"  ACM
 SG_ OBJ_Abs_Long_Velocity_1 : 240|12@1+ (0.05,-30) [-30|100] "MPS"  ACM
 SG_ OBJ_Abs_Long_Velocity_V_1 : 252|1@1+ (1,0) [0|1] "bool"  ACM
 SG_ OBJ_Abs_Long_Velocity_STD_1 : 253|11@1+ (0.05,0) [0|65] "MPS"  ACM
 SG_ OBJ_Abs_Long_Vel_STD_V_1 : 264|1@1+ (1,0) [0|1] "bool"  ACM
 SG_ OBJ_Abs_Lat_Velocity_1 : 272|11@1+ (0.05,-50) [-50|50] "MPS"  ACM
 SG_ OBJ_Abs_Lat_Velocity_V_1 : 283|1@1+ (1,0) [0|1] "bool"  ACM
 SG_ OBJ_Abs_Lat_Velocity_STD_1 : 284|10@1+ (0.05,0) [0|50] "MPS"  ACM
 SG_ OBJ_Abs_Lat_Vel_STD_V_1 : 294|1@1+ (1,0) [0|1] "bool"  ACM
 SG_ OBJ_Abs_Long_Acc_1 : 295|9@1+ (0.05,-10.3) [-10.3|7.3] "MPS2"  ACM
 SG_ OBJ_Abs_Long_Acc_V_1 : 304|1@1+ (1,0) [0|1] "bool"  ACM
 SG_ OBJ_Abs_Long_Acc_STD_1 : 305|8@1+ (0.05,0) [0|7.3] "MPS2"  ACM
 SG_ OBJ_Abs_Long_Acc_STD_V_1 : 313|1@1+ (1,0) [0|1] "bool"  ACM
 SG_ OBJ_Abs_Lat_Acc_1 : 314|9@1+ (0.05,-10.3) [-10.3|7.3] "MPS2"  ACM
 SG_ OBJ_Abs_Lat_Acc_V_1 : 323|1@1+ (1,0) [0|1] "bool"  ACM
 SG_ OBJ_Abs_Lat_Acc_STD_1 : 324|8@1+ (0.05,0) [0|7.3] "MPS2"  ACM
 SG_ OBJ_Abs_Lat_Acc_STD_V_1 : 332|1@1+ (1,0) [0|1] "bool"  ACM
 SG_ OBJ_Abs_Acceleration_1 : 336|9@1+ (0.05,-10.3) [-10.3|7.3] "MPS2"  ACM
 SG_ OBJ_Abs_Acceleration_V_1 : 345|1@1+ (1,0) [0|1] "bool"  ACM
 SG_ OBJ_Abs_Acc_STD_1 : 346|8@1+ (0.05,0) [0|7.3] "MPS2"  ACM
 SG_ OBJ_Abs_Acc_STD_V_1 : 354|1@1+ (1,0) [0|1] "bool"  ACM
 SG_ OBJ_Inv_TTC_1 : 355|11@1+ (0.01,-8) [-8|8] "INV(s)"  ACM
 SG_ OBJ_Inv_TTC_V_1 : 366|1@1+ (1,0) [0|1] "bool"  ACM
 SG_ OBJ_Inv_TTC_STD_1 : 368|11@1+ (0.01,0) [0|4] "INV(s)"  ACM
 SG_ OBJ_Inv_TTC_STD_V_1 : 379|1@1+ (1,0) [0|1] "bool"  ACM
 SG_ OBJ_Relative_Long_Acc_1 : 380|9@1+ (0.05,-10.3) [-10.3|7.3] "MPS2"  ACM
 SG_ OBJ_Relative_Long_Acc_V_1 : 389|1@1+ (1,0) [0|1] "bool"  ACM
 SG_ OBJ_Relative_Long_Acc_STD_1 : 390|8@1+ (0.05,0) [0|7.3] "MPS2"  ACM
 SG_ OBJ_Rel_Long_Acc_STD_V_1 : 398|1@1+ (1,0) [0|1] "bool"  ACM

BO_ 148 ICM_Object_Prot1_B: 64 MyECU
 SG_ ICM_Object_Prot1_B_Header : 0|16@1+ (1,0) [0|65535] ""  ACM
 SG_ OBJ_Relative_Long_Velocity_1 : 16|13@1+ (0.05,-120) [-120|130] "MPS"  ACM
 SG_ OBJ_Relative_Long_Velocity_V_1 : 29|1@1+ (1,0) [0|1] "bool"  ACM
 SG_ OBJ_Relative_Long_Vel_STD_1 : 30|12@1+ (0.05,0) [0|130] "MPS"  ACM
 SG_ OBJ_Rel_Long_Vel_STD_V_1 : 42|1@1+ (1,0) [0|1] "bool"  ACM
 SG_ OBJ_Relative_Lat_Velocity_1 : 48|11@1+ (0.05,-50) [-50|50] "MPS"  ACM
 SG_ OBJ_Relative_Lat_Velocity_V_1 : 59|1@1+ (1,0) [0|1] "bool"  ACM
 SG_ OBJ_Relative_Lat_Velocity_STD_1 : 60|10@1+ (0.05,0) [0|50] "MPS"  ACM
 SG_ OBJ_Rel_Lat_Vel_STD_V_1 : 70|1@1+ (1,0) [0|1] "bool"  ACM
 SG_ OBJ_Long_Distance_1 : 80|14@1+ (0.05,-200) [-200|250] "m"  ACM
 SG_ OBJ_Long_Distance_V_1 : 94|1@1+ (1,0) [0|1] "bool"  ACM
 SG_ OBJ_Long_Distance_STD_1 : 95|13@1+ (0.05,0) [0|250] "m"  ACM
 SG_ OBJ_Long_Distance_STD_V_1 : 108|1@1+ (1,0) [0|1] "bool"  ACM
 SG_ OBJ_Lat_Distance_1 : 112|12@1+ (0.05,-100) [-100|100] "m"  ACM
 SG_ OBJ_Lat_Distance_V_1 : 124|1@1+ (1,0) [0|1] "bool"  ACM
 SG_ OBJ_Lat_Distance_STD_1 : 125|11@1+ (0.05,0) [0|100] "m"  ACM
 SG_ OBJ_Lat_Distance_STD_V_1 : 136|1@1+ (1,0) [0|1] "bool"  ACM
 SG_ OBJ_Absolute_Speed_1 : 144|12@1+ (0.05,-65) [-65|65] "MPS"  ACM
 SG_ OBJ_Absolute_Speed_V_1 : 156|1@1+ (1,0) [0|1] "bool"  ACM
 SG_ OBJ_Absolute_Speed_STD_1 : 157|11@1+ (0.05,0) [0|65] "MPS"  ACM
 SG_ OBJ_Absolute_Speed_STD_V_1 : 168|1@1+ (1,0) [0|1] "bool"  ACM
 SG_ OBJ_Heading_1 : 176|10@1+ (0.01,-3.14) [-3.14|3.14] "rad"  ACM
 SG_ OBJ_Heading_V_1 : 186|1@1+ (1,0) [0|1] "bool"  ACM
 SG_ OBJ_Heading_STD_1 : 187|9@1+ (0.01,0) [0|3.14] "rad"  ACM
 SG_ OBJ_Heading_STD_V_1 : 196|1@1+ (1,0) [0|1] "bool"  ACM
 SG_ OBJ_Angle_Rate_STD_1 : 197|11@1+ (0.002,0) [0|2.2318] "RPS"  ACM
 SG_ OBJ_Angle_Rate_STD_V_1 : 208|1@1+ (1,0) [0|1] "bool"  ACM
 SG_ OBJ_Angle_Rate_1 : 209|12@1+ (0.002,-2.234) [-2.234|2.2318] "RPS"  ACM
 SG_ OBJ_Angle_Rate_V_1 : 221|1@1+ (1,0) [0|1] "bool"  ACM
 SG_ OBJ_Angle_Right_1 : 222|14@1+ (0.0002,-1.571) [-1.571|1.571] "rad "  ACM
 SG_ OBJ_Angle_Right_V_1 : 236|1@1+ (1,0) [0|1] "bool"  ACM
 SG_ OBJ_Angle_Right_STD_1 : 240|13@1+ (0.0002,0) [0|1.571] "rad "  ACM
 SG_ OBJ_Angle_Right_STD_V_1 : 253|1@1+ (1,0) [0|1] "bool"  ACM
 SG_ OBJ_Angle_Left_1 : 254|14@1+ (0.0002,-1.571) [-1.571|1.571] "rad "  ACM
 SG_ OBJ_Angle_Left_V_1 : 268|1@1+ (1,0) [0|1] "bool"  ACM
 SG_ OBJ_Angle_Left_STD_1 : 272|13@1+ (0.0002,0) [0|1.571] "rad"  ACM
 SG_ OBJ_Angle_Left_STD_V_1 : 285|1@1+ (1,0) [0|1] "bool"  ACM
 SG_ OBJ_Angle_Side_1 : 286|14@1+ (0.0002,-1.571) [-1.571|1.571] "rad"  ACM
 SG_ OBJ_Angle_Side_V_1 : 300|1@1+ (1,0) [0|1] "bool"  ACM
 SG_ OBJ_Angle_Side_STD_1 : 304|13@1+ (0.0002,0) [0|1.571] "rad"  ACM
 SG_ OBJ_Angle_Side_STD_V_1 : 317|1@1+ (1,0) [0|1] "bool"  ACM
 SG_ OBJ_Angle_Mid_V_1 : 318|1@1+ (1,0) [0|1] "bool"  ACM
 SG_ OBJ_Angle_Mid_1 : 319|14@1+ (0.0002,-1.571) [-1.571|1.571] "rad"  ACM
 SG_ OBJ_Angle_Mid_STD_1 : 336|13@1+ (0.0002,0) [0|1.571] "rad"  ACM
 SG_ OBJ_Angle_Mid_STD_V_1 : 349|1@1+ (1,0) [0|1] "bool"  ACM
 SG_ OBJ_Angle_Bottom_V_1 : 350|1@1+ (1,0) [0|1] "bool"  ACM
 SG_ OBJ_Angle_Bottom_1 : 351|14@1+ (0.0002,-1.571) [-1.571|1.571] "rad"  ACM
 SG_ OBJ_Angle_Bottom_STD_1 : 368|13@1+ (0.0002,0) [0|1.571] "rad"  ACM
 SG_ OBJ_Angle_Bottom_STD_V_1 : 381|1@1+ (1,0) [0|1] "bool"  ACM
 SG_ OBJ_Visibility_Side_V_1 : 382|1@1+ (1,0) [0|1] "bool"  ACM
 SG_ OBJ_Visibility_Side_1 : 383|2@1+ (1,0) [0|2] "ENUM"  ACM
 SG_ OBJ_Is_In_Drivable_Area_1 : 385|1@1+ (1,0) [0|1] "bool"  ACM
 SG_ OBJ_Is_In_Drivable_Area_V_1 : 386|1@1+ (1,0) [0|1] "bool"  ACM
 SG_ OBJ_Is_VeryClose_1 : 387|1@1+ (1,0) [0|1] "bool"  ACM
 SG_ OBJ_Is_VeryClose_V_1 : 388|1@1+ (1,0) [0|1] "bool"  ACM
 SG_ OBJ_Buffer_1 : 389|11@1+ (1,0) [0|0] "NA"  ACM

BO_ 146 ICM_Object_Prot0_B: 64 MyECU
 SG_ ICM_Object_Prot0_B_Header : 0|16@1+ (1,0) [0|65535] ""  ACM
 SG_ OBJ_Relative_Long_Velocity_0 : 16|13@1+ (0.05,-120) [-120|130] "MPS"  ACM
 SG_ OBJ_Relative_Long_Velocity_V_0 : 29|1@1+ (1,0) [0|1] "bool"  ACM
 SG_ OBJ_Relative_Long_Vel_STD_0 : 30|12@1+ (0.05,0) [0|130] "MPS"  ACM
 SG_ OBJ_Rel_Long_Vel_STD_V_0 : 42|1@1+ (1,0) [0|1] "bool"  ACM
 SG_ OBJ_Relative_Lat_Velocity_0 : 48|11@1+ (0.05,-50) [-50|50] "MPS"  ACM
 SG_ OBJ_Relative_Lat_Velocity_V_0 : 59|1@1+ (1,0) [0|1] "bool"  ACM
 SG_ OBJ_Relative_Lat_Velocity_STD_0 : 60|10@1+ (0.05,0) [0|50] "MPS"  ACM
 SG_ OBJ_Rel_Lat_Vel_STD_V_0 : 70|1@1+ (1,0) [0|1] "bool"  ACM
 SG_ OBJ_Long_Distance_0 : 80|14@1+ (0.05,-200) [-200|250] "m"  ACM
 SG_ OBJ_Long_Distance_V_0 : 94|1@1+ (1,0) [0|1] "bool"  ACM
 SG_ OBJ_Long_Distance_STD_0 : 95|13@1+ (0.05,0) [0|250] "m"  ACM
 SG_ OBJ_Long_Distance_STD_V_0 : 108|1@1+ (1,0) [0|1] "bool"  ACM
 SG_ OBJ_Lat_Distance_0 : 112|12@1+ (0.05,-100) [-100|100] "m"  ACM
 SG_ OBJ_Lat_Distance_V_0 : 124|1@1+ (1,0) [0|1] "bool"  ACM
 SG_ OBJ_Lat_Distance_STD_0 : 125|11@1+ (0.05,0) [0|100] "m"  ACM
 SG_ OBJ_Lat_Distance_STD_V_0 : 136|1@1+ (1,0) [0|1] "bool"  ACM
 SG_ OBJ_Absolute_Speed_0 : 144|12@1+ (0.05,-65) [-65|65] "MPS"  ACM
 SG_ OBJ_Absolute_Speed_V_0 : 156|1@1+ (1,0) [0|1] "bool"  ACM
 SG_ OBJ_Absolute_Speed_STD_0 : 157|11@1+ (0.05,0) [0|65] "MPS"  ACM
 SG_ OBJ_Absolute_Speed_STD_V_0 : 168|1@1+ (1,0) [0|1] "bool"  ACM
 SG_ OBJ_Heading_0 : 176|10@1+ (0.01,-3.14) [-3.14|3.14] "rad"  ACM
 SG_ OBJ_Heading_V_0 : 186|1@1+ (1,0) [0|1] "bool"  ACM
 SG_ OBJ_Heading_STD_0 : 187|9@1+ (0.01,0) [0|3.14] "rad"  ACM
 SG_ OBJ_Heading_STD_V_0 : 196|1@1+ (1,0) [0|1] "bool"  ACM
 SG_ OBJ_Angle_Rate_STD_0 : 197|11@1+ (0.002,0) [0|2.2318] "RPS"  ACM
 SG_ OBJ_Angle_Rate_STD_V_0 : 208|1@1+ (1,0) [0|1] "bool"  ACM
 SG_ OBJ_Angle_Rate_0 : 209|12@1+ (0.002,-2.234) [-2.234|2.2318] "RPS"  ACM
 SG_ OBJ_Angle_Rate_V_0 : 221|1@1+ (1,0) [0|1] "bool"  ACM
 SG_ OBJ_Angle_Right_0 : 222|14@1+ (0.0002,-1.571) [-1.571|1.571] "rad "  ACM
 SG_ OBJ_Angle_Right_V_0 : 236|1@1+ (1,0) [0|1] "bool"  ACM
 SG_ OBJ_Angle_Right_STD_0 : 240|13@1+ (0.0002,0) [0|1.571] "rad "  ACM
 SG_ OBJ_Angle_Right_STD_V_0 : 253|1@1+ (1,0) [0|1] "bool"  ACM
 SG_ OBJ_Angle_Left_0 : 254|14@1+ (0.0002,-1.571) [-1.571|1.571] "rad "  ACM
 SG_ OBJ_Angle_Left_V_0 : 268|1@1+ (1,0) [0|1] "bool"  ACM
 SG_ OBJ_Angle_Left_STD_0 : 272|13@1+ (0.0002,0) [0|1.571] "rad"  ACM
 SG_ OBJ_Angle_Left_STD_V_0 : 285|1@1+ (1,0) [0|1] "bool"  ACM
 SG_ OBJ_Angle_Side_0 : 286|14@1+ (0.0002,-1.571) [-1.571|1.571] "rad"  ACM
 SG_ OBJ_Angle_Side_V_0 : 300|1@1+ (1,0) [0|1] "bool"  ACM
 SG_ OBJ_Angle_Side_STD_0 : 304|13@1+ (0.0002,0) [0|1.571] "rad"  ACM
 SG_ OBJ_Angle_Side_STD_V_0 : 317|1@1+ (1,0) [0|1] "bool"  ACM
 SG_ OBJ_Angle_Mid_V_0 : 318|1@1+ (1,0) [0|1] "bool"  ACM
 SG_ OBJ_Angle_Mid_0 : 319|14@1+ (0.0002,-1.571) [-1.571|1.571] "rad"  ACM
 SG_ OBJ_Angle_Mid_STD_0 : 336|13@1+ (0.0002,0) [0|1.571] "rad"  ACM
 SG_ OBJ_Angle_Mid_STD_V_0 : 349|1@1+ (1,0) [0|1] "bool"  ACM
 SG_ OBJ_Angle_Bottom_V_0 : 350|1@1+ (1,0) [0|1] "bool"  ACM
 SG_ OBJ_Angle_Bottom_0 : 351|14@1+ (0.0002,-1.571) [-1.571|1.571] "rad"  ACM
 SG_ OBJ_Angle_Bottom_STD_0 : 368|13@1+ (0.0002,0) [0|1.571] "rad"  ACM
 SG_ OBJ_Angle_Bottom_STD_V_0 : 381|1@1+ (1,0) [0|1] "bool"  ACM
 SG_ OBJ_Visibility_Side_V_0 : 382|1@1+ (1,0) [0|1] "bool"  ACM
 SG_ OBJ_Visibility_Side_0 : 383|2@1+ (1,0) [0|2] "ENUM"  ACM
 SG_ OBJ_Is_In_Drivable_Area_0 : 385|1@1+ (1,0) [0|1] "bool"  ACM
 SG_ OBJ_Is_In_Drivable_Area_V_0 : 386|1@1+ (1,0) [0|1] "bool"  ACM
 SG_ OBJ_Is_VeryClose_0 : 387|1@1+ (1,0) [0|1] "bool"  ACM
 SG_ OBJ_Is_VeryClose_V_0 : 388|1@1+ (1,0) [0|1] "bool"  ACM
 SG_ OBJ_Buffer_0 : 389|11@1+ (1,0) [0|0] "NA"  ACM

BO_ 145 ICM_Object_Prot0_A: 64 MyECU
 SG_ ICM_Object_Prot0_A_Header : 0|16@1+ (1,0) [0|65535] ""  ACM
 SG_ OBJ_CRC_0 : 16|32@1+ (1,0) [0|4294967295] "NA"  ACM
 SG_ OBJ_ID_0 : 48|8@1+ (1,0) [0|255] "NA"  ACM
 SG_ OBJ_Existence_Probability_0 : 56|8@1+ (0.01,0) [0|1] "NA"  ACM
 SG_ OBJ_Fusion_Source_0 : 64|16@1+ (1,0) [0|65535] "BITWIZE"  ACM
 SG_ OBJ_Triggered_SDM_0 : 80|2@1+ (1,0) [0|2] "ENUM"  ACM
 SG_ OBJ_Motion_Category_0 : 82|4@1+ (1,0) [0|13] "ENUM "  ACM
 SG_ OBJ_Moving_IN_Probability_0 : 86|7@1+ (1,0) [0|0] "NA"  ACM
 SG_ OBJ_Object_Age_0 : 93|11@1+ (1,0) [0|2047] "Frame"  ACM
 SG_ OBJ_Measuring_Status_0 : 104|3@1+ (1,0) [0|7] "BITWIZE"  ACM
 SG_ OBJ_Object_Class_0 : 107|4@1+ (1,0) [0|8] "ENUM"  ACM
 SG_ OBJ_Class_Probability_0 : 112|7@1+ (0.01,0) [0|1] "NA"  ACM
 SG_ OBJ_Car_Probability_0 : 119|7@1+ (1,0) [0|0] "NA"  ACM
 SG_ OBJ_Truck_Probability_0 : 126|7@1+ (1,0) [0|0] "NA"  ACM
 SG_ OBJ_Bike_Probability_0 : 133|7@1+ (1,0) [0|0] "NA"  ACM
 SG_ OBJ_Camera_Source_0 : 140|4@1+ (1,0) [0|15] "ENUM"  ACM
 SG_ OBJ_Motion_Status_0 : 144|3@1+ (1,0) [0|5] "ENUM "  ACM
 SG_ OBJ_Motion_Orientation_0 : 147|4@1+ (1,0) [0|13] "ENUM "  ACM
 SG_ OBJ_Has_Cut_Lane_0 : 151|1@1+ (1,0) [0|1] "bool"  ACM
 SG_ OBJ_Has_Cut_Path_0 : 152|1@1+ (1,0) [0|1] "bool"  ACM
 SG_ OBJ_Brake_Light_0 : 153|1@1+ (1,0) [0|1] "bool"  ACM
 SG_ OBJ_Turn_Indicator_Right_0 : 154|1@1+ (1,0) [0|1] "bool"  ACM
 SG_ OBJ_Turn_Indicator_Left_0 : 155|1@1+ (1,0) [0|1] "bool"  ACM
 SG_ OBJ_Light_Indicator_Validity_0 : 156|1@1+ (1,0) [0|1] "bool"  ACM
 SG_ OBJ_Right_Out_Of_Image_0 : 157|1@1+ (1,0) [0|1] "bool"  ACM
 SG_ OBJ_Left_Out_Of_Image_0 : 158|1@1+ (1,0) [0|1] "bool"  ACM
 SG_ OBJ_Right_Out_Of_Image_V_0 : 159|1@1+ (1,0) [0|1] "bool"  ACM
 SG_ OBJ_Left_Out_Of_Image_V_0 : 160|1@1+ (1,0) [0|1] "bool"  ACM
 SG_ OBJ_Top_Out_Of_Image_0 : 161|1@1+ (1,0) [0|1] "bool"  ACM
 SG_ OBJ_Bottom_Out_Of_Image_0 : 162|1@1+ (1,0) [0|1] "bool"  ACM
 SG_ OBJ_Top_Out_Of_Image_V_0 : 163|1@1+ (1,0) [0|1] "bool"  ACM
 SG_ OBJ_Bottom_Out_Of_Image_V_0 : 164|1@1+ (1,0) [0|1] "bool"  ACM
 SG_ OBJ_Lane_Assignment_0 : 165|3@1+ (1,0) [0|5] "ENUM"  ACM
 SG_ OBJ_Lane_Assignment_V_0 : 168|1@1+ (1,0) [0|1] "bool"  ACM
 SG_ OBJ_Age_Seconds_0 : 169|7@1+ (1,0) [0|100] "s"  ACM
 SG_ OBJ_Age_Seconds_V_0 : 176|1@1+ (1,0) [0|1] "bool"  ACM
 SG_ OBJ_Width_0 : 177|9@1+ (0.01,0) [0.4|2.95] "m"  ACM
 SG_ OBJ_Width_V_0 : 186|1@1+ (1,0) [0|1] "bool"  ACM
 SG_ OBJ_Width_STD_0 : 187|8@1+ (0.01,0) [0|2] "m"  ACM
 SG_ OBJ_Width_STD_V_0 : 195|1@1+ (1,0) [0|1] "bool"  ACM
 SG_ OBJ_Length_0 : 196|9@1+ (0.05,0) [1.2|21] "m"  ACM
 SG_ OBJ_Length_V_0 : 205|1@1+ (1,0) [0|1] "bool"  ACM
 SG_ OBJ_Length_STD_0 : 208|8@1+ (0.05,0) [0|10] "m"  ACM
 SG_ OBJ_Length_STD_V_0 : 216|1@1+ (1,0) [0|1] "bool"  ACM
 SG_ OBJ_Height_0 : 217|9@1+ (0.01,0) [0|2.95] "m"  ACM
 SG_ OBJ_Height_V_0 : 226|1@1+ (1,0) [0|1] "bool"  ACM
 SG_ OBJ_Height_STD_0 : 227|8@1+ (0.01,0) [0|2] "m"  ACM
 SG_ OBJ_Height_STD_V_0 : 235|1@1+ (1,0) [0|1] "bool"  ACM
 SG_ OBJ_Abs_Long_Velocity_0 : 240|12@1+ (0.05,-30) [-30|100] "MPS"  ACM
 SG_ OBJ_Abs_Long_Velocity_V_0 : 252|1@1+ (1,0) [0|1] "bool"  ACM
 SG_ OBJ_Abs_Long_Velocity_STD_0 : 253|11@1+ (0.05,0) [0|65] "MPS"  ACM
 SG_ OBJ_Abs_Long_Vel_STD_V_0 : 264|1@1+ (1,0) [0|1] "bool"  ACM
 SG_ OBJ_Abs_Lat_Velocity_0 : 272|11@1+ (0.05,-50) [-50|50] "MPS"  ACM
 SG_ OBJ_Abs_Lat_Velocity_V_0 : 283|1@1+ (1,0) [0|1] "bool"  ACM
 SG_ OBJ_Abs_Lat_Velocity_STD_0 : 284|10@1+ (0.05,0) [0|50] "MPS"  ACM
 SG_ OBJ_Abs_Lat_Vel_STD_V_0 : 294|1@1+ (1,0) [0|1] "bool"  ACM
 SG_ OBJ_Abs_Long_Acc_0 : 295|9@1+ (0.05,-10.3) [-10.3|7.3] "MPS2"  ACM
 SG_ OBJ_Abs_Long_Acc_V_0 : 304|1@1+ (1,0) [0|1] "bool"  ACM
 SG_ OBJ_Abs_Long_Acc_STD_0 : 305|8@1+ (0.05,0) [0|7.3] "MPS2"  ACM
 SG_ OBJ_Abs_Long_Acc_STD_V_0 : 313|1@1+ (1,0) [0|1] "bool"  ACM
 SG_ OBJ_Abs_Lat_Acc_0 : 314|9@1+ (0.05,-10.3) [-10.3|7.3] "MPS2"  ACM
 SG_ OBJ_Abs_Lat_Acc_V_0 : 323|1@1+ (1,0) [0|1] "bool"  ACM
 SG_ OBJ_Abs_Lat_Acc_STD_0 : 324|8@1+ (0.05,0) [0|7.3] "MPS2"  ACM
 SG_ OBJ_Abs_Lat_Acc_STD_V_0 : 332|1@1+ (1,0) [0|1] "bool"  ACM
 SG_ OBJ_Abs_Acceleration_0 : 336|9@1+ (0.05,-10.3) [-10.3|7.3] "MPS2"  ACM
 SG_ OBJ_Abs_Acceleration_V_0 : 345|1@1+ (1,0) [0|1] "bool"  ACM
 SG_ OBJ_Abs_Acc_STD_0 : 346|8@1+ (0.05,0) [0|7.3] "MPS2"  ACM
 SG_ OBJ_Abs_Acc_STD_V_0 : 354|1@1+ (1,0) [0|1] "bool"  ACM
 SG_ OBJ_Inv_TTC_0 : 355|11@1+ (0.01,-8) [-8|8] "INV(s)"  ACM
 SG_ OBJ_Inv_TTC_V_0 : 366|1@1+ (1,0) [0|1] "bool"  ACM
 SG_ OBJ_Inv_TTC_STD_0 : 368|11@1+ (0.01,0) [0|4] "INV(s)"  ACM
 SG_ OBJ_Inv_TTC_STD_V_0 : 379|1@1+ (1,0) [0|1] "bool"  ACM
 SG_ OBJ_Relative_Long_Acc_0 : 380|9@1+ (0.05,-10.3) [-10.3|7.3] "MPS2"  ACM
 SG_ OBJ_Relative_Long_Acc_V_0 : 389|1@1+ (1,0) [0|1] "bool"  ACM
 SG_ OBJ_Relative_Long_Acc_STD_0 : 390|8@1+ (0.05,0) [0|7.3] "MPS2"  ACM
 SG_ OBJ_Rel_Long_Acc_STD_V_0 : 398|1@1+ (1,0) [0|1] "bool"  ACM

BO_ 144 ICM_Object_Prot_Header: 64 MyECU
 SG_ ICM_Object_Prot_Head_Header : 0|16@1+ (1,0) [0|65535] ""  ACM
 SG_ OBJ_Zero_byte : 16|8@1+ (1,0) [0|255] "NA"  ACM
 SG_ OBJ_Header_CRC : 48|32@1+ (1,0) [0|4294967295] "NA"  ACM
 SG_ OBJ_Protocol_Version : 80|8@1+ (1,0) [7|7] "counter"  ACM
 SG_ OBJ_Sync_ID : 88|8@1+ (1,0) [0|255] "counter"  ACM
 SG_ OBJ_VRU_Count : 96|5@1+ (1,0) [0|20] "counter"  ACM
 SG_ OBJ_VD_Count : 101|5@1+ (1,0) [0|20] "counter"  ACM
 SG_ OBJ_General_OBJ_Count : 106|4@1+ (1,0) [0|10] "counter"  ACM
 SG_ OBJ_Animal_Count : 112|4@1+ (1,0) [0|10] "counter"  ACM
 SG_ OBJ_VD_NIV_Left : 116|8@1+ (1,0) [0|255] "NA"  ACM
 SG_ OBJ_VD_NIV_Right : 124|8@1+ (1,0) [0|255] "NA"  ACM
 SG_ OBJ_VD_CIPV_ID : 132|8@1+ (1,0) [0|255] "counter"  ACM
 SG_ OBJ_VD_CIPV_Lost : 140|2@1+ (1,0) [0|2] "ENUM"  ACM
 SG_ OBJ_VD_Allow_Acc : 142|2@1+ (1,0) [0|2] "ENUM"  ACM
 SG_ OBJ_Is_Blocked_Left : 144|1@1+ (1,0) [0|1] "bool"  ACM
 SG_ OBJ_Is_Blocked_Right : 145|1@1+ (1,0) [0|1] "bool"  ACM
 SG_ OBJ_Header_Buffer : 146|30@1+ (1,0) [0|0] "NA"  ACM

BO_ 75 ICM_Safety_Diag_Prot: 64 MyECU
 SG_ ICM_Safety_Diag_Prot_CRC : 208|16@1+ (1,0) [0|65535] ""  ACM
 SG_ ICM_Safety_Diag_Prot_Header : 0|16@1+ (1,0) [0|65535] ""  ACM
 SG_ SD_Zero_byte : 16|8@1+ (1,0) [0|255] "NA"  ACM
 SG_ SD_CRC : 48|32@1+ (1,0) [0|4294967295] "NA"  ACM
 SG_ SD_Protocol_Version : 80|8@1+ (1,0) [2|2] "counter"  ACM
 SG_ SD_Sync_ID : 88|8@1+ (1,0) [0|255] "counter"  ACM
 SG_ SD_Bit_0 : 96|1@1+ (1,0) [0|1] "bool"  ACM
 SG_ SD_Bit_1 : 97|1@1+ (1,0) [0|1] "bool"  ACM
 SG_ SD_Bit_2 : 98|1@1+ (1,0) [0|1] "bool"  ACM
 SG_ SD_Bit_3 : 99|1@1+ (1,0) [0|1] "bool"  ACM
 SG_ SD_Bit_4 : 100|1@1+ (1,0) [0|1] "bool"  ACM
 SG_ SD_Bit_5 : 101|1@1+ (1,0) [0|1] "bool"  ACM
 SG_ SD_Bit_6 : 102|1@1+ (1,0) [0|1] "bool"  ACM
 SG_ SD_Bit_7 : 103|1@1+ (1,0) [0|1] "bool"  ACM
 SG_ SD_Bit_8 : 104|1@1+ (1,0) [0|1] "bool"  ACM
 SG_ SD_Bit_9 : 105|1@1+ (1,0) [0|1] "bool"  ACM
 SG_ SD_Bit_10 : 106|1@1+ (1,0) [0|1] "bool"  ACM
 SG_ SD_Bit_11 : 107|1@1+ (1,0) [0|1] "bool"  ACM
 SG_ SD_Bit_12 : 108|1@1+ (1,0) [0|1] "bool"  ACM
 SG_ SD_Bit_13 : 109|1@1+ (1,0) [0|1] "bool"  ACM
 SG_ SD_Bit_14 : 110|1@1+ (1,0) [0|1] "bool"  ACM
 SG_ SD_Bit_15 : 111|1@1+ (1,0) [0|1] "bool"  ACM
 SG_ SD_Bit_16 : 112|1@1+ (1,0) [0|1] "bool"  ACM
 SG_ SD_Bit_17 : 113|1@1+ (1,0) [0|1] "bool"  ACM
 SG_ SD_Bit_18 : 114|1@1+ (1,0) [0|1] "bool"  ACM
 SG_ SD_Bit_19 : 115|1@1+ (1,0) [0|1] "bool"  ACM
 SG_ SD_Bit_20 : 116|1@1+ (1,0) [0|1] "bool"  ACM
 SG_ SD_Bit_21 : 117|1@1+ (1,0) [0|1] "bool"  ACM
 SG_ SD_Bit_22 : 118|1@1+ (1,0) [0|1] "bool"  ACM
 SG_ SD_Bit_23 : 119|1@1+ (1,0) [0|1] "bool"  ACM
 SG_ SD_Bit_24 : 120|1@1+ (1,0) [0|1] "bool"  ACM
 SG_ SD_Bit_25 : 121|1@1+ (1,0) [0|1] "bool"  ACM
 SG_ SD_Bit_26 : 122|1@1+ (1,0) [0|1] "bool"  ACM
 SG_ SD_Bit_27 : 123|1@1+ (1,0) [0|1] "bool"  ACM
 SG_ SD_Bit_28 : 124|1@1+ (1,0) [0|1] "bool"  ACM
 SG_ SD_Bit_29 : 125|1@1+ (1,0) [0|1] "bool"  ACM
 SG_ SD_Bit_30 : 126|1@1+ (1,0) [0|1] "bool"  ACM
 SG_ SD_Bit_31 : 127|1@1+ (1,0) [0|1] "bool"  ACM
 SG_ SD_Bit_32 : 128|1@1+ (1,0) [0|1] "bool"  ACM
 SG_ SD_Bit_33 : 129|1@1+ (1,0) [0|1] "bool"  ACM
 SG_ SD_Bit_34 : 130|1@1+ (1,0) [0|1] "bool"  ACM
 SG_ SD_Bit_35 : 131|1@1+ (1,0) [0|1] "bool"  ACM
 SG_ SD_Bit_36 : 132|1@1+ (1,0) [0|1] "bool"  ACM
 SG_ SD_Bit_37 : 133|1@1+ (1,0) [0|1] "bool"  ACM
 SG_ SD_Bit_38 : 134|1@1+ (1,0) [0|1] "bool"  ACM
 SG_ SD_Bit_39 : 135|1@1+ (1,0) [0|1] "bool"  ACM
 SG_ SD_Bit_40 : 136|1@1+ (1,0) [0|1] "bool"  ACM
 SG_ SD_Bit_41 : 137|1@1+ (1,0) [0|1] "bool"  ACM
 SG_ SD_Bit_42 : 138|1@1+ (1,0) [0|1] "bool"  ACM
 SG_ SD_Bit_43 : 139|1@1+ (1,0) [0|1] "bool"  ACM
 SG_ SD_Bit_44 : 140|1@1+ (1,0) [0|1] "bool"  ACM
 SG_ SD_Bit_45 : 141|1@1+ (1,0) [0|1] "bool"  ACM
 SG_ SD_Bit_46 : 142|1@1+ (1,0) [0|1] "bool"  ACM
 SG_ SD_Bit_47 : 143|1@1+ (1,0) [0|1] "bool"  ACM
 SG_ SD_Bit_48 : 144|1@1+ (1,0) [0|1] "bool"  ACM
 SG_ SD_Bit_49 : 145|1@1+ (1,0) [0|1] "bool"  ACM
 SG_ SD_Bit_50 : 146|1@1+ (1,0) [0|1] "bool"  ACM
 SG_ SD_Bit_51 : 147|1@1+ (1,0) [0|1] "bool"  ACM
 SG_ SD_Bit_52 : 148|1@1+ (1,0) [0|1] "bool"  ACM
 SG_ SD_Bit_53 : 149|1@1+ (1,0) [0|1] "bool"  ACM
 SG_ SD_Bit_54 : 150|1@1+ (1,0) [0|1] "bool"  ACM
 SG_ SD_Bit_55 : 151|1@1+ (1,0) [0|1] "bool"  ACM
 SG_ SD_Bit_56 : 152|1@1+ (1,0) [0|1] "bool"  ACM
 SG_ SD_Bit_57 : 153|1@1+ (1,0) [0|1] "bool"  ACM
 SG_ SD_Bit_58 : 154|1@1+ (1,0) [0|1] "bool"  ACM
 SG_ SD_Bit_59 : 155|1@1+ (1,0) [0|1] "bool"  ACM
 SG_ SD_Bit_60 : 156|1@1+ (1,0) [0|1] "bool"  ACM
 SG_ SD_Bit_61 : 157|1@1+ (1,0) [0|1] "bool"  ACM
 SG_ SD_Bit_62 : 158|1@1+ (1,0) [0|1] "bool"  ACM
 SG_ SD_Bit_63 : 159|1@1+ (1,0) [0|1] "bool"  ACM
 SG_ SD_Challenge_Response1 : 160|8@1+ (1,0) [0|255] "counter"  ACM
 SG_ SD_Challenge_Response2 : 168|8@1+ (1,0) [0|255] "counter"  ACM
 SG_ SD_Challenge_Response3 : 176|8@1+ (1,0) [0|255] "counter"  ACM
 SG_ SD_Challenge_Response4 : 184|8@1+ (1,0) [0|255] "counter"  ACM
 SG_ SD_Challenge_Identifier : 192|8@1+ (1,0) [0|255] "counter"  ACM

BO_ 111 ICM_Lanes_Road_Edge_Prot_C: 64 MyECU
 SG_ LRE_Is_Triggered_SDM_Model_3 : 116|2@1- (1,0) [0|0] ""  ACM
 SG_ ICM_La_Ro_Ed_Prot_C_CRC : 274|16@1+ (1,0) [0|65535] ""  ACM
 SG_ ICM_La_Ro_Ed_Prot_C_Header : 0|16@1+ (1,0) [0|65535] ""  ACM
 SG_ LRE_ID_3 : 16|8@1+ (1,0) [0|255] "counter"  ACM
 SG_ LRE_Age_3 : 24|8@1+ (1,0) [0|255] "frames"  ACM
 SG_ LRE_Exist_Prob_3 : 32|7@1+ (0.01,0) [0|1] "NA"  ACM
 SG_ LRE_Type_3 : 39|4@1+ (1,0) [0|5] "ENUM"  ACM
 SG_ LRE_Prediction_Type_3 : 43|5@1+ (1,0) [0|31] "BITWIZE"  ACM
 SG_ LRE_Height_3 : 48|8@1+ (1,0) [0|0] "NA"  ACM
 SG_ LRE_Height_STD_3 : 56|8@1+ (1,0) [0|0] "NA"  ACM
 SG_ LRE_View_Range_Start_3 : 64|15@1+ (0.01,0) [0|200] "m"  ACM
 SG_ LRE_View_Range_End_3 : 80|15@1+ (0.01,0) [0|200] "m"  ACM
 SG_ LRE_Measured_VR_End_3 : 95|15@1+ (0.01,0) [0|200] "m"  ACM
 SG_ LRE_Side_3 : 112|2@1+ (1,0) [0|2] "ENUM"  ACM
 SG_ LRE_Index_3 : 114|2@1+ (1,0) [0|3] "ENUM"  ACM
 SG_ LRE_Line_C3_3 : 146|32@1+ (1E-005,-0.004) [0|800] "INV(m2)"  ACM
 SG_ LRE_Line_C2_3 : 178|32@1+ (0.0001,-0.125) [0|2500] "INV(m)"  ACM
 SG_ LRE_Line_C1_3 : 210|32@1+ (0.0001,-2) [0|40000] "rad"  ACM
 SG_ LRE_Line_C0_3 : 242|32@1+ (0.0001,-30) [0|600000] "m"  ACM

BO_ 110 ICM_Lanes_Road_Edge_Prot_B: 64 MyECU
 SG_ LRE_Is_Triggered_SDM_Model_2 : 116|2@1- (1,0) [0|0] ""  ACM
 SG_ ICM_La_Ro_Ed_Prot_B_Header : 0|16@1+ (1,0) [0|65535] ""  ACM
 SG_ LRE_ID_2 : 16|8@1+ (1,0) [0|255] "counter"  ACM
 SG_ LRE_Age_2 : 24|8@1+ (1,0) [0|255] "frames"  ACM
 SG_ LRE_Exist_Prob_2 : 32|7@1+ (0.01,0) [0|1] "NA"  ACM
 SG_ LRE_Type_2 : 39|4@1+ (1,0) [0|5] "ENUM"  ACM
 SG_ LRE_Prediction_Type_2 : 43|5@1+ (1,0) [0|31] "BITWIZE"  ACM
 SG_ LRE_Height_2 : 48|8@1+ (1,0) [0|0] "NA"  ACM
 SG_ LRE_Height_STD_2 : 56|8@1+ (1,0) [0|0] "NA"  ACM
 SG_ LRE_View_Range_Start_2 : 64|15@1+ (0.01,0) [0|200] "m"  ACM
 SG_ LRE_View_Range_End_2 : 80|15@1+ (0.01,0) [0|200] "m"  ACM
 SG_ LRE_Measured_VR_End_2 : 95|15@1+ (0.01,0) [0|200] "m"  ACM
 SG_ LRE_Side_2 : 112|2@1+ (1,0) [0|2] "ENUM"  ACM
 SG_ LRE_Index_2 : 114|2@1+ (1,0) [0|3] "ENUM"  ACM
 SG_ LRE_Line_C3_2 : 146|32@1+ (1E-005,-0.004) [0|800] "INV(m2)"  ACM
 SG_ LRE_Line_C2_2 : 178|32@1+ (0.0001,-0.125) [0|2500] "INV(m)"  ACM
 SG_ LRE_Line_C1_2 : 210|32@1+ (0.0001,-2) [0|40000] "rad"  ACM
 SG_ LRE_Line_C0_2 : 242|32@1+ (0.0001,-30) [0|600000] "m"  ACM

BO_ 109 ICM_Lanes_Road_Edge_Prot_A: 64 MyECU
 SG_ LRE_Is_Triggered_SDM_Model_1 : 116|2@1- (1,0) [0|0] ""  ACM
 SG_ ICM_La_Ro_Ed_Prot_A_Header : 0|16@1+ (1,0) [0|65535] ""  ACM
 SG_ LRE_ID_1 : 16|8@1+ (1,0) [0|255] "counter"  ACM
 SG_ LRE_Age_1 : 24|8@1+ (1,0) [0|255] "frames"  ACM
 SG_ LRE_Exist_Prob_1 : 32|7@1+ (0.01,0) [0|1] "NA"  ACM
 SG_ LRE_Type_1 : 39|4@1+ (1,0) [0|5] "ENUM"  ACM
 SG_ LRE_Prediction_Type_1 : 43|5@1+ (1,0) [0|31] "BITWIZE"  ACM
 SG_ LRE_Height_1 : 48|8@1+ (1,0) [0|0] "NA"  ACM
 SG_ LRE_Height_STD_1 : 56|8@1+ (1,0) [0|0] "NA"  ACM
 SG_ LRE_View_Range_Start_1 : 64|15@1+ (0.01,0) [0|200] "m"  ACM
 SG_ LRE_View_Range_End_1 : 80|15@1+ (0.01,0) [0|200] "m"  ACM
 SG_ LRE_Measured_VR_End_1 : 95|15@1+ (0.01,0) [0|200] "m"  ACM
 SG_ LRE_Side_1 : 112|2@1+ (1,0) [0|2] "ENUM"  ACM
 SG_ LRE_Index_1 : 114|2@1+ (1,0) [0|3] "ENUM"  ACM
 SG_ LRE_Line_C3_1 : 146|32@1+ (1E-005,-0.004) [0|800] "INV(m2)"  ACM
 SG_ LRE_Line_C2_1 : 178|32@1+ (0.0001,-0.125) [0|2500] "INV(m)"  ACM
 SG_ LRE_Line_C1_1 : 210|32@1+ (0.0001,-2) [0|40000] "rad"  ACM
 SG_ LRE_Line_C0_1 : 242|32@1+ (0.0001,-30) [0|600000] "m"  ACM

BO_ 108 ICM_Lanes_Road_Edge_Prot_Header: 64 MyECU
 SG_ LRE_Is_Triggered_SDM_Model_0 : 212|2@1- (1,0) [0|0] ""  ACM
 SG_ LRE_Count : 96|3@1- (1,0) [0|0] ""  ACM
 SG_ ICM_La_Ro_Ed_Prot_Head_Header : 0|16@1+ (1,0) [0|65535] ""  ACM
 SG_ LRE_Zero_byte : 16|8@1+ (1,0) [0|255] "NA"  ACM
 SG_ LRE_CRC : 48|32@1+ (1,0) [0|4294967295] "NA"  ACM
 SG_ LRE_Protocol_Version : 80|8@1+ (1,0) [6|6] "counter"  ACM
 SG_ LRE_Sync_ID : 88|8@1+ (1,0) [0|255] "counter"  ACM
 SG_ LRE_Header_Buffer : 99|13@1+ (1,0) [0|0] "NA"  ACM
 SG_ LRE_ID_0 : 112|8@1+ (1,0) [0|255] "counter"  ACM
 SG_ LRE_Age_0 : 120|8@1+ (1,0) [0|255] "frames"  ACM
 SG_ LRE_Exist_Prob_0 : 128|7@1+ (0.01,0) [0|1] "NA"  ACM
 SG_ LRE_Type_0 : 135|4@1+ (1,0) [0|5] "ENUM"  ACM
 SG_ LRE_Prediction_Type_0 : 139|5@1+ (1,0) [0|31] "BITWIZE"  ACM
 SG_ LRE_Height_0 : 144|8@1+ (1,0) [0|0] "NA"  ACM
 SG_ LRE_Height_STD_0 : 152|8@1+ (1,0) [0|0] "NA"  ACM
 SG_ LRE_View_Range_Start_0 : 160|15@1+ (0.01,0) [0|200] "m"  ACM
 SG_ LRE_View_Range_End_0 : 176|15@1+ (0.01,0) [0|200] "m"  ACM
 SG_ LRE_Measured_VR_End_0 : 191|15@1+ (0.01,0) [0|200] "m"  ACM
 SG_ LRE_Side_0 : 208|2@1+ (1,0) [0|2] "ENUM"  ACM
 SG_ LRE_Index_0 : 210|2@1+ (1,0) [0|3] "ENUM"  ACM
 SG_ LRE_Line_C3_0 : 242|32@1+ (1E-005,-0.004) [0|800] "INV(m2)"  ACM
 SG_ LRE_Line_C2_0 : 274|32@1+ (0.0001,-0.125) [0|2500] "INV(m)"  ACM
 SG_ LRE_Line_C1_0 : 306|32@1+ (0.0001,-2) [0|40000] "rad"  ACM
 SG_ LRE_Line_C0_0 : 338|32@1+ (0.0001,-30) [0|600000] "m"  ACM

BO_ 105 ICM_Lanes_Host_Prot_Header: 64 MyECU
 SG_ LH_Snow_On_Road_Prob : 57|7@1- (1,0) [0|0] ""  ACM
 SG_ ICM_La_Host_Prot_Head_Header : 0|16@1+ (1,0) [0|65535] ""  ACM
 SG_ LH_Zero_byte : 16|8@1+ (1,0) [0|255] "NA"  ACM
 SG_ LH_Protocol_Version : 24|8@1+ (1,0) [1|1] "counter"  ACM
 SG_ LH_Sync_ID : 32|8@1+ (1,0) [0|255] "counter"  ACM
 SG_ LH_Lanes_Count : 40|3@1+ (1,0) [0|4] "counter"  ACM
 SG_ LH_Estimated_Width : 48|9@1+ (0.01,0) [0|4] "m"  ACM
 SG_ LH_Header_Buffer : 64|16@1+ (1,0) [0|65535] "NA"  ACM

BO_ 104 ICM_Lanes_App_Prot_C: 64 MyECU
 SG_ ICM_La_App_Prot_C_CRC : 336|16@1+ (1,0) [0|65535] ""  ACM
 SG_ ICM_La_App_Prot_C_Header : 0|16@1+ (1,0) [0|65535] ""  ACM
 SG_ LAP_INTP_ID_7 : 16|8@1+ (1,0) [0|255] "counter"  ACM
 SG_ LAP_INTP_Age_7 : 24|12@1+ (0.1,0) [0|250] "Frame"  ACM
 SG_ LAP_INTP_Exist_Probability_7 : 36|7@1+ (0.01,0) [0|1] "NA"  ACM
 SG_ LAP_INTP_Is_Valid_7 : 43|1@1+ (1,0) [0|1] "bool"  ACM
 SG_ LAP_INTP_Line_Role_7 : 44|4@1+ (1,0) [0|15] "ENUM"  ACM
 SG_ LAP_INTP_Type_7 : 48|1@1+ (1,0) [0|1] "ENUM"  ACM
 SG_ LAP_INTP_Is_Start_7 : 49|1@1+ (1,0) [0|1] "bool"  ACM
 SG_ LAP_INTP_Lat_Distance_7 : 50|14@1+ (0.01,-50) [-50|50] "m"  ACM
 SG_ LAP_INTP_Long_Distance_7 : 64|15@1+ (0.01,0) [0|200] "m"  ACM
 SG_ LAP_INTP_Buffer_7 : 79|1@1+ (1,0) [0|0] "NA"  ACM
 SG_ LAP_INTP_ID_8 : 80|8@1+ (1,0) [0|255] "counter"  ACM
 SG_ LAP_INTP_Age_8 : 88|12@1+ (0.1,0) [0|250] "Frame"  ACM
 SG_ LAP_INTP_Exist_Probability_8 : 100|7@1+ (0.01,0) [0|1] "NA"  ACM
 SG_ LAP_INTP_Is_Valid_8 : 107|1@1+ (1,0) [0|1] "bool"  ACM
 SG_ LAP_INTP_Line_Role_8 : 108|4@1+ (1,0) [0|15] "ENUM"  ACM
 SG_ LAP_INTP_Type_8 : 112|1@1+ (1,0) [0|1] "ENUM"  ACM
 SG_ LAP_INTP_Is_Start_8 : 113|1@1+ (1,0) [0|1] "bool"  ACM
 SG_ LAP_INTP_Lat_Distance_8 : 114|14@1+ (0.01,-50) [-50|50] "m"  ACM
 SG_ LAP_INTP_Long_Distance_8 : 128|15@1+ (0.01,0) [0|200] "m"  ACM
 SG_ LAP_INTP_Buffer_8 : 143|1@1+ (1,0) [0|0] "NA"  ACM
 SG_ LAP_INTP_ID_9 : 144|8@1+ (1,0) [0|255] "counter"  ACM
 SG_ LAP_INTP_Age_9 : 152|12@1+ (0.1,0) [0|250] "Frame"  ACM
 SG_ LAP_INTP_Exist_Probability_9 : 164|7@1+ (0.01,0) [0|1] "NA"  ACM
 SG_ LAP_INTP_Is_Valid_9 : 171|1@1+ (1,0) [0|1] "bool"  ACM
 SG_ LAP_INTP_Line_Role_9 : 172|4@1+ (1,0) [0|15] "ENUM"  ACM
 SG_ LAP_INTP_Type_9 : 176|1@1+ (1,0) [0|1] "ENUM"  ACM
 SG_ LAP_INTP_Is_Start_9 : 177|1@1+ (1,0) [0|1] "bool"  ACM
 SG_ LAP_INTP_Lat_Distance_9 : 178|14@1+ (0.01,-50) [-50|50] "m"  ACM
 SG_ LAP_INTP_Long_Distance_9 : 192|15@1+ (0.01,0) [0|200] "m"  ACM
 SG_ LAP_INTP_Buffer_9 : 207|1@1+ (1,0) [0|0] "NA"  ACM
 SG_ LAP_INTP_ID_10 : 208|8@1+ (1,0) [0|255] "counter"  ACM
 SG_ LAP_INTP_Age_10 : 216|12@1+ (0.1,0) [0|250] "Frame"  ACM
 SG_ LAP_INTP_Exist_Probability_10 : 228|7@1+ (0.01,0) [0|1] "NA"  ACM
 SG_ LAP_INTP_Is_Valid_10 : 235|1@1+ (1,0) [0|1] "bool"  ACM
 SG_ LAP_INTP_Line_Role_10 : 236|4@1+ (1,0) [0|15] "ENUM"  ACM
 SG_ LAP_INTP_Type_10 : 240|1@1+ (1,0) [0|1] "ENUM"  ACM
 SG_ LAP_INTP_Is_Start_10 : 241|1@1+ (1,0) [0|1] "bool"  ACM
 SG_ LAP_INTP_Lat_Distance_10 : 242|14@1+ (0.01,-50) [-50|50] "m"  ACM
 SG_ LAP_INTP_Long_Distance_10 : 256|15@1+ (0.01,0) [0|200] "m"  ACM
 SG_ LAP_INTP_Buffer_10 : 271|1@1+ (1,0) [0|0] "NA"  ACM
 SG_ LAP_INTP_ID_11 : 272|8@1+ (1,0) [0|255] "counter"  ACM
 SG_ LAP_INTP_Age_11 : 280|12@1+ (0.1,0) [0|250] "Frame"  ACM
 SG_ LAP_INTP_Exist_Probability_11 : 292|7@1+ (0.01,0) [0|1] "NA"  ACM
 SG_ LAP_INTP_Is_Valid_11 : 299|1@1+ (1,0) [0|1] "bool"  ACM
 SG_ LAP_INTP_Line_Role_11 : 300|4@1+ (1,0) [0|15] "ENUM"  ACM
 SG_ LAP_INTP_Type_11 : 304|1@1+ (1,0) [0|1] "ENUM"  ACM
 SG_ LAP_INTP_Is_Start_11 : 305|1@1+ (1,0) [0|1] "bool"  ACM
 SG_ LAP_INTP_Lat_Distance_11 : 306|14@1+ (0.01,-50) [-50|50] "m"  ACM
 SG_ LAP_INTP_Long_Distance_11 : 320|15@1+ (0.01,0) [0|200] "m"  ACM
 SG_ LAP_INTP_Buffer_11 : 335|1@1+ (1,0) [0|0] "NA"  ACM

BO_ 103 ICM_Lanes_App_Prot_B: 64 MyECU
 SG_ ICM_La_App_Prot_B_Header : 0|16@1+ (1,0) [0|65535] ""  ACM
 SG_ LAP_INTP_ID_0 : 16|8@1+ (1,0) [0|255] "counter"  ACM
 SG_ LAP_INTP_Age_0 : 24|12@1+ (0.1,0) [0|250] "Frame"  ACM
 SG_ LAP_INTP_Exist_Probability_0 : 36|7@1+ (0.01,0) [0|1] "NA"  ACM
 SG_ LAP_INTP_Is_Valid_0 : 43|1@1+ (1,0) [0|1] "bool"  ACM
 SG_ LAP_INTP_Line_Role_0 : 44|4@1+ (1,0) [0|15] "ENUM"  ACM
 SG_ LAP_INTP_Type_0 : 48|1@1+ (1,0) [0|1] "ENUM"  ACM
 SG_ LAP_INTP_Is_Start_0 : 49|1@1+ (1,0) [0|1] "bool"  ACM
 SG_ LAP_INTP_Lat_Distance_0 : 50|14@1+ (0.01,-50) [-50|50] "m"  ACM
 SG_ LAP_INTP_Long_Distance_0 : 64|15@1+ (0.01,0) [0|200] "m"  ACM
 SG_ LAP_INTP_Buffer_0 : 79|1@1+ (1,0) [0|0] "NA"  ACM
 SG_ LAP_INTP_ID_1 : 80|8@1+ (1,0) [0|255] "counter"  ACM
 SG_ LAP_INTP_Age_1 : 88|12@1+ (0.1,0) [0|250] "Frame"  ACM
 SG_ LAP_INTP_Exist_Probability_1 : 100|7@1+ (0.01,0) [0|1] "NA"  ACM
 SG_ LAP_INTP_Is_Valid_1 : 107|1@1+ (1,0) [0|1] "bool"  ACM
 SG_ LAP_INTP_Line_Role_1 : 108|4@1+ (1,0) [0|15] "ENUM"  ACM
 SG_ LAP_INTP_Type_1 : 112|1@1+ (1,0) [0|1] "ENUM"  ACM
 SG_ LAP_INTP_Is_Start_1 : 113|1@1+ (1,0) [0|1] "bool"  ACM
 SG_ LAP_INTP_Lat_Distance_1 : 114|14@1+ (0.01,-50) [-50|50] "m"  ACM
 SG_ LAP_INTP_Long_Distance_1 : 128|15@1+ (0.01,0) [0|200] "m"  ACM
 SG_ LAP_INTP_Buffer_1 : 143|1@1+ (1,0) [0|0] "NA"  ACM
 SG_ LAP_INTP_ID_2 : 144|8@1+ (1,0) [0|255] "counter"  ACM
 SG_ LAP_INTP_Age_2 : 152|12@1+ (0.1,0) [0|250] "Frame"  ACM
 SG_ LAP_INTP_Exist_Probability_2 : 164|7@1+ (0.01,0) [0|1] "NA"  ACM
 SG_ LAP_INTP_Is_Valid_2 : 171|1@1+ (1,0) [0|1] "bool"  ACM
 SG_ LAP_INTP_Line_Role_2 : 172|4@1+ (1,0) [0|15] "ENUM"  ACM
 SG_ LAP_INTP_Type_2 : 176|1@1+ (1,0) [0|1] "ENUM"  ACM
 SG_ LAP_INTP_Is_Start_2 : 177|1@1+ (1,0) [0|1] "bool"  ACM
 SG_ LAP_INTP_Lat_Distance_2 : 178|14@1+ (0.01,-50) [-50|50] "m"  ACM
 SG_ LAP_INTP_Long_Distance_2 : 192|15@1+ (0.01,0) [0|200] "m"  ACM
 SG_ LAP_INTP_Buffer_2 : 207|1@1+ (1,0) [0|0] "NA"  ACM
 SG_ LAP_INTP_ID_3 : 208|8@1+ (1,0) [0|255] "counter"  ACM
 SG_ LAP_INTP_Age_3 : 216|12@1+ (0.1,0) [0|250] "Frame"  ACM
 SG_ LAP_INTP_Exist_Probability_3 : 228|7@1+ (0.01,0) [0|1] "NA"  ACM
 SG_ LAP_INTP_Is_Valid_3 : 235|1@1+ (1,0) [0|1] "bool"  ACM
 SG_ LAP_INTP_Line_Role_3 : 236|4@1+ (1,0) [0|15] "ENUM"  ACM
 SG_ LAP_INTP_Type_3 : 240|1@1+ (1,0) [0|1] "ENUM"  ACM
 SG_ LAP_INTP_Is_Start_3 : 241|1@1+ (1,0) [0|1] "bool"  ACM
 SG_ LAP_INTP_Lat_Distance_3 : 242|14@1+ (0.01,-50) [-50|50] "m"  ACM
 SG_ LAP_INTP_Long_Distance_3 : 256|15@1+ (0.01,0) [0|200] "m"  ACM
 SG_ LAP_INTP_Buffer_3 : 271|1@1+ (1,0) [0|0] "NA"  ACM
 SG_ LAP_INTP_ID_4 : 272|8@1+ (1,0) [0|255] "counter"  ACM
 SG_ LAP_INTP_Age_4 : 280|12@1+ (0.1,0) [0|250] "Frame"  ACM
 SG_ LAP_INTP_Exist_Probability_4 : 292|7@1+ (0.01,0) [0|1] "NA"  ACM
 SG_ LAP_INTP_Is_Valid_4 : 299|1@1+ (1,0) [0|1] "bool"  ACM
 SG_ LAP_INTP_Line_Role_4 : 300|4@1+ (1,0) [0|15] "ENUM"  ACM
 SG_ LAP_INTP_Type_4 : 304|1@1+ (1,0) [0|1] "ENUM"  ACM
 SG_ LAP_INTP_Is_Start_4 : 305|1@1+ (1,0) [0|1] "bool"  ACM
 SG_ LAP_INTP_Lat_Distance_4 : 306|14@1+ (0.01,-50) [-50|50] "m"  ACM
 SG_ LAP_INTP_Long_Distance_4 : 320|15@1+ (0.01,0) [0|200] "m"  ACM
 SG_ LAP_INTP_Buffer_4 : 335|1@1+ (1,0) [0|0] "NA"  ACM
 SG_ LAP_INTP_ID_5 : 336|8@1+ (1,0) [0|255] "counter"  ACM
 SG_ LAP_INTP_Age_5 : 344|12@1+ (0.1,0) [0|250] "Frame"  ACM
 SG_ LAP_INTP_Exist_Probability_5 : 356|7@1+ (0.01,0) [0|1] "NA"  ACM
 SG_ LAP_INTP_Is_Valid_5 : 363|1@1+ (1,0) [0|1] "bool"  ACM
 SG_ LAP_INTP_Line_Role_5 : 364|4@1+ (1,0) [0|15] "ENUM"  ACM
 SG_ LAP_INTP_Type_5 : 368|1@1+ (1,0) [0|1] "ENUM"  ACM
 SG_ LAP_INTP_Is_Start_5 : 369|1@1+ (1,0) [0|1] "bool"  ACM
 SG_ LAP_INTP_Lat_Distance_5 : 370|14@1+ (0.01,-50) [-50|50] "m"  ACM
 SG_ LAP_INTP_Long_Distance_5 : 384|15@1+ (0.01,0) [0|200] "m"  ACM
 SG_ LAP_INTP_Buffer_5 : 399|1@1+ (1,0) [0|0] "NA"  ACM
 SG_ LAP_INTP_ID_6 : 400|8@1+ (1,0) [0|255] "counter"  ACM
 SG_ LAP_INTP_Age_6 : 408|12@1+ (0.1,0) [0|250] "Frame"  ACM
 SG_ LAP_INTP_Exist_Probability_6 : 420|7@1+ (0.01,0) [0|1] "NA"  ACM
 SG_ LAP_INTP_Is_Valid_6 : 427|1@1+ (1,0) [0|1] "bool"  ACM
 SG_ LAP_INTP_Line_Role_6 : 428|4@1+ (1,0) [0|15] "ENUM"  ACM
 SG_ LAP_INTP_Type_6 : 432|1@1+ (1,0) [0|1] "ENUM"  ACM
 SG_ LAP_INTP_Is_Start_6 : 433|1@1+ (1,0) [0|1] "bool"  ACM
 SG_ LAP_INTP_Lat_Distance_6 : 434|14@1+ (0.01,-50) [-50|50] "m"  ACM
 SG_ LAP_INTP_Long_Distance_6 : 448|15@1+ (0.01,0) [0|200] "m"  ACM
 SG_ LAP_INTP_Buffer_6 : 463|1@1+ (1,0) [0|0] "NA"  ACM

BO_ 102 ICM_Lanes_App_Prot_A: 64 MyECU
 SG_ LAP_Is_Triggered_SDM_Model : 195|2@1- (1,0) [0|0] ""  ACM
 SG_ ICM_La_App_Prot_A_Header : 0|16@1+ (1,0) [0|65535] ""  ACM
 SG_ LAP_ADV_Zero_byte : 16|8@1+ (1,0) [0|255] "NA"  ACM
 SG_ LAP_ADV_Protocol_Version : 24|8@1+ (1,0) [1|1] "counter"  ACM
 SG_ LAP_ADV_Sync_ID : 32|8@1+ (1,0) [0|255] "counter"  ACM
 SG_ LAP_Is_Construction_Area : 40|1@1+ (1,0) [0|1] "bool"  ACM
 SG_ LAP_INTP_Available : 41|1@1+ (1,0) [0|1] "bool"  ACM
 SG_ LAP_INTP_Count : 42|4@1+ (1,0) [0|8] "counter"  ACM
 SG_ LAP_Exit_Merge_Available : 46|1@1+ (1,0) [0|1] "bool"  ACM
 SG_ LAP_Is_Highway_Merge_Left : 47|1@1+ (1,0) [0|1] "bool"  ACM
 SG_ LAP_Is_Highway_Merge_Right : 48|1@1+ (1,0) [0|1] "bool"  ACM
 SG_ LAP_Is_Highway_Exit_Left : 49|1@1+ (1,0) [0|1] "bool"  ACM
 SG_ LAP_Is_Highway_Exit_Right : 50|1@1+ (1,0) [0|1] "bool"  ACM
 SG_ LAP_Vertical_Surface_Available : 51|1@1+ (1,0) [0|1] "bool"  ACM
 SG_ LAP_Vertical_Surface_C0 : 52|11@1+ (0.01,-10) [-10|10] "meter"  ACM
 SG_ LAP_Vertical_Surface_C1 : 63|11@1+ (0.000977,-0.785) [-0.785|0.785] "rad"  ACM
 SG_ LAP_Vertical_Surface_C2 : 80|16@1+ (1E-006,-0.03) [-0.03|0.03] "INV(m)"  ACM
 SG_ LAP_Vertical_Surface_C3 : 112|17@1+ (1E-008,-0.0004) [-0.0004|0.0004] "INV(m2)"  ACM
 SG_ LAP_Vertical_Surface_VR_End : 129|15@1+ (0.01,0) [0|200] "m"  ACM
 SG_ LAP_Path_Pred_CRC : 144|32@1+ (1,0) [0|4294967295] "NA"  ACM
 SG_ LAP_Path_Pred_Available : 176|1@1+ (1,0) [0|1] "bool"  ACM
 SG_ LAP_Path_Pred_First_Valid : 177|1@1+ (1,0) [0|1] "bool"  ACM
 SG_ LAP_Path_Pred_Second_Valid : 178|1@1+ (1,0) [0|1] "bool"  ACM
 SG_ LAP_Path_Pred_Half_Width : 179|9@1+ (0.01,0) [0|3] "m"  ACM
 SG_ LAP_Path_Pred_Conf : 188|7@1+ (0.01,0) [0|1] "NA"  ACM
 SG_ LAP_Path_Pred_First_VR_End : 208|15@1+ (0.01,0) [0|200] "m"  ACM
 SG_ LAP_Path_Pred_Second_VR_End : 223|15@1+ (0.01,0) [0|200] "m"  ACM
 SG_ LAP_Path_Pred_First_C0 : 240|32@1+ (0.001,-30) [-30|30] "m"  ACM
 SG_ LAP_Path_Pred_First_C1 : 272|32@1+ (0.0001,-2) [-2|2] "rad"  ACM
 SG_ LAP_Path_Pred_First_C2 : 304|32@1+ (1E-006,-0.125) [-0.125|0.125] "INV(m)"  ACM
 SG_ LAP_Path_Pred_First_C3 : 336|32@1+ (1E-008,-0.004) [-0.004|0.004] "INV(m2)"  ACM
 SG_ LAP_Path_Pred_Second_C0 : 368|32@1+ (0.001,-30) [-30|30] "m"  ACM
 SG_ LAP_Path_Pred_Second_C1 : 400|32@1+ (0.0001,-2) [-2|2] "rad"  ACM
 SG_ LAP_Path_Pred_Second_C2 : 432|32@1+ (1E-006,-0.125) [-0.125|0.125] "INV(m)"  ACM
 SG_ LAP_Path_Pred_Second_C3 : 464|32@1+ (1E-008,-0.004) [-0.004|0.004] "INV(m2)"  ACM

BO_ 101 ICM_LDW_Prot: 64 MyECU
 SG_ LDW_Time_To_Host_Right : 56|8@1- (1,0) [-128|127] ""  ACM
 SG_ LDW_Time_To_Host_Left : 48|8@1- (1,0) [-128|127] ""  ACM
 SG_ ICM_LDW_Prot_CRC : 208|16@1+ (1,0) [0|65535] ""  ACM
 SG_ ICM_LDW_Prot_Header : 0|16@1+ (1,0) [0|65535] ""  ACM
 SG_ LDW_Zero_byte : 16|8@1+ (1,0) [0|255] "NA"  ACM
 SG_ LDW_Protocol_Version : 24|8@1+ (1,0) [3|3] "counter"  ACM
 SG_ LDW_Sync_ID : 32|8@1+ (1,0) [0|255] "counter"  ACM
 SG_ LDW_Line_Valid_Left : 40|1@1+ (1,0) [0|1] "bool"  ACM
 SG_ LDW_Line_Valid_Right : 41|1@1+ (1,0) [0|1] "bool"  ACM
 SG_ LDW_Header_Buffer : 64|16@1+ (1,0) [0|65535] "NA"  ACM
 SG_ LDW_Suppression_Reason_0 : 80|10@1+ (1,0) [0|1023] "BITWIZE"  ACM
 SG_ LDW_Time_To_Warning_Left_0 : 90|8@1+ (0.01,0) [0|2] "sec"  ACM
 SG_ LDW_Time_To_Warning_Right_0 : 98|8@1+ (0.01,0) [0|2] "sec"  ACM
 SG_ LDW_Warning_Status_Left_0 : 106|2@1+ (1,0) [0|3] "ENUM"  ACM
 SG_ LDW_Warning_Status_Right_0 : 108|2@1+ (1,0) [0|3] "ENUM"  ACM
 SG_ LDW_Buffer_0 : 110|2@1+ (1,0) [0|0] "NA"  ACM
 SG_ LDW_Suppression_Reason_1 : 112|10@1+ (1,0) [0|1023] "BITWIZE"  ACM
 SG_ LDW_Time_To_Warning_Left_1 : 122|8@1+ (0.01,0) [0|2] "sec"  ACM
 SG_ LDW_Time_To_Warning_Right_1 : 130|8@1+ (0.01,0) [0|2] "sec"  ACM
 SG_ LDW_Warning_Status_Left_1 : 138|2@1+ (1,0) [0|3] "ENUM"  ACM
 SG_ LDW_Warning_Status_Right_1 : 140|2@1+ (1,0) [0|3] "ENUM"  ACM
 SG_ LDW_Buffer_1 : 142|2@1+ (1,0) [0|0] "NA"  ACM
 SG_ LDW_Suppression_Reason_2 : 144|10@1+ (1,0) [0|1023] "BITWIZE"  ACM
 SG_ LDW_Time_To_Warning_Left_2 : 154|8@1+ (0.01,0) [0|2] "sec"  ACM
 SG_ LDW_Time_To_Warning_Right_2 : 162|8@1+ (0.01,0) [0|2] "sec"  ACM
 SG_ LDW_Warning_Status_Left_2 : 170|2@1+ (1,0) [0|3] "ENUM"  ACM
 SG_ LDW_Warning_Status_Right_2 : 172|2@1+ (1,0) [0|3] "ENUM"  ACM
 SG_ LDW_Buffer_2 : 174|2@1+ (1,0) [0|0] "NA"  ACM
 SG_ LDW_Suppression_Reason_3 : 176|10@1+ (1,0) [0|1023] "BITWIZE"  ACM
 SG_ LDW_Time_To_Warning_Left_3 : 186|8@1+ (0.01,0) [0|2] "sec"  ACM
 SG_ LDW_Time_To_Warning_Right_3 : 194|8@1+ (0.01,0) [0|2] "sec"  ACM
 SG_ LDW_Warning_Status_Left_3 : 202|2@1+ (1,0) [0|3] "ENUM"  ACM
 SG_ LDW_Warning_Status_Right_3 : 204|2@1+ (1,0) [0|3] "ENUM"  ACM
 SG_ LDW_Buffer_3 : 206|2@1+ (1,0) [0|0] "NA"  ACM

BO_ 99 ICM_Lanes_Adja_Prot_C: 64 MyECU
 SG_ LA_Line_C0_2 : 240|32@1+ (0.0001,-30) [0|600000] "m"  ACM
 SG_ LA_Line_C1_2 : 208|32@1+ (0.0001,-2) [0|40000] "rad"  ACM
 SG_ LA_Line_C2_2 : 176|32@1+ (0.0001,-0.125) [0|2500] "INV(m)"  ACM
 SG_ LA_Line_C3_2 : 144|32@1+ (1E-005,-0.004) [0|800] "INV(m2)"  ACM
 SG_ LA_Marker_Width_STD_2 : 124|7@1+ (0.005,0) [0|0.5] "m"  ACM
 SG_ LA_Marker_Width_2 : 116|8@1+ (0.01,0) [0|0.7] "m"  ACM
 SG_ LA_Line_Role_2 : 112|4@1+ (1,0) [0|4] "ENUM"  ACM
 SG_ LA_Lanemark_Type_Conf_2 : 102|7@1+ (0.01,0) [0|1] "NA"  ACM
 SG_ LA_DLM_Type_2 : 99|3@1+ (1,0) [0|5] "ENUM"  ACM
 SG_ LA_Lanemark_Type_2 : 95|4@1+ (1,0) [0|6] "ENUM"  ACM
 SG_ LA_Measured_VR_End_2 : 80|15@1+ (0.01,0) [0|200] "m"  ACM
 SG_ LA_View_Range_End_2 : 65|15@1+ (0.01,0) [0|200] "m"  ACM
 SG_ LA_View_Range_Start_2 : 50|15@1+ (0.01,0) [0|200] "m"  ACM
 SG_ LA_Prediction_Source_2 : 49|1@1+ (1,0) [0|1] "ENUM"  ACM
 SG_ LA_Prediction_Type_2 : 48|1@1+ (1,0) [0|1] "ENUM"  ACM
 SG_ LA_Color_Conf_2 : 41|7@1+ (0.01,0) [0|1] "NA"  ACM
 SG_ LA_Color_2 : 39|2@1+ (1,0) [0|3] "ENUM"  ACM
 SG_ LA_Exist_Probability_2 : 32|7@1+ (0.01,0) [0|1] "NA"  ACM
 SG_ LA_Age_2 : 24|8@1+ (1,0) [0|255] "frames"  ACM
 SG_ LA_Lane_Track_ID_2 : 16|8@1+ (1,0) [0|255] "counter"  ACM
 SG_ ICM_La_Adja_Prot_C_Header : 0|16@1+ (1,0) [0|65535] ""  ACM

BO_ 100 ICM_Lanes_Adja_Prot_D: 64 MyECU
 SG_ ICM_La_Adja_Prot_D_CRC : 272|16@1+ (1,0) [0|65535] ""  ACM
 SG_ LA_Line_C0_3 : 240|32@1+ (0.0001,-30) [0|600000] "m"  ACM
 SG_ LA_Line_C1_3 : 208|32@1+ (0.0001,-2) [0|40000] "rad"  ACM
 SG_ LA_Line_C2_3 : 176|32@1+ (0.0001,-0.125) [0|2500] "INV(m)"  ACM
 SG_ LA_Line_C3_3 : 144|32@1+ (1E-005,-0.004) [0|800] "INV(m2)"  ACM
 SG_ LA_Marker_Width_STD_3 : 124|7@1+ (0.005,0) [0|0.5] "m"  ACM
 SG_ LA_Marker_Width_3 : 116|8@1+ (0.01,0) [0|0.7] "m"  ACM
 SG_ LA_Line_Role_3 : 112|4@1+ (1,0) [0|4] "ENUM"  ACM
 SG_ LA_Lanemark_Type_Conf_3 : 102|7@1+ (0.01,0) [0|1] "NA"  ACM
 SG_ LA_DLM_Type_3 : 99|3@1+ (1,0) [0|5] "ENUM"  ACM
 SG_ LA_Lanemark_Type_3 : 95|4@1+ (1,0) [0|6] "ENUM"  ACM
 SG_ LA_Measured_VR_End_3 : 80|15@1+ (0.01,0) [0|200] "m"  ACM
 SG_ LA_View_Range_End_3 : 65|15@1+ (0.01,0) [0|200] "m"  ACM
 SG_ LA_View_Range_Start_3 : 50|15@1+ (0.01,0) [0|200] "m"  ACM
 SG_ LA_Prediction_Source_3 : 49|1@1+ (1,0) [0|1] "ENUM"  ACM
 SG_ LA_Prediction_Type_3 : 48|1@1+ (1,0) [0|1] "ENUM"  ACM
 SG_ LA_Color_Conf_3 : 41|7@1+ (0.01,0) [0|1] "NA"  ACM
 SG_ LA_Color_3 : 39|2@1+ (1,0) [0|3] "ENUM"  ACM
 SG_ LA_Exist_Probability_3 : 32|7@1+ (0.01,0) [0|1] "NA"  ACM
 SG_ LA_Age_3 : 24|8@1+ (1,0) [0|255] "frames"  ACM
 SG_ LA_Lane_Track_ID_3 : 16|8@1+ (1,0) [0|255] "counter"  ACM
 SG_ ICM_La_Adja_Prot_D_Header : 0|16@1+ (1,0) [0|65535] ""  ACM

BO_ 98 ICM_Lanes_Adja_Prot_B: 64 MyECU
 SG_ LA_Line_C0_1 : 240|32@1+ (0.0001,-30) [0|600000] "m"  ACM
 SG_ LA_Line_C1_1 : 208|32@1+ (0.0001,-2) [-0|40000] "rad"  ACM
 SG_ LA_Line_C2_1 : 176|32@1+ (0.0001,-0.125) [0|2500] "INV(m)"  ACM
 SG_ LA_Line_C3_1 : 144|32@1+ (1E-005,-0.004) [0|800] "INV(m2)"  ACM
 SG_ LA_Marker_Width_STD_1 : 124|7@1+ (0.005,0) [0|0.5] "m"  ACM
 SG_ LA_Marker_Width_1 : 116|8@1+ (0.01,0) [0|0.7] "m"  ACM
 SG_ LA_Line_Role_1 : 112|4@1+ (1,0) [0|4] "ENUM"  ACM
 SG_ LA_Lanemark_Type_Conf_1 : 102|7@1+ (0.01,0) [0|1] "NA"  ACM
 SG_ LA_DLM_Type_1 : 99|3@1+ (1,0) [0|5] "ENUM"  ACM
 SG_ LA_Lanemark_Type_1 : 95|4@1+ (1,0) [0|6] "ENUM"  ACM
 SG_ LA_Measured_VR_End_1 : 80|15@1+ (0.01,0) [0|200] "m"  ACM
 SG_ LA_View_Range_End_1 : 65|15@1+ (0.01,0) [0|200] "m"  ACM
 SG_ LA_View_Range_Start_1 : 50|15@1+ (0.01,0) [0|200] "m"  ACM
 SG_ LA_Prediction_Source_1 : 49|1@1+ (1,0) [0|1] "ENUM"  ACM
 SG_ LA_Prediction_Type_1 : 48|1@1+ (1,0) [0|1] "ENUM"  ACM
 SG_ LA_Color_Conf_1 : 41|7@1+ (0.01,0) [0|1] "NA"  ACM
 SG_ LA_Color_1 : 39|2@1+ (1,0) [0|3] "ENUM"  ACM
 SG_ LA_Exist_Probability_1 : 32|7@1+ (0.01,0) [0|1] "NA"  ACM
 SG_ LA_Age_1 : 24|8@1+ (1,0) [0|255] "frames"  ACM
 SG_ LA_Lane_Track_ID_1 : 16|8@1+ (1,0) [0|255] "counter"  ACM
 SG_ ICM_La_Adja_Prot_B_Header : 0|16@1+ (1,0) [0|65535] ""  ACM

BO_ 97 ICM_Lanes_Adja_Prot_A: 64 MyECU
 SG_ LA_Line_C0_0 : 240|32@1+ (0.0001,-30) [0|600000] "m"  ACM
 SG_ LA_Line_C1_0 : 208|32@1+ (0.0001,-2) [0|40000] "rad"  ACM
 SG_ LA_Line_C2_0 : 176|32@1+ (0.0001,-0.125) [0|2500] "INV(m)"  ACM
 SG_ LA_Line_C3_0 : 144|32@1+ (1E-005,-0.004) [0|800] "INV(m2)"  ACM
 SG_ LA_Marker_Width_STD_0 : 124|7@1+ (0.005,0) [0|0.5] "m"  ACM
 SG_ LA_Marker_Width_0 : 116|8@1+ (0.01,0) [0|0.7] "m"  ACM
 SG_ LA_Line_Role_0 : 112|4@1+ (1,0) [0|4] "ENUM"  ACM
 SG_ LA_Lanemark_Type_Conf_0 : 102|7@1+ (0.01,0) [0|1] "NA"  ACM
 SG_ LA_DLM_Type_0 : 99|3@1+ (1,0) [0|5] "ENUM"  ACM
 SG_ LA_Lanemark_Type_0 : 95|4@1+ (1,0) [0|6] "ENUM"  ACM
 SG_ LA_Measured_VR_End_0 : 80|15@1+ (0.01,0) [0|200] "m"  ACM
 SG_ LA_View_Range_End_0 : 65|15@1+ (0.01,0) [0|200] "m"  ACM
 SG_ LA_View_Range_Start_0 : 50|15@1+ (0.01,0) [0|200] "m"  ACM
 SG_ LA_Prediction_Source_0 : 49|1@1+ (1,0) [0|1] "ENUM"  ACM
 SG_ LA_Prediction_Type_0 : 48|1@1+ (1,0) [0|1] "ENUM"  ACM
 SG_ LA_Color_Conf_0 : 41|7@1+ (0.01,0) [0|1] "NA"  ACM
 SG_ LA_Color_0 : 39|2@1+ (1,0) [0|3] "ENUM"  ACM
 SG_ LA_Exist_Probability_0 : 32|7@1+ (0.01,0) [0|1] "NA"  ACM
 SG_ LA_Age_0 : 24|8@1+ (1,0) [0|255] "frames"  ACM
 SG_ LA_Lane_Track_ID_0 : 16|8@1+ (1,0) [0|255] "counter"  ACM
 SG_ ICM_La_Adja_Prot_A_Header : 0|16@1+ (1,0) [0|65535] ""  ACM

BO_ 96 ICM_Lanes_Adja_Prot_Header: 64 MyECU
 SG_ LA_Header_Buffer : 43|5@1+ (1,0) [0|0] "NA"  ACM
 SG_ LA_Adjacent_Count : 40|3@1+ (1,0) [0|4] "counter"  ACM
 SG_ LA_Sync_ID : 32|8@1+ (1,0) [0|255] "counter"  ACM
 SG_ LA_Protocol_Version : 24|8@1+ (1,0) [1|1] "counter"  ACM
 SG_ LA_Zero_byte : 16|8@1+ (1,0) [0|255] "NA"  ACM
 SG_ ICM_La_Adja_Prot_Head_Header : 0|16@1+ (1,0) [0|65535] ""  ACM

BO_ 74 ICM_HLB_Prot: 64 MyECU
 SG_ HLB_Brightness_Score : 80|32@1- (1,0) [0|0] ""  ACM
 SG_ ICM_HLB_Prot_CRC : 112|16@1+ (1,0) [0|65535] ""  ACM
 SG_ HLB_Reason : 48|32@1+ (1,0) [0|524287] "BITWIZE"  ACM
 SG_ HLB_Decision : 45|2@1+ (1,0) [0|2] "ENUM"  ACM
 SG_ HLB_Inactive_Reason : 42|3@1+ (1,0) [0|7] "ENUM"  ACM
 SG_ HLB_Running_Mode : 40|2@1+ (1,0) [0|3] "ENUM"  ACM
 SG_ HLB_Sync_ID : 32|8@1+ (1,0) [0|255] "counter"  ACM
 SG_ HLB_Protocol_Version : 24|8@1+ (1,0) [4|4] "counter"  ACM
 SG_ HLB_Zero_byte : 16|8@1+ (1,0) [0|255] "NA"  ACM
 SG_ ICM_HLB_Prot_Header : 0|16@1+ (1,0) [0|65535] ""  ACM

BO_ 72 ICM_Common_Prot_B: 64 MyECU
 SG_ ICM_Common_Prot_B_CRC : 272|16@1- (1,0) [0|0] ""  ACM
 SG_ COM_SCA_Factor_Variance : 240|32@1- (1,0) [-3.402823466E+038|3.402823466E+038] "NA"  ACM
 SG_ COM_SCA_Factor_Mean : 208|32@1- (1,0) [-3.402823466E+038|3.402823466E+038] "NA"  ACM
 SG_ COM_SCA_Weight : 176|32@1- (1,0) [-3.402823466E+038|3.402823466E+038] "NA"  ACM
 SG_ COM_SCA_Cov_Y_Y : 144|32@1- (1,0) [-3.402823466E+038|3.402823466E+038] "NA"  ACM
 SG_ COM_SCA_Cov_X_Y : 112|32@1- (1,0) [-3.402823466E+038|3.402823466E+038] "NA"  ACM
 SG_ COM_SCA_Cov_X_X : 80|32@1- (1,0) [-3.402823466E+038|3.402823466E+038] "NA"  ACM
 SG_ COM_SCA_Mean_Y : 48|32@1- (1,0) [-3.402823466E+038|3.402823466E+038] "NA"  ACM
 SG_ COM_SCA_Mean_X : 16|32@1- (1,0) [-3.402823466E+038|3.402823466E+038] "NA"  ACM
 SG_ ICM_Common_Prot_B_Header : 0|16@1- (1,0) [0|0] ""  ACM

BO_ 71 ICM_Common_Prot_A: 64 MyECU
 SG_ COM_Is_HighSpeed_Road : 356|1@1+ (1,0) [0|1] "bool"  ACM
 SG_ COM_Is_HighSpeed_Road_V : 355|1@1+ (1,0) [0|1] "bool"  ACM
 SG_ COM_Driving_Side : 347|8@1+ (1,0) [0|2] "ENUM"  ACM
 SG_ COM_Driving_Side_V : 346|1@1+ (1,0) [0|1] "bool"  ACM
 SG_ COM_Region_Code : 342|4@1+ (1,0) [0|15] "ENUM"  ACM
 SG_ COM_Region_Code_V : 341|1@1+ (1,0) [0|1] "bool"  ACM
 SG_ COM_Exposure_Type : 339|2@1+ (1,0) [0|1] "ENUM"  ACM
 SG_ COM_HIL_Mode_Status : 338|1@1+ (1,0) [0|1] "ENUM"  ACM
 SG_ COM_DayTime_Indicator : 336|2@1+ (1,0) [0|2] "ENUM"  ACM
 SG_ COM_Cam_Frame_ID : 304|32@1+ (1,0) [0|4294967295] "counter"  ACM
 SG_ COM_EyeQ_Frame_ID : 272|32@1+ (1,0) [0|4294967295] "counter"  ACM
 SG_ COM_Last_Clock_Sync_Error : 262|1@1+ (1,0) [0|1] "bool"  ACM
 SG_ COM_Last_Clock_Sync_Skew : 240|22@1+ (1,-100000) [-100000|100000] " nano seconds"  ACM
 SG_ COM_Last_MCU_Sync_TS : 176|64@1+ (1,0) [0|1.84467440737096E+019] "us"  ACM
 SG_ COM_Frame_MCU_TS_Start : 112|64@1+ (1,0) [0|1.84467440737096E+019] "us"  ACM
 SG_ COM_Sync_Frame_ID : 88|8@1+ (1,0) [0|255] "counter"  ACM
 SG_ COM_Protocol_Version : 80|8@1+ (1,0) [5|5] "counter"  ACM
 SG_ COM_CRC : 48|32@1+ (1,0) [0|4294967295] "NA"  ACM
 SG_ COM_Zero_byte : 16|8@1+ (1,0) [0|255] "NA"  ACM
 SG_ ICM_Common_Prot_A_Header : 0|16@1+ (1,0) [0|65535] ""  ACM

BO_ 67 ICM_Boot_Diag_Message_B: 64 MyECU
 SG_ ICM_Boot_Diag_Mes_B_CRC : 312|16@1+ (1,0) [0|65535] ""  ACM
 SG_ ICM_Boot_Diag_Mes_B_Header : 0|16@1+ (1,0) [0|65535] ""  ACM
 SG_ BOOT_Failure_info_7 : 280|32@1+ (1,0) [0|4294967295] "NA"  ACM
 SG_ BOOT_Failure_info_6 : 248|32@1+ (1,0) [0|4294967295] "NA"  ACM
 SG_ BOOT_Failure_info_5 : 216|32@1+ (1,0) [0|4294967295] "NA"  ACM
 SG_ BOOT_Failure_info_4 : 184|32@1+ (1,0) [0|4294967295] "NA"  ACM
 SG_ BOOT_Failure_info_3 : 152|32@1+ (1,0) [0|4294967295] "NA"  ACM
 SG_ BOOT_Failure_info_2 : 120|32@1+ (1,0) [0|4294967295] "NA"  ACM
 SG_ BOOT_Failure_info_1 : 88|32@1+ (1,0) [0|4294967295] "NA"  ACM
 SG_ BOOT_Failure_info_0 : 64|24@1+ (1,0) [0|16777215] "NA"  ACM
 SG_ Boot_Stage : 56|8@1+ (1,0) [0|7] "ENUM"  ACM
 SG_ BOOT_Flash_2_Size : 32|24@1+ (1,0) [0|16777215] "MB"  ACM
 SG_ BOOT_Flash2_Man_Code : 24|8@1+ (1,0) [0|255] "NA"  ACM

BO_ 66 ICM_Boot_Diag_Message_A: 64 MyECU
 SG_ BOOT_LPDDR4_Temperature_Status : 296|8@1+ (1,0) [0|7] "ENUM"  ACM
 SG_ BOOT_VMP_Temperature : 288|8@1- (1,0) [-128|127] "deg"  ACM
 SG_ BOOT_CPU_Temperature : 280|8@1- (1,0) [-128|127] "deg"  ACM
 SG_ ICM_Boot_Diag_Mes_A_Header : 0|16@1+ (1,0) [0|65535] ""  ACM
 SG_ BOOT_Flash_Size : 256|24@1+ (1,0) [0|16777215] "MB"  ACM
 SG_ BOOT_Flash_Man_Code : 248|8@1+ (1,0) [0|255] "NA"  ACM
 SG_ BOOT_DDR_Size : 224|24@1+ (1,0) [0|16777215] "MB"  ACM
 SG_ BOOT_DDR_manufacturer_code : 216|8@1+ (1,0) [0|255] "NA"  ACM
 SG_ BOOT_EyeQ_Type : 152|32@1+ (1,0) [0|4294967295] "NA"  ACM
 SG_ BOOT_EyeQ_ID : 184|32@1+ (1,0) [0|4294967295] "NA"  ACM
 SG_ BOOT_Application_version : 120|32@1+ (1,0) [0|4294967295] "NA"  ACM
 SG_ BOOT_Version : 88|32@1+ (1,0) [0|4294967295] "NA"  ACM
 SG_ BOOT_Board_revision : 80|8@1+ (1,0) [0|255] "NA"  ACM
 SG_ BOOT_Board_project_code : 72|8@1+ (1,0) [0|255] "NA"  ACM
 SG_ BOOT_Test_results : 56|16@1+ (1,0) [0|65535] "BITWIZE"  ACM
 SG_ BootMsg_Protocol_Version : 32|8@1+ (1,0) [2|2] "counter"  ACM
 SG_ BOOT_Zero_byte : 16|8@1+ (1,0) [0|0] "NA"  ACM

BO_ 65 ICM_Application_Message_B: 64 MyECU
 SG_ APP_Application_ver : 144|32@1+ (1,0) [0|4294967295] "Int"  ACM
 SG_ APP_appMode : 112|32@1+ (1,0) [0|4294967295] "Int"  ACM
 SG_ ICM_App_Message_B_Header : 0|16@1+ (1,0) [0|65535] ""  ACM
 SG_ ICM_App_Message_B_CRC : 496|16@1+ (1,0) [0|65535] ""  ACM
 SG_ APP_Brain_drops_counter : 80|32@1+ (1,0) [0|4294967295] "BITWIZE"  ACM
 SG_ APP_Camera2_VideoErrorFlags_pt1 : 16|32@1+ (1,0) [0|4294967295] "BITWIZE"  ACM
 SG_ APP_Camera3_VideoErrorFlags_pt1 : 48|32@1+ (1,0) [0|4294967295] "BITWIZE"  ACM
 SG_ APP_SPI_Retransmit_Tx : 400|32@1+ (1,0) [0|4294967295] "Int"  ACM
 SG_ APP_SPI_Bus_Load_Tx : 336|32@1+ (1,0) [0|4294967295] "Int"  ACM
 SG_ APP_SPI_Bus_Load_Rx : 368|32@1+ (1,0) [0|4294967295] "Int"  ACM
 SG_ APP_Camera3_VideoErrorFlags_pt2 : 304|32@1+ (1,0) [0|4294967295] "BITWIZE"  ACM
 SG_ APP_Camera2_VideoErrorFlags_pt2 : 272|32@1+ (1,0) [0|4294967295] "BITWIZE"  ACM
 SG_ APP_Camera1_VideoErrorFlags_pt2 : 240|32@1+ (1,0) [0|4294967295] "BITWIZE"  ACM

BO_ 64 ICM_Application_Message_A: 64 MyECU
 SG_ APP_Camera1_VideoErrorFlags_pt1 : 400|32@1+ (1,0) [0|4294967295] "BITWIZE"  ACM
 SG_ ICM_App_Message_A_Header : 0|16@1+ (1,0) [0|65535] ""  ACM
 SG_ APP_Valid_cameras_information : 296|8@1+ (1,0) [0|255] "BITWIZE"  ACM
 SG_ APP_Valid_second_cam_temp_info : 288|8@1+ (1,0) [0|255] "BITWIZE"  ACM
 SG_ APP_Camera3_VideoErrorRange : 384|8@1+ (1,0) [0|255] "BITWIZE"  ACM
 SG_ APP_Camera2_VideoErrorRange : 376|8@1+ (1,0) [0|255] "BITWIZE"  ACM
 SG_ APP_Camera1_VideoErrorRange : 368|8@1+ (1,0) [0|255] "BITWIZE"  ACM
 SG_ APP_Camera3_temperature_2 : 344|8@1- (1,0) [-128|127] "deg"  ACM
 SG_ APP_Camera3_temperature_1 : 320|8@1- (1,0) [-128|127] "deg"  ACM
 SG_ APP_Camera2_temperature_2 : 336|8@1- (1,0) [-128|127] "deg"  ACM
 SG_ APP_Camera2_temperature_1 : 312|8@1- (1,0) [-128|127] "deg"  ACM
 SG_ APP_Camera1_temperature_2 : 328|8@1- (1,0) [-128|127] "deg"  ACM
 SG_ APP_Camera1_temperature_1 : 304|8@1- (1,0) [-128|127] "deg"  ACM
 SG_ APP_spiErrors : 280|8@1+ (1,0) [0|255] "BITWIZE"  ACM
 SG_ APP_Temperature_DDR : 240|8@1- (1,0) [-1|7] "ENUM"  ACM
 SG_ APP_EyeQTemperature2 : 224|16@1- (1,0) [-128|127] "deg"  ACM
 SG_ APP_EyeQTemperature1 : 208|16@1- (1,0) [-128|127] "deg"  ACM
 SG_ APP_Minor_Error : 192|16@1+ (1,0) [0|5014] "ENUM"  ACM
 SG_ APP_Fatal_Error : 176|8@1+ (1,0) [0|129] "ENUM"  ACM
 SG_ APP_EyeQ_Current_Timestamp : 112|32@1+ (1,0) [0|4294967295] "millisec"  ACM
 SG_ APP_EyeQ_Timestamp : 80|32@1+ (1,0) [0|4294967295] "millisec"  ACM
 SG_ APP_EyeQ_Process_Index : 48|32@1+ (1,0) [0|4294967295] "NA"  ACM
 SG_ APP_Sub_State : 40|8@1+ (1,0) [0|255] "NA"  ACM
 SG_ APP_Main_State : 32|8@1+ (1,0) [0|255] "NA"  ACM
 SG_ Application_Message_Version : 24|8@1+ (1,0) [3|3] "NA"  ACM
 SG_ APP_Diagnostics_part_2 : 160|16@1+ (1,0) [0|65535] "BITWIZE"  ACM
 SG_ APP_Diagnostics_part_1 : 144|16@1+ (1,0) [0|65535] "BITWIZE"  ACM
 SG_ APP_Zero_Byte : 16|8@1+ (1,0) [0|0] "NA"  ACM

CM_ SG_ 65 APP_appMode "The app mode that configured in the FFS";
CM_ SG_ 65 APP_Brain_drops_counter "The total number of brain drops";
CM_ SG_ 65 APP_Camera2_VideoErrorFlags_pt1 "Internal camera error flag";
CM_ SG_ 65 APP_Camera3_VideoErrorFlags_pt1 "Internal camera error flag";
CM_ SG_ 65 APP_SPI_Retransmit_Tx "The number of bytes retransmitted by EyeQ over SPI since the last application message";
CM_ SG_ 65 APP_SPI_Bus_Load_Tx "The number of bytes transmitted by EyeQ over SPI since the last application message";
CM_ SG_ 65 APP_SPI_Bus_Load_Rx "The number of bytes received by EyeQ over SPI since the last application message";
CM_ SG_ 65 APP_Camera3_VideoErrorFlags_pt2 "Internal camera error flag";
CM_ SG_ 65 APP_Camera2_VideoErrorFlags_pt2 "Internal camera error flag";
CM_ SG_ 65 APP_Camera1_VideoErrorFlags_pt2 "Internal camera error flag";
CM_ SG_ 64 APP_Camera1_VideoErrorFlags_pt1 "Internal camera error flag";
CM_ SG_ 64 APP_Valid_cameras_information "The supported cameras . Each supported Camera will have it's bit on. 0=Not Valid, 1- Valid";
CM_ SG_ 64 APP_Valid_second_cam_temp_info "The supported camera's second temperature . Each supported Camera will have it's bit on. 0=Not Valid, 1- Valid. Not implemented yet. ";
CM_ SG_ 64 APP_Camera3_VideoErrorRange "As described for camera1";
CM_ SG_ 64 APP_Camera2_VideoErrorRange "As described for camera1";
CM_ SG_ 64 APP_Camera1_VideoErrorRange "This byte represents video errors frames range:  bits-0-3: The number of consecutive video frames with errors bits-4-7: The 4 LSB bits of the image frame counter of the first erroneous frame.";
CM_ SG_ 64 APP_Camera3_temperature_2 "As described for camera1";
CM_ SG_ 64 APP_Camera3_temperature_1 "As described for camera1";
CM_ SG_ 64 APP_Camera2_temperature_2 "As described for camera1";
CM_ SG_ 64 APP_Camera2_temperature_1 "As described for camera1";
CM_ SG_ 64 APP_Camera1_temperature_2 "Camera1 temperature second sensor. Note that 127 is the maximal reported value, even if the actual temperature is higher.";
CM_ SG_ 64 APP_Camera1_temperature_1 "Camera1 temperature. Note that 127 is the maximal reported value, even if the actual temperature is higher.";
CM_ SG_ 64 APP_spiErrors "This byte represents the SPI communication layer status.  A nonzero value of any bit in the SPI status indicates an SPI issue. Note that once set, the bits will not be cleared in the next frames:  bit-0: SPI_CRC_BIT - CRC error occurred. bit-1: SPI_CRC_CONTINUOUS_BIT - 3 consecutive CRC errors occurred. bit-2: SPI_SEQ_BIT - sequence error occurred. bit-3: SPI_SEQ_CONTINUOUS_BIT - 3 consecutive sequence errors occurred. Bits 4-7: Reserved.";
CM_ SG_ 64 APP_Temperature_DDR "DDR Temperture range enumeration. More information on BPP-base-communication-protocol.doc";
CM_ SG_ 64 APP_EyeQTemperature2 "The temperature of the EyeQ (second sensor)";
CM_ SG_ 64 APP_EyeQTemperature1 "The temperature of the EyeQ (first sensor)";
CM_ SG_ 64 APP_Minor_Error "BPP Minor error.  A non fatal error reported from one of EyeQ components. In this case, EyeQ main processing loop continues running as usual.  NOTE: For now mapped only to EDR errors.";
CM_ SG_ 64 APP_Fatal_Error "None rcoverable EyeQ error. Algorithmic processing is halted and only application message is sent. Recovery possible only after a reset.  Note - value zero means that there is no error.";
CM_ SG_ 64 APP_EyeQ_Current_Timestamp "Time since init of the EyeQ";
CM_ SG_ 64 APP_EyeQ_Timestamp "Time since init of the camera";
CM_ SG_ 64 APP_EyeQ_Process_Index "TAPI frame ID. Used for syncronization with algorithmic output.";
CM_ SG_ 64 APP_Sub_State "Application sub-state.";
CM_ SG_ 64 APP_Main_State "Application main state.";
CM_ SG_ 64 APP_Diagnostics_part_2 "Application Diagnostics (second short)";
CM_ SG_ 64 APP_Diagnostics_part_1 "Application Diagnostics (first short)";
BA_DEF_ BO_  "VFrameFormat" ENUM  "StandardCAN","ExtendedCAN","reserved","reserved","reserved","reserved","reserved","reserved","reserved","reserved","reserved","reserved","reserved","reserved","StandardCAN_FD","ExtendedCAN_FD";
BA_DEF_ BO_  "GenMsgSendType" ENUM  "Cyclic","NotUsed","NotUsed","NotUsed","NotUsed","NotUsed","NotUsed","NotUsed","NoMsgSendType";
BA_DEF_ SG_  "GenSigSendType" ENUM  "NotUsed","OnWrite","OnWriteWithRepetition","OnChange","OnChangeWithRepetition","IfActive","IfActiveWithRepeition","NoSigSendType";
BA_DEF_ BO_  "GenMsgCycleTime" INT 0 0;
BA_DEF_ BO_  "GenMsgILSupport" ENUM  "no","yes";
BA_DEF_ SG_  "GenSigStartValue" INT 0 0;
BA_DEF_DEF_  "VFrameFormat" "ExtendedCAN_FD";
BA_DEF_DEF_  "GenMsgSendType" "NoMsgSendType";
BA_DEF_DEF_  "GenSigSendType" "OnWrite";
BA_DEF_DEF_  "GenMsgCycleTime" 0;
BA_DEF_DEF_  "GenMsgILSupport" "yes";
BA_DEF_DEF_  "GenSigStartValue" 0;
BA_ "VFrameFormat" BO_ 156 14;
BA_ "VFrameFormat" BO_ 155 14;
BA_ "VFrameFormat" BO_ 154 14;
BA_ "VFrameFormat" BO_ 153 14;
BA_ "VFrameFormat" BO_ 152 14;
BA_ "VFrameFormat" BO_ 151 14;
BA_ "VFrameFormat" BO_ 149 14;
BA_ "VFrameFormat" BO_ 150 14;
BA_ "VFrameFormat" BO_ 147 14;
BA_ "VFrameFormat" BO_ 148 14;
BA_ "VFrameFormat" BO_ 146 14;
BA_ "VFrameFormat" BO_ 145 14;
BA_ "VFrameFormat" BO_ 144 14;
BA_ "VFrameFormat" BO_ 75 14;
BA_ "VFrameFormat" BO_ 111 14;
BA_ "VFrameFormat" BO_ 110 14;
BA_ "VFrameFormat" BO_ 109 14;
BA_ "VFrameFormat" BO_ 108 14;
BA_ "VFrameFormat" BO_ 105 14;
BA_ "VFrameFormat" BO_ 104 14;
BA_ "VFrameFormat" BO_ 103 14;
BA_ "VFrameFormat" BO_ 102 14;
BA_ "VFrameFormat" BO_ 101 14;
BA_ "VFrameFormat" BO_ 99 14;
BA_ "VFrameFormat" BO_ 100 14;
BA_ "VFrameFormat" BO_ 98 14;
BA_ "VFrameFormat" BO_ 97 14;
BA_ "VFrameFormat" BO_ 96 14;
BA_ "VFrameFormat" BO_ 74 14;
BA_ "VFrameFormat" BO_ 72 14;
BA_ "VFrameFormat" BO_ 71 14;
BA_ "VFrameFormat" BO_ 67 14;
BA_ "VFrameFormat" BO_ 66 14;
BA_ "VFrameFormat" BO_ 65 14;
BA_ "VFrameFormat" BO_ 64 14;
BA_ "GenSigStartValue" SG_ 155 OBJ_Width_5 40;
BA_ "GenSigStartValue" SG_ 155 OBJ_Length_5 24;
BA_ "GenSigStartValue" SG_ 153 OBJ_Width_4 40;
BA_ "GenSigStartValue" SG_ 153 OBJ_Length_4 24;
BA_ "GenSigStartValue" SG_ 151 OBJ_Width_3 40;
BA_ "GenSigStartValue" SG_ 151 OBJ_Length_3 24;
BA_ "GenSigStartValue" SG_ 149 OBJ_Width_2 40;
BA_ "GenSigStartValue" SG_ 149 OBJ_Length_2 24;
BA_ "GenSigStartValue" SG_ 147 OBJ_Width_1 40;
BA_ "GenSigStartValue" SG_ 147 OBJ_Length_1 24;
BA_ "GenSigStartValue" SG_ 145 OBJ_Width_0 40;
BA_ "GenSigStartValue" SG_ 145 OBJ_Length_0 24;
BA_ "GenSigStartValue" SG_ 144 OBJ_Protocol_Version 7;
BA_ "GenSigStartValue" SG_ 75 SD_Protocol_Version 2;
BA_ "GenSigStartValue" SG_ 111 LRE_Line_C3_3 400;
BA_ "GenSigStartValue" SG_ 111 LRE_Line_C2_3 1250;
BA_ "GenSigStartValue" SG_ 111 LRE_Line_C1_3 20000;
BA_ "GenSigStartValue" SG_ 111 LRE_Line_C0_3 300000;
BA_ "GenSigStartValue" SG_ 110 LRE_Line_C3_2 400;
BA_ "GenSigStartValue" SG_ 110 LRE_Line_C2_2 1250;
BA_ "GenSigStartValue" SG_ 110 LRE_Line_C1_2 20000;
BA_ "GenSigStartValue" SG_ 110 LRE_Line_C0_2 300000;
BA_ "GenSigStartValue" SG_ 109 LRE_Line_C3_1 400;
BA_ "GenSigStartValue" SG_ 109 LRE_Line_C2_1 1250;
BA_ "GenSigStartValue" SG_ 109 LRE_Line_C1_1 20000;
BA_ "GenSigStartValue" SG_ 109 LRE_Line_C0_1 300000;
BA_ "GenSigStartValue" SG_ 108 LRE_Protocol_Version 6;
BA_ "GenSigStartValue" SG_ 108 LRE_Line_C3_0 400;
BA_ "GenSigStartValue" SG_ 108 LRE_Line_C2_0 1250;
BA_ "GenSigStartValue" SG_ 108 LRE_Line_C1_0 20000;
BA_ "GenSigStartValue" SG_ 108 LRE_Line_C0_0 300000;
BA_ "GenSigStartValue" SG_ 105 LH_Protocol_Version 1;
BA_ "GenSigStartValue" SG_ 102 LAP_ADV_Protocol_Version 1;
BA_ "GenSigStartValue" SG_ 101 LDW_Protocol_Version 3;
BA_ "GenSigStartValue" SG_ 99 LA_Line_C0_2 300000;
BA_ "GenSigStartValue" SG_ 99 LA_Line_C1_2 20000;
BA_ "GenSigStartValue" SG_ 99 LA_Line_C2_2 1250;
BA_ "GenSigStartValue" SG_ 99 LA_Line_C3_2 400;
BA_ "GenSigStartValue" SG_ 100 LA_Line_C0_3 300000;
BA_ "GenSigStartValue" SG_ 100 LA_Line_C1_3 20000;
BA_ "GenSigStartValue" SG_ 100 LA_Line_C2_3 1250;
BA_ "GenSigStartValue" SG_ 100 LA_Line_C3_3 400;
BA_ "GenSigStartValue" SG_ 98 LA_Line_C0_1 300000;
BA_ "GenSigStartValue" SG_ 98 LA_Line_C1_1 20000;
BA_ "GenSigStartValue" SG_ 98 LA_Line_C2_1 1250;
BA_ "GenSigStartValue" SG_ 98 LA_Line_C3_1 400;
BA_ "GenSigStartValue" SG_ 97 LA_Line_C0_0 300000;
BA_ "GenSigStartValue" SG_ 97 LA_Line_C1_0 20000;
BA_ "GenSigStartValue" SG_ 97 LA_Line_C2_0 1250;
BA_ "GenSigStartValue" SG_ 97 LA_Line_C3_0 400;
BA_ "GenSigStartValue" SG_ 96 LA_Protocol_Version 1;
BA_ "GenSigStartValue" SG_ 74 HLB_Protocol_Version 4;
BA_ "GenSigStartValue" SG_ 71 COM_Protocol_Version 5;
BA_ "GenSigStartValue" SG_ 66 BootMsg_Protocol_Version 2;
BA_ "GenSigStartValue" SG_ 64 Application_Message_Version 3;
VAL_ 156 OBJ_Relative_Long_Velocity_V_5 1 "VALID" 0 "INVALID" ;
VAL_ 156 OBJ_Rel_Long_Vel_STD_V_5 1 "VALID" 0 "INVALID" ;
VAL_ 156 OBJ_Relative_Lat_Velocity_V_5 1 "VALID" 0 "INVALID" ;
VAL_ 156 OBJ_Rel_Lat_Vel_STD_V_5 1 "VALID" 0 "INVALID" ;
VAL_ 156 OBJ_Long_Distance_V_5 1 "VALID" 0 "INVALID" ;
VAL_ 156 OBJ_Long_Distance_STD_V_5 1 "VALID" 0 "INVALID" ;
VAL_ 156 OBJ_Lat_Distance_V_5 1 "VALID" 0 "INVALID" ;
VAL_ 156 OBJ_Lat_Distance_STD_V_5 1 "VALID" 0 "INVALID" ;
VAL_ 156 OBJ_Absolute_Speed_V_5 1 "VALID" 0 "INVALID" ;
VAL_ 156 OBJ_Absolute_Speed_STD_V_5 1 "VALID" 0 "INVALID" ;
VAL_ 156 OBJ_Heading_V_5 1 "VALID" 0 "INVALID" ;
VAL_ 156 OBJ_Heading_STD_V_5 1 "VALID" 0 "INVALID" ;
VAL_ 156 OBJ_Angle_Rate_STD_V_5 1 "VALID" 0 "INVALID" ;
VAL_ 156 OBJ_Angle_Rate_V_5 1 "VALID" 0 "INVALID" ;
VAL_ 156 OBJ_Angle_Right_V_5 1 "VALID" 0 "INVALID" ;
VAL_ 156 OBJ_Angle_Right_STD_V_5 1 "VALID" 0 "INVALID" ;
VAL_ 156 OBJ_Angle_Left_V_5 1 "VALID" 0 "INVALID" ;
VAL_ 156 OBJ_Angle_Left_STD_V_5 1 "VALID" 0 "INVALID" ;
VAL_ 156 OBJ_Angle_Side_V_5 1 "VALID" 0 "INVALID" ;
VAL_ 156 OBJ_Angle_Side_STD_V_5 1 "VALID" 0 "INVALID" ;
VAL_ 156 OBJ_Angle_Mid_V_5 1 "VALID" 0 "INVALID" ;
VAL_ 156 OBJ_Angle_Mid_STD_V_5 1 "VALID" 0 "INVALID" ;
VAL_ 156 OBJ_Angle_Bottom_V_5 1 "VALID" 0 "INVALID" ;
VAL_ 156 OBJ_Angle_Bottom_STD_V_5 1 "VALID" 0 "INVALID" ;
VAL_ 156 OBJ_Visibility_Side_V_5 1 "VALID" 0 "INVALID" ;
VAL_ 156 OBJ_Visibility_Side_5 2 "REAR" 1 "FRONT" 0 "NOT_VISIBLE" ;
VAL_ 156 OBJ_Is_In_Drivable_Area_5 1 "TRUE" 0 "FALSE" ;
VAL_ 156 OBJ_Is_In_Drivable_Area_V_5 1 "VALID" 0 "INVALID" ;
VAL_ 156 OBJ_Is_VeryClose_5 1 "TRUE" 0 "FALSE" ;
VAL_ 156 OBJ_Is_VeryClose_V_5 1 "VALID" 0 "INVALID" ;
VAL_ 155 OBJ_Triggered_SDM_5 2 "NOT_TRIGGERED" 1 "TRIGGERED" 0 "NOT_AVAILABLE" ;
VAL_ 155 OBJ_Motion_Category_5 13 "ONCOMING" 12 "PRECEEDING" 11 "MOVING" 10 "RTAP" 9 "LTAP" 8 "CROSSING" 7 "MOVING_OUT" 6 "MOVING_IN" 5 "CLOSE_CUT_IN" 4 "PASSING_OUT" 3 "PASSING_IN" 2 "PASSING" 1 "UNDEFINED" 0 "INVALID" ;
VAL_ 155 OBJ_Measuring_Status_5 2 "(BIT_2)NOT_VALID_OR_VALID" 1 "(BIT_1)PREDICTED_OR_MEASURED" 0 "(BIT_0)OLD_OR_NEW" ;
VAL_ 155 OBJ_Object_Class_5 8 "UNCERTAIN_VCL" 7 "ANIMAL" 6 "GENERAL_OBJECT" 5 "PEDESTRIAN" 4 "BICYCLE" 3 "MOTOR_BIKE" 2 "TRUCK" 1 "CAR" 0 "INVALID" ;
VAL_ 155 OBJ_Camera_Source_5 11 "PARKING_RIGHT" 10 "PARKING_LEFT" 9 "PARKING_REAR" 8 "PARKING_FRONT" 7 "FRONT_CORNER_RIGHT" 6 "FRONT_CORNER_LEFT" 5 "REAR_CORNER_RIGHT" 4 "REAR_CORNER_LEFT" 3 "REAR" 2 "FRONT_FISHEYE" 1 "FRONT_NARROW" 0 "FRONT_MAIN" ;
VAL_ 155 OBJ_Motion_Status_5 5 "MOVING_SLOWLY" 4 "STOPPED" 3 "STATIONARY" 2 "MOVING" 1 "UNKNOWN" 0 "INVALID" ;
VAL_ 155 OBJ_Motion_Orientation_5 13 "UNKNOWN" 12 "PRECEEDING" 11 "DRIFTING_LEFT" 9 "CROSSING_LEFT" 7 "OC_DRIFTING_LEFT" 6 "ONCOMING" 5 "OC_DRIFTING_RIGHT" 3 "CROSSING_RIGHT" 1 "DRIFTING_RIGHT" 0 "INVALID" ;
VAL_ 155 OBJ_Has_Cut_Lane_5 1 "TRUE" 0 "FALSE" ;
VAL_ 155 OBJ_Has_Cut_Path_5 1 "TRUE" 0 "FALSE" ;
VAL_ 155 OBJ_Brake_Light_5 1 "TRUE" 0 "FALSE" ;
VAL_ 155 OBJ_Turn_Indicator_Right_5 1 "TRUE" 0 "FALSE" ;
VAL_ 155 OBJ_Turn_Indicator_Left_5 1 "TRUE" 0 "FALSE" ;
VAL_ 155 OBJ_Light_Indicator_Validity_5 1 "TRUE" 0 "FALSE" ;
VAL_ 155 OBJ_Right_Out_Of_Image_5 1 "TRUE" 0 "FALSE" ;
VAL_ 155 OBJ_Left_Out_Of_Image_5 1 "TRUE" 0 "FALSE" ;
VAL_ 155 OBJ_Right_Out_Of_Image_V_5 1 "TRUE" 0 "FALSE" ;
VAL_ 155 OBJ_Left_Out_Of_Image_V_5 1 "TRUE" 0 "FALSE" ;
VAL_ 155 OBJ_Top_Out_Of_Image_5 1 "TRUE" 0 "FALSE" ;
VAL_ 155 OBJ_Bottom_Out_Of_Image_5 1 "TRUE" 0 "FALSE" ;
VAL_ 155 OBJ_Top_Out_Of_Image_V_5 1 "VALID" 0 "INVALID" ;
VAL_ 155 OBJ_Bottom_Out_Of_Image_V_5 1 "VALID" 0 "INVALID" ;
VAL_ 155 OBJ_Lane_Assignment_5 5 "RIGHT_RIGHT" 4 "RIGHT" 3 "HOST" 2 "LEFT" 1 "LEFT_LEFT" 0 "UNKNOWN" ;
VAL_ 155 OBJ_Lane_Assignment_V_5 1 "VALID" 0 "INVALID" ;
VAL_ 155 OBJ_Age_Seconds_V_5 1 "VALID" 0 "INVALID" ;
VAL_ 155 OBJ_Width_V_5 1 "VALID" 0 "INVALID" ;
VAL_ 155 OBJ_Width_STD_V_5 1 "VALID" 0 "INVALID" ;
VAL_ 155 OBJ_Length_V_5 1 "VALID" 0 "INVALID" ;
VAL_ 155 OBJ_Length_STD_V_5 1 "VALID" 0 "INVALID" ;
VAL_ 155 OBJ_Height_V_5 1 "VALID" 0 "INVALID" ;
VAL_ 155 OBJ_Height_STD_V_5 1 "VALID" 0 "INVALID" ;
VAL_ 155 OBJ_Abs_Long_Velocity_V_5 1 "VALID" 0 "INVALID" ;
VAL_ 155 OBJ_Abs_Long_Vel_STD_V_5 1 "VALID" 0 "INVALID" ;
VAL_ 155 OBJ_Abs_Lat_Velocity_V_5 1 "VALID" 0 "INVALID" ;
VAL_ 155 OBJ_Abs_Lat_Vel_STD_V_5 1 "VALID" 0 "INVALID" ;
VAL_ 155 OBJ_Abs_Long_Acc_V_5 1 "VALID" 0 "INVALID" ;
VAL_ 155 OBJ_Abs_Long_Acc_STD_V_5 1 "VALID" 0 "INVALID" ;
VAL_ 155 OBJ_Abs_Lat_Acc_V_5 1 "VALID" 0 "INVALID" ;
VAL_ 155 OBJ_Abs_Lat_Acc_STD_V_5 1 "VALID" 0 "INVALID" ;
VAL_ 155 OBJ_Abs_Acceleration_V_5 1 "VALID" 0 "INVALID" ;
VAL_ 155 OBJ_Abs_Acc_STD_V_5 1 "VALID" 0 "INVALID" ;
VAL_ 155 OBJ_Inv_TTC_V_5 1 "VALID" 0 "INVALID" ;
VAL_ 155 OBJ_Inv_TTC_STD_V_5 1 "VALID" 0 "INVALID" ;
VAL_ 155 OBJ_Relative_Long_Acc_V_5 1 "VALID" 0 "INVALID" ;
VAL_ 155 OBJ_Rel_Long_Acc_STD_V_5 1 "VALID" 0 "INVALID" ;
VAL_ 154 OBJ_Relative_Long_Velocity_V_4 1 "VALID" 0 "INVALID" ;
VAL_ 154 OBJ_Rel_Long_Vel_STD_V_4 1 "VALID" 0 "INVALID" ;
VAL_ 154 OBJ_Relative_Lat_Velocity_V_4 1 "VALID" 0 "INVALID" ;
VAL_ 154 OBJ_Rel_Lat_Vel_STD_V_4 1 "VALID" 0 "INVALID" ;
VAL_ 154 OBJ_Long_Distance_V_4 1 "VALID" 0 "INVALID" ;
VAL_ 154 OBJ_Long_Distance_STD_V_4 1 "VALID" 0 "INVALID" ;
VAL_ 154 OBJ_Lat_Distance_V_4 1 "VALID" 0 "INVALID" ;
VAL_ 154 OBJ_Lat_Distance_STD_V_4 1 "VALID" 0 "INVALID" ;
VAL_ 154 OBJ_Absolute_Speed_V_4 1 "VALID" 0 "INVALID" ;
VAL_ 154 OBJ_Absolute_Speed_STD_V_4 1 "VALID" 0 "INVALID" ;
VAL_ 154 OBJ_Heading_V_4 1 "VALID" 0 "INVALID" ;
VAL_ 154 OBJ_Heading_STD_V_4 1 "VALID" 0 "INVALID" ;
VAL_ 154 OBJ_Angle_Rate_STD_V_4 1 "VALID" 0 "INVALID" ;
VAL_ 154 OBJ_Angle_Rate_V_4 1 "VALID" 0 "INVALID" ;
VAL_ 154 OBJ_Angle_Right_V_4 1 "VALID" 0 "INVALID" ;
VAL_ 154 OBJ_Angle_Right_STD_V_4 1 "VALID" 0 "INVALID" ;
VAL_ 154 OBJ_Angle_Left_V_4 1 "VALID" 0 "INVALID" ;
VAL_ 154 OBJ_Angle_Left_STD_V_4 1 "VALID" 0 "INVALID" ;
VAL_ 154 OBJ_Angle_Side_V_4 1 "VALID" 0 "INVALID" ;
VAL_ 154 OBJ_Angle_Side_STD_V_4 1 "VALID" 0 "INVALID" ;
VAL_ 154 OBJ_Angle_Mid_V_4 1 "VALID" 0 "INVALID" ;
VAL_ 154 OBJ_Angle_Mid_STD_V_4 1 "VALID" 0 "INVALID" ;
VAL_ 154 OBJ_Angle_Bottom_V_4 1 "VALID" 0 "INVALID" ;
VAL_ 154 OBJ_Angle_Bottom_STD_V_4 1 "VALID" 0 "INVALID" ;
VAL_ 154 OBJ_Visibility_Side_V_4 1 "VALID" 0 "INVALID" ;
VAL_ 154 OBJ_Visibility_Side_4 2 "REAR" 1 "FRONT" 0 "NOT_VISIBLE" ;
VAL_ 154 OBJ_Is_In_Drivable_Area_4 1 "TRUE" 0 "FALSE" ;
VAL_ 154 OBJ_Is_In_Drivable_Area_V_4 1 "VALID" 0 "INVALID" ;
VAL_ 154 OBJ_Is_VeryClose_4 1 "TRUE" 0 "FALSE" ;
VAL_ 154 OBJ_Is_VeryClose_V_4 1 "VALID" 0 "INVALID" ;
VAL_ 153 OBJ_Triggered_SDM_4 2 "NOT_TRIGGERED" 1 "TRIGGERED" 0 "NOT_AVAILABLE" ;
VAL_ 153 OBJ_Motion_Category_4 13 "ONCOMING" 12 "PRECEEDING" 11 "MOVING" 10 "RTAP" 9 "LTAP" 8 "CROSSING" 7 "MOVING_OUT" 6 "MOVING_IN" 5 "CLOSE_CUT_IN" 4 "PASSING_OUT" 3 "PASSING_IN" 2 "PASSING" 1 "UNDEFINED" 0 "INVALID" ;
VAL_ 153 OBJ_Measuring_Status_4 2 "(BIT_2)NOT_VALID_OR_VALID" 1 "(BIT_1)PREDICTED_OR_MEASURED" 0 "(BIT_0)OLD_OR_NEW" ;
VAL_ 153 OBJ_Object_Class_4 8 "UNCERTAIN_VCL" 7 "ANIMAL" 6 "GENERAL_OBJECT" 5 "PEDESTRIAN" 4 "BICYCLE" 3 "MOTOR_BIKE" 2 "TRUCK" 1 "CAR" 0 "INVALID" ;
VAL_ 153 OBJ_Camera_Source_4 11 "PARKING_RIGHT" 10 "PARKING_LEFT" 9 "PARKING_REAR" 8 "PARKING_FRONT" 7 "FRONT_CORNER_RIGHT" 6 "FRONT_CORNER_LEFT" 5 "REAR_CORNER_RIGHT" 4 "REAR_CORNER_LEFT" 3 "REAR" 2 "FRONT_FISHEYE" 1 "FRONT_NARROW" 0 "FRONT_MAIN" ;
VAL_ 153 OBJ_Motion_Status_4 5 "MOVING_SLOWLY" 4 "STOPPED" 3 "STATIONARY" 2 "MOVING" 1 "UNKNOWN" 0 "INVALID" ;
VAL_ 153 OBJ_Motion_Orientation_4 13 "UNKNOWN" 12 "PRECEEDING" 11 "DRIFTING_LEFT" 9 "CROSSING_LEFT" 7 "OC_DRIFTING_LEFT" 6 "ONCOMING" 5 "OC_DRIFTING_RIGHT" 3 "CROSSING_RIGHT" 1 "DRIFTING_RIGHT" 0 "INVALID" ;
VAL_ 153 OBJ_Has_Cut_Lane_4 1 "TRUE" 0 "FALSE" ;
VAL_ 153 OBJ_Has_Cut_Path_4 1 "TRUE" 0 "FALSE" ;
VAL_ 153 OBJ_Brake_Light_4 1 "TRUE" 0 "FALSE" ;
VAL_ 153 OBJ_Turn_Indicator_Right_4 1 "TRUE" 0 "FALSE" ;
VAL_ 153 OBJ_Turn_Indicator_Left_4 1 "TRUE" 0 "FALSE" ;
VAL_ 153 OBJ_Light_Indicator_Validity_4 1 "TRUE" 0 "FALSE" ;
VAL_ 153 OBJ_Right_Out_Of_Image_4 1 "TRUE" 0 "FALSE" ;
VAL_ 153 OBJ_Left_Out_Of_Image_4 1 "TRUE" 0 "FALSE" ;
VAL_ 153 OBJ_Right_Out_Of_Image_V_4 1 "TRUE" 0 "FALSE" ;
VAL_ 153 OBJ_Left_Out_Of_Image_V_4 1 "TRUE" 0 "FALSE" ;
VAL_ 153 OBJ_Top_Out_Of_Image_4 1 "TRUE" 0 "FALSE" ;
VAL_ 153 OBJ_Bottom_Out_Of_Image_4 1 "TRUE" 0 "FALSE" ;
VAL_ 153 OBJ_Top_Out_Of_Image_V_4 1 "VALID" 0 "INVALID" ;
VAL_ 153 OBJ_Bottom_Out_Of_Image_V_4 1 "VALID" 0 "INVALID" ;
VAL_ 153 OBJ_Lane_Assignment_4 5 "RIGHT_RIGHT" 4 "RIGHT" 3 "HOST" 2 "LEFT" 1 "LEFT_LEFT" 0 "UNKNOWN" ;
VAL_ 153 OBJ_Lane_Assignment_V_4 1 "VALID" 0 "INVALID" ;
VAL_ 153 OBJ_Age_Seconds_V_4 1 "VALID" 0 "INVALID" ;
VAL_ 153 OBJ_Width_V_4 1 "VALID" 0 "INVALID" ;
VAL_ 153 OBJ_Width_STD_V_4 1 "VALID" 0 "INVALID" ;
VAL_ 153 OBJ_Length_V_4 1 "VALID" 0 "INVALID" ;
VAL_ 153 OBJ_Length_STD_V_4 1 "VALID" 0 "INVALID" ;
VAL_ 153 OBJ_Height_V_4 1 "VALID" 0 "INVALID" ;
VAL_ 153 OBJ_Height_STD_V_4 1 "VALID" 0 "INVALID" ;
VAL_ 153 OBJ_Abs_Long_Velocity_V_4 1 "VALID" 0 "INVALID" ;
VAL_ 153 OBJ_Abs_Long_Vel_STD_V_4 1 "VALID" 0 "INVALID" ;
VAL_ 153 OBJ_Abs_Lat_Velocity_V_4 1 "VALID" 0 "INVALID" ;
VAL_ 153 OBJ_Abs_Lat_Vel_STD_V_4 1 "VALID" 0 "INVALID" ;
VAL_ 153 OBJ_Abs_Long_Acc_V_4 1 "VALID" 0 "INVALID" ;
VAL_ 153 OBJ_Abs_Long_Acc_STD_V_4 1 "VALID" 0 "INVALID" ;
VAL_ 153 OBJ_Abs_Lat_Acc_V_4 1 "VALID" 0 "INVALID" ;
VAL_ 153 OBJ_Abs_Lat_Acc_STD_V_4 1 "VALID" 0 "INVALID" ;
VAL_ 153 OBJ_Abs_Acceleration_V_4 1 "VALID" 0 "INVALID" ;
VAL_ 153 OBJ_Abs_Acc_STD_V_4 1 "VALID" 0 "INVALID" ;
VAL_ 153 OBJ_Inv_TTC_V_4 1 "VALID" 0 "INVALID" ;
VAL_ 153 OBJ_Inv_TTC_STD_V_4 1 "VALID" 0 "INVALID" ;
VAL_ 153 OBJ_Relative_Long_Acc_V_4 1 "VALID" 0 "INVALID" ;
VAL_ 153 OBJ_Rel_Long_Acc_STD_V_4 1 "VALID" 0 "INVALID" ;
VAL_ 152 OBJ_Relative_Long_Velocity_V_3 1 "VALID" 0 "INVALID" ;
VAL_ 152 OBJ_Rel_Long_Vel_STD_V_3 1 "VALID" 0 "INVALID" ;
VAL_ 152 OBJ_Relative_Lat_Velocity_V_3 1 "VALID" 0 "INVALID" ;
VAL_ 152 OBJ_Rel_Lat_Vel_STD_V_3 1 "VALID" 0 "INVALID" ;
VAL_ 152 OBJ_Long_Distance_V_3 1 "VALID" 0 "INVALID" ;
VAL_ 152 OBJ_Long_Distance_STD_V_3 1 "VALID" 0 "INVALID" ;
VAL_ 152 OBJ_Lat_Distance_V_3 1 "VALID" 0 "INVALID" ;
VAL_ 152 OBJ_Lat_Distance_STD_V_3 1 "VALID" 0 "INVALID" ;
VAL_ 152 OBJ_Absolute_Speed_V_3 1 "VALID" 0 "INVALID" ;
VAL_ 152 OBJ_Absolute_Speed_STD_V_3 1 "VALID" 0 "INVALID" ;
VAL_ 152 OBJ_Heading_V_3 1 "VALID" 0 "INVALID" ;
VAL_ 152 OBJ_Heading_STD_V_3 1 "VALID" 0 "INVALID" ;
VAL_ 152 OBJ_Angle_Rate_STD_V_3 1 "VALID" 0 "INVALID" ;
VAL_ 152 OBJ_Angle_Rate_V_3 1 "VALID" 0 "INVALID" ;
VAL_ 152 OBJ_Angle_Right_V_3 1 "VALID" 0 "INVALID" ;
VAL_ 152 OBJ_Angle_Right_STD_V_3 1 "VALID" 0 "INVALID" ;
VAL_ 152 OBJ_Angle_Left_V_3 1 "VALID" 0 "INVALID" ;
VAL_ 152 OBJ_Angle_Left_STD_V_3 1 "VALID" 0 "INVALID" ;
VAL_ 152 OBJ_Angle_Side_V_3 1 "VALID" 0 "INVALID" ;
VAL_ 152 OBJ_Angle_Side_STD_V_3 1 "VALID" 0 "INVALID" ;
VAL_ 152 OBJ_Angle_Mid_V_3 1 "VALID" 0 "INVALID" ;
VAL_ 152 OBJ_Angle_Mid_STD_V_3 1 "VALID" 0 "INVALID" ;
VAL_ 152 OBJ_Angle_Bottom_V_3 1 "VALID" 0 "INVALID" ;
VAL_ 152 OBJ_Angle_Bottom_STD_V_3 1 "VALID" 0 "INVALID" ;
VAL_ 152 OBJ_Visibility_Side_V_3 1 "VALID" 0 "INVALID" ;
VAL_ 152 OBJ_Visibility_Side_3 2 "REAR" 1 "FRONT" 0 "NOT_VISIBLE" ;
VAL_ 152 OBJ_Is_In_Drivable_Area_3 1 "TRUE" 0 "FALSE" ;
VAL_ 152 OBJ_Is_In_Drivable_Area_V_3 1 "VALID" 0 "INVALID" ;
VAL_ 152 OBJ_Is_VeryClose_3 1 "TRUE" 0 "FALSE" ;
VAL_ 152 OBJ_Is_VeryClose_V_3 1 "VALID" 0 "INVALID" ;
VAL_ 151 OBJ_Triggered_SDM_3 2 "NOT_TRIGGERED" 1 "TRIGGERED" 0 "NOT_AVAILABLE" ;
VAL_ 151 OBJ_Motion_Category_3 13 "ONCOMING" 12 "PRECEEDING" 11 "MOVING" 10 "RTAP" 9 "LTAP" 8 "CROSSING" 7 "MOVING_OUT" 6 "MOVING_IN" 5 "CLOSE_CUT_IN" 4 "PASSING_OUT" 3 "PASSING_IN" 2 "PASSING" 1 "UNDEFINED" 0 "INVALID" ;
VAL_ 151 OBJ_Measuring_Status_3 2 "(BIT_2)NOT_VALID_OR_VALID" 1 "(BIT_1)PREDICTED_OR_MEASURED" 0 "(BIT_0)OLD_OR_NEW" ;
VAL_ 151 OBJ_Object_Class_3 8 "UNCERTAIN_VCL" 7 "ANIMAL" 6 "GENERAL_OBJECT" 5 "PEDESTRIAN" 4 "BICYCLE" 3 "MOTOR_BIKE" 2 "TRUCK" 1 "CAR" 0 "INVALID" ;
VAL_ 151 OBJ_Camera_Source_3 11 "PARKING_RIGHT" 10 "PARKING_LEFT" 9 "PARKING_REAR" 8 "PARKING_FRONT" 7 "FRONT_CORNER_RIGHT" 6 "FRONT_CORNER_LEFT" 5 "REAR_CORNER_RIGHT" 4 "REAR_CORNER_LEFT" 3 "REAR" 2 "FRONT_FISHEYE" 1 "FRONT_NARROW" 0 "FRONT_MAIN" ;
VAL_ 151 OBJ_Motion_Status_3 5 "MOVING_SLOWLY" 4 "STOPPED" 3 "STATIONARY" 2 "MOVING" 1 "UNKNOWN" 0 "INVALID" ;
VAL_ 151 OBJ_Motion_Orientation_3 13 "UNKNOWN" 12 "PRECEEDING" 11 "DRIFTING_LEFT" 9 "CROSSING_LEFT" 7 "OC_DRIFTING_LEFT" 6 "ONCOMING" 5 "OC_DRIFTING_RIGHT" 3 "CROSSING_RIGHT" 1 "DRIFTING_RIGHT" 0 "INVALID" ;
VAL_ 151 OBJ_Has_Cut_Lane_3 1 "TRUE" 0 "FALSE" ;
VAL_ 151 OBJ_Has_Cut_Path_3 1 "TRUE" 0 "FALSE" ;
VAL_ 151 OBJ_Brake_Light_3 1 "TRUE" 0 "FALSE" ;
VAL_ 151 OBJ_Turn_Indicator_Right_3 1 "TRUE" 0 "FALSE" ;
VAL_ 151 OBJ_Turn_Indicator_Left_3 1 "TRUE" 0 "FALSE" ;
VAL_ 151 OBJ_Light_Indicator_Validity_3 1 "TRUE" 0 "FALSE" ;
VAL_ 151 OBJ_Right_Out_Of_Image_3 1 "TRUE" 0 "FALSE" ;
VAL_ 151 OBJ_Left_Out_Of_Image_3 1 "TRUE" 0 "FALSE" ;
VAL_ 151 OBJ_Right_Out_Of_Image_V_3 1 "TRUE" 0 "FALSE" ;
VAL_ 151 OBJ_Left_Out_Of_Image_V_3 1 "TRUE" 0 "FALSE" ;
VAL_ 151 OBJ_Top_Out_Of_Image_3 1 "TRUE" 0 "FALSE" ;
VAL_ 151 OBJ_Bottom_Out_Of_Image_3 1 "TRUE" 0 "FALSE" ;
VAL_ 151 OBJ_Top_Out_Of_Image_V_3 1 "VALID" 0 "INVALID" ;
VAL_ 151 OBJ_Bottom_Out_Of_Image_V_3 1 "VALID" 0 "INVALID" ;
VAL_ 151 OBJ_Lane_Assignment_3 5 "RIGHT_RIGHT" 4 "RIGHT" 3 "HOST" 2 "LEFT" 1 "LEFT_LEFT" 0 "UNKNOWN" ;
VAL_ 151 OBJ_Lane_Assignment_V_3 1 "VALID" 0 "INVALID" ;
VAL_ 151 OBJ_Age_Seconds_V_3 1 "VALID" 0 "INVALID" ;
VAL_ 151 OBJ_Width_V_3 1 "VALID" 0 "INVALID" ;
VAL_ 151 OBJ_Width_STD_V_3 1 "VALID" 0 "INVALID" ;
VAL_ 151 OBJ_Length_V_3 1 "VALID" 0 "INVALID" ;
VAL_ 151 OBJ_Length_STD_V_3 1 "VALID" 0 "INVALID" ;
VAL_ 151 OBJ_Height_V_3 1 "VALID" 0 "INVALID" ;
VAL_ 151 OBJ_Height_STD_V_3 1 "VALID" 0 "INVALID" ;
VAL_ 151 OBJ_Abs_Long_Velocity_V_3 1 "VALID" 0 "INVALID" ;
VAL_ 151 OBJ_Abs_Long_Vel_STD_V_3 1 "VALID" 0 "INVALID" ;
VAL_ 151 OBJ_Abs_Lat_Velocity_V_3 1 "VALID" 0 "INVALID" ;
VAL_ 151 OBJ_Abs_Lat_Vel_STD_V_3 1 "VALID" 0 "INVALID" ;
VAL_ 151 OBJ_Abs_Long_Acc_V_3 1 "VALID" 0 "INVALID" ;
VAL_ 151 OBJ_Abs_Long_Acc_STD_V_3 1 "VALID" 0 "INVALID" ;
VAL_ 151 OBJ_Abs_Lat_Acc_V_3 1 "VALID" 0 "INVALID" ;
VAL_ 151 OBJ_Abs_Lat_Acc_STD_V_3 1 "VALID" 0 "INVALID" ;
VAL_ 151 OBJ_Abs_Acceleration_V_3 1 "VALID" 0 "INVALID" ;
VAL_ 151 OBJ_Abs_Acc_STD_V_3 1 "VALID" 0 "INVALID" ;
VAL_ 151 OBJ_Inv_TTC_V_3 1 "VALID" 0 "INVALID" ;
VAL_ 151 OBJ_Inv_TTC_STD_V_3 1 "VALID" 0 "INVALID" ;
VAL_ 151 OBJ_Relative_Long_Acc_V_3 1 "VALID" 0 "INVALID" ;
VAL_ 151 OBJ_Rel_Long_Acc_STD_V_3 1 "VALID" 0 "INVALID" ;
VAL_ 149 OBJ_Triggered_SDM_2 2 "NOT_TRIGGERED" 1 "TRIGGERED" 0 "NOT_AVAILABLE" ;
VAL_ 149 OBJ_Motion_Category_2 13 "ONCOMING" 12 "PRECEEDING" 11 "MOVING" 10 "RTAP" 9 "LTAP" 8 "CROSSING" 7 "MOVING_OUT" 6 "MOVING_IN" 5 "CLOSE_CUT_IN" 4 "PASSING_OUT" 3 "PASSING_IN" 2 "PASSING" 1 "UNDEFINED" 0 "INVALID" ;
VAL_ 149 OBJ_Measuring_Status_2 2 "(BIT_2)NOT_VALID_OR_VALID" 1 "(BIT_1)PREDICTED_OR_MEASURED" 0 "(BIT_0)OLD_OR_NEW" ;
VAL_ 149 OBJ_Object_Class_2 8 "UNCERTAIN_VCL" 7 "ANIMAL" 6 "GENERAL_OBJECT" 5 "PEDESTRIAN" 4 "BICYCLE" 3 "MOTOR_BIKE" 2 "TRUCK" 1 "CAR" 0 "INVALID" ;
VAL_ 149 OBJ_Camera_Source_2 11 "PARKING_RIGHT" 10 "PARKING_LEFT" 9 "PARKING_REAR" 8 "PARKING_FRONT" 7 "FRONT_CORNER_RIGHT" 6 "FRONT_CORNER_LEFT" 5 "REAR_CORNER_RIGHT" 4 "REAR_CORNER_LEFT" 3 "REAR" 2 "FRONT_FISHEYE" 1 "FRONT_NARROW" 0 "FRONT_MAIN" ;
VAL_ 149 OBJ_Motion_Status_2 5 "MOVING_SLOWLY" 4 "STOPPED" 3 "STATIONARY" 2 "MOVING" 1 "UNKNOWN" 0 "INVALID" ;
VAL_ 149 OBJ_Motion_Orientation_2 13 "UNKNOWN" 12 "PRECEEDING" 11 "DRIFTING_LEFT" 9 "CROSSING_LEFT" 7 "OC_DRIFTING_LEFT" 6 "ONCOMING" 5 "OC_DRIFTING_RIGHT" 3 "CROSSING_RIGHT" 1 "DRIFTING_RIGHT" 0 "INVALID" ;
VAL_ 149 OBJ_Has_Cut_Lane_2 1 "TRUE" 0 "FALSE" ;
VAL_ 149 OBJ_Has_Cut_Path_2 1 "TRUE" 0 "FALSE" ;
VAL_ 149 OBJ_Brake_Light_2 1 "TRUE" 0 "FALSE" ;
VAL_ 149 OBJ_Turn_Indicator_Right_2 1 "TRUE" 0 "FALSE" ;
VAL_ 149 OBJ_Turn_Indicator_Left_2 1 "TRUE" 0 "FALSE" ;
VAL_ 149 OBJ_Light_Indicator_Validity_2 1 "TRUE" 0 "FALSE" ;
VAL_ 149 OBJ_Right_Out_Of_Image_2 1 "TRUE" 0 "FALSE" ;
VAL_ 149 OBJ_Left_Out_Of_Image_2 1 "TRUE" 0 "FALSE" ;
VAL_ 149 OBJ_Right_Out_Of_Image_V_2 1 "TRUE" 0 "FALSE" ;
VAL_ 149 OBJ_Left_Out_Of_Image_V_2 1 "TRUE" 0 "FALSE" ;
VAL_ 149 OBJ_Top_Out_Of_Image_2 1 "TRUE" 0 "FALSE" ;
VAL_ 149 OBJ_Bottom_Out_Of_Image_2 1 "TRUE" 0 "FALSE" ;
VAL_ 149 OBJ_Top_Out_Of_Image_V_2 1 "VALID" 0 "INVALID" ;
VAL_ 149 OBJ_Bottom_Out_Of_Image_V_2 1 "VALID" 0 "INVALID" ;
VAL_ 149 OBJ_Lane_Assignment_2 5 "RIGHT_RIGHT" 4 "RIGHT" 3 "HOST" 2 "LEFT" 1 "LEFT_LEFT" 0 "UNKNOWN" ;
VAL_ 149 OBJ_Lane_Assignment_V_2 1 "VALID" 0 "INVALID" ;
VAL_ 149 OBJ_Age_Seconds_V_2 1 "VALID" 0 "INVALID" ;
VAL_ 149 OBJ_Width_V_2 1 "VALID" 0 "INVALID" ;
VAL_ 149 OBJ_Width_STD_V_2 1 "VALID" 0 "INVALID" ;
VAL_ 149 OBJ_Length_V_2 1 "VALID" 0 "INVALID" ;
VAL_ 149 OBJ_Length_STD_V_2 1 "VALID" 0 "INVALID" ;
VAL_ 149 OBJ_Height_V_2 1 "VALID" 0 "INVALID" ;
VAL_ 149 OBJ_Height_STD_V_2 1 "VALID" 0 "INVALID" ;
VAL_ 149 OBJ_Abs_Long_Velocity_V_2 1 "VALID" 0 "INVALID" ;
VAL_ 149 OBJ_Abs_Long_Vel_STD_V_2 1 "VALID" 0 "INVALID" ;
VAL_ 149 OBJ_Abs_Lat_Velocity_V_2 1 "VALID" 0 "INVALID" ;
VAL_ 149 OBJ_Abs_Lat_Vel_STD_V_2 1 "VALID" 0 "INVALID" ;
VAL_ 149 OBJ_Abs_Long_Acc_V_2 1 "VALID" 0 "INVALID" ;
VAL_ 149 OBJ_Abs_Long_Acc_STD_V_2 1 "VALID" 0 "INVALID" ;
VAL_ 149 OBJ_Abs_Lat_Acc_V_2 1 "VALID" 0 "INVALID" ;
VAL_ 149 OBJ_Abs_Lat_Acc_STD_V_2 1 "VALID" 0 "INVALID" ;
VAL_ 149 OBJ_Abs_Acceleration_V_2 1 "VALID" 0 "INVALID" ;
VAL_ 149 OBJ_Abs_Acc_STD_V_2 1 "VALID" 0 "INVALID" ;
VAL_ 149 OBJ_Inv_TTC_V_2 1 "VALID" 0 "INVALID" ;
VAL_ 149 OBJ_Inv_TTC_STD_V_2 1 "VALID" 0 "INVALID" ;
VAL_ 149 OBJ_Relative_Long_Acc_V_2 1 "VALID" 0 "INVALID" ;
VAL_ 149 OBJ_Rel_Long_Acc_STD_V_2 1 "VALID" 0 "INVALID" ;
VAL_ 150 OBJ_Relative_Long_Velocity_V_2 1 "VALID" 0 "INVALID" ;
VAL_ 150 OBJ_Rel_Long_Vel_STD_V_2 1 "VALID" 0 "INVALID" ;
VAL_ 150 OBJ_Relative_Lat_Velocity_V_2 1 "VALID" 0 "INVALID" ;
VAL_ 150 OBJ_Rel_Lat_Vel_STD_V_2 1 "VALID" 0 "INVALID" ;
VAL_ 150 OBJ_Long_Distance_V_2 1 "VALID" 0 "INVALID" ;
VAL_ 150 OBJ_Long_Distance_STD_V_2 1 "VALID" 0 "INVALID" ;
VAL_ 150 OBJ_Lat_Distance_V_2 1 "VALID" 0 "INVALID" ;
VAL_ 150 OBJ_Lat_Distance_STD_V_2 1 "VALID" 0 "INVALID" ;
VAL_ 150 OBJ_Absolute_Speed_V_2 1 "VALID" 0 "INVALID" ;
VAL_ 150 OBJ_Absolute_Speed_STD_V_2 1 "VALID" 0 "INVALID" ;
VAL_ 150 OBJ_Heading_V_2 1 "VALID" 0 "INVALID" ;
VAL_ 150 OBJ_Heading_STD_V_2 1 "VALID" 0 "INVALID" ;
VAL_ 150 OBJ_Angle_Rate_STD_V_2 1 "VALID" 0 "INVALID" ;
VAL_ 150 OBJ_Angle_Rate_V_2 1 "VALID" 0 "INVALID" ;
VAL_ 150 OBJ_Angle_Right_V_2 1 "VALID" 0 "INVALID" ;
VAL_ 150 OBJ_Angle_Right_STD_V_2 1 "VALID" 0 "INVALID" ;
VAL_ 150 OBJ_Angle_Left_V_2 1 "VALID" 0 "INVALID" ;
VAL_ 150 OBJ_Angle_Left_STD_V_2 1 "VALID" 0 "INVALID" ;
VAL_ 150 OBJ_Angle_Side_V_2 1 "VALID" 0 "INVALID" ;
VAL_ 150 OBJ_Angle_Side_STD_V_2 1 "VALID" 0 "INVALID" ;
VAL_ 150 OBJ_Angle_Mid_V_2 1 "VALID" 0 "INVALID" ;
VAL_ 150 OBJ_Angle_Mid_STD_V_2 1 "VALID" 0 "INVALID" ;
VAL_ 150 OBJ_Angle_Bottom_V_2 1 "VALID" 0 "INVALID" ;
VAL_ 150 OBJ_Angle_Bottom_STD_V_2 1 "VALID" 0 "INVALID" ;
VAL_ 150 OBJ_Visibility_Side_V_2 1 "VALID" 0 "INVALID" ;
VAL_ 150 OBJ_Visibility_Side_2 2 "REAR" 1 "FRONT" 0 "NOT_VISIBLE" ;
VAL_ 150 OBJ_Is_In_Drivable_Area_2 1 "TRUE" 0 "FALSE" ;
VAL_ 150 OBJ_Is_In_Drivable_Area_V_2 1 "VALID" 0 "INVALID" ;
VAL_ 150 OBJ_Is_VeryClose_2 1 "TRUE" 0 "FALSE" ;
VAL_ 150 OBJ_Is_VeryClose_V_2 1 "VALID" 0 "INVALID" ;
VAL_ 147 OBJ_Triggered_SDM_1 2 "NOT_TRIGGERED" 1 "TRIGGERED" 0 "NOT_AVAILABLE" ;
VAL_ 147 OBJ_Motion_Category_1 13 "ONCOMING" 12 "PRECEEDING" 11 "MOVING" 10 "RTAP" 9 "LTAP" 8 "CROSSING" 7 "MOVING_OUT" 6 "MOVING_IN" 5 "CLOSE_CUT_IN" 4 "PASSING_OUT" 3 "PASSING_IN" 2 "PASSING" 1 "UNDEFINED" 0 "INVALID" ;
VAL_ 147 OBJ_Measuring_Status_1 2 "(BIT_2)NOT_VALID_OR_VALID" 1 "(BIT_1)PREDICTED_OR_MEASURED" 0 "(BIT_0)OLD_OR_NEW" ;
VAL_ 147 OBJ_Object_Class_1 8 "UNCERTAIN_VCL" 7 "ANIMAL" 6 "GENERAL_OBJECT" 5 "PEDESTRIAN" 4 "BICYCLE" 3 "MOTOR_BIKE" 2 "TRUCK" 1 "CAR" 0 "INVALID" ;
VAL_ 147 OBJ_Camera_Source_1 11 "PARKING_RIGHT" 10 "PARKING_LEFT" 9 "PARKING_REAR" 8 "PARKING_FRONT" 7 "FRONT_CORNER_RIGHT" 6 "FRONT_CORNER_LEFT" 5 "REAR_CORNER_RIGHT" 4 "REAR_CORNER_LEFT" 3 "REAR" 2 "FRONT_FISHEYE" 1 "FRONT_NARROW" 0 "FRONT_MAIN" ;
VAL_ 147 OBJ_Motion_Status_1 5 "MOVING_SLOWLY" 4 "STOPPED" 3 "STATIONARY" 2 "MOVING" 1 "UNKNOWN" 0 "INVALID" ;
VAL_ 147 OBJ_Motion_Orientation_1 13 "UNKNOWN" 12 "PRECEEDING" 11 "DRIFTING_LEFT" 9 "CROSSING_LEFT" 7 "OC_DRIFTING_LEFT" 6 "ONCOMING" 5 "OC_DRIFTING_RIGHT" 3 "CROSSING_RIGHT" 1 "DRIFTING_RIGHT" 0 "INVALID" ;
VAL_ 147 OBJ_Has_Cut_Lane_1 1 "TRUE" 0 "FALSE" ;
VAL_ 147 OBJ_Has_Cut_Path_1 1 "TRUE" 0 "FALSE" ;
VAL_ 147 OBJ_Brake_Light_1 1 "TRUE" 0 "FALSE" ;
VAL_ 147 OBJ_Turn_Indicator_Right_1 1 "TRUE" 0 "FALSE" ;
VAL_ 147 OBJ_Turn_Indicator_Left_1 1 "TRUE" 0 "FALSE" ;
VAL_ 147 OBJ_Light_Indicator_Validity_1 1 "TRUE" 0 "FALSE" ;
VAL_ 147 OBJ_Right_Out_Of_Image_1 1 "TRUE" 0 "FALSE" ;
VAL_ 147 OBJ_Left_Out_Of_Image_1 1 "TRUE" 0 "FALSE" ;
VAL_ 147 OBJ_Right_Out_Of_Image_V_1 1 "TRUE" 0 "FALSE" ;
VAL_ 147 OBJ_Left_Out_Of_Image_V_1 1 "TRUE" 0 "FALSE" ;
VAL_ 147 OBJ_Top_Out_Of_Image_1 1 "TRUE" 0 "FALSE" ;
VAL_ 147 OBJ_Bottom_Out_Of_Image_1 1 "TRUE" 0 "FALSE" ;
VAL_ 147 OBJ_Top_Out_Of_Image_V_1 1 "VALID" 0 "INVALID" ;
VAL_ 147 OBJ_Bottom_Out_Of_Image_V_1 1 "VALID" 0 "INVALID" ;
VAL_ 147 OBJ_Lane_Assignment_1 5 "RIGHT_RIGHT" 4 "RIGHT" 3 "HOST" 2 "LEFT" 1 "LEFT_LEFT" 0 "UNKNOWN" ;
VAL_ 147 OBJ_Lane_Assignment_V_1 1 "VALID" 0 "INVALID" ;
VAL_ 147 OBJ_Age_Seconds_V_1 1 "VALID" 0 "INVALID" ;
VAL_ 147 OBJ_Width_V_1 1 "VALID" 0 "INVALID" ;
VAL_ 147 OBJ_Width_STD_V_1 1 "VALID" 0 "INVALID" ;
VAL_ 147 OBJ_Length_V_1 1 "VALID" 0 "INVALID" ;
VAL_ 147 OBJ_Length_STD_V_1 1 "VALID" 0 "INVALID" ;
VAL_ 147 OBJ_Height_V_1 1 "VALID" 0 "INVALID" ;
VAL_ 147 OBJ_Height_STD_V_1 1 "VALID" 0 "INVALID" ;
VAL_ 147 OBJ_Abs_Long_Velocity_V_1 1 "VALID" 0 "INVALID" ;
VAL_ 147 OBJ_Abs_Long_Vel_STD_V_1 1 "VALID" 0 "INVALID" ;
VAL_ 147 OBJ_Abs_Lat_Velocity_V_1 1 "VALID" 0 "INVALID" ;
VAL_ 147 OBJ_Abs_Lat_Vel_STD_V_1 1 "VALID" 0 "INVALID" ;
VAL_ 147 OBJ_Abs_Long_Acc_V_1 1 "VALID" 0 "INVALID" ;
VAL_ 147 OBJ_Abs_Long_Acc_STD_V_1 1 "VALID" 0 "INVALID" ;
VAL_ 147 OBJ_Abs_Lat_Acc_V_1 1 "VALID" 0 "INVALID" ;
VAL_ 147 OBJ_Abs_Lat_Acc_STD_V_1 1 "VALID" 0 "INVALID" ;
VAL_ 147 OBJ_Abs_Acceleration_V_1 1 "VALID" 0 "INVALID" ;
VAL_ 147 OBJ_Abs_Acc_STD_V_1 1 "VALID" 0 "INVALID" ;
VAL_ 147 OBJ_Inv_TTC_V_1 1 "VALID" 0 "INVALID" ;
VAL_ 147 OBJ_Inv_TTC_STD_V_1 1 "VALID" 0 "INVALID" ;
VAL_ 147 OBJ_Relative_Long_Acc_V_1 1 "VALID" 0 "INVALID" ;
VAL_ 147 OBJ_Rel_Long_Acc_STD_V_1 1 "VALID" 0 "INVALID" ;
VAL_ 148 OBJ_Relative_Long_Velocity_V_1 1 "VALID" 0 "INVALID" ;
VAL_ 148 OBJ_Rel_Long_Vel_STD_V_1 1 "VALID" 0 "INVALID" ;
VAL_ 148 OBJ_Relative_Lat_Velocity_V_1 1 "VALID" 0 "INVALID" ;
VAL_ 148 OBJ_Rel_Lat_Vel_STD_V_1 1 "VALID" 0 "INVALID" ;
VAL_ 148 OBJ_Long_Distance_V_1 1 "VALID" 0 "INVALID" ;
VAL_ 148 OBJ_Long_Distance_STD_V_1 1 "VALID" 0 "INVALID" ;
VAL_ 148 OBJ_Lat_Distance_V_1 1 "VALID" 0 "INVALID" ;
VAL_ 148 OBJ_Lat_Distance_STD_V_1 1 "VALID" 0 "INVALID" ;
VAL_ 148 OBJ_Absolute_Speed_V_1 1 "VALID" 0 "INVALID" ;
VAL_ 148 OBJ_Absolute_Speed_STD_V_1 1 "VALID" 0 "INVALID" ;
VAL_ 148 OBJ_Heading_V_1 1 "VALID" 0 "INVALID" ;
VAL_ 148 OBJ_Heading_STD_V_1 1 "VALID" 0 "INVALID" ;
VAL_ 148 OBJ_Angle_Rate_STD_V_1 1 "VALID" 0 "INVALID" ;
VAL_ 148 OBJ_Angle_Rate_V_1 1 "VALID" 0 "INVALID" ;
VAL_ 148 OBJ_Angle_Right_V_1 1 "VALID" 0 "INVALID" ;
VAL_ 148 OBJ_Angle_Right_STD_V_1 1 "VALID" 0 "INVALID" ;
VAL_ 148 OBJ_Angle_Left_V_1 1 "VALID" 0 "INVALID" ;
VAL_ 148 OBJ_Angle_Left_STD_V_1 1 "VALID" 0 "INVALID" ;
VAL_ 148 OBJ_Angle_Side_V_1 1 "VALID" 0 "INVALID" ;
VAL_ 148 OBJ_Angle_Side_STD_V_1 1 "VALID" 0 "INVALID" ;
VAL_ 148 OBJ_Angle_Mid_V_1 1 "VALID" 0 "INVALID" ;
VAL_ 148 OBJ_Angle_Mid_STD_V_1 1 "VALID" 0 "INVALID" ;
VAL_ 148 OBJ_Angle_Bottom_V_1 1 "VALID" 0 "INVALID" ;
VAL_ 148 OBJ_Angle_Bottom_STD_V_1 1 "VALID" 0 "INVALID" ;
VAL_ 148 OBJ_Visibility_Side_V_1 1 "VALID" 0 "INVALID" ;
VAL_ 148 OBJ_Visibility_Side_1 2 "REAR" 1 "FRONT" 0 "NOT_VISIBLE" ;
VAL_ 148 OBJ_Is_In_Drivable_Area_1 1 "TRUE" 0 "FALSE" ;
VAL_ 148 OBJ_Is_In_Drivable_Area_V_1 1 "VALID" 0 "INVALID" ;
VAL_ 148 OBJ_Is_VeryClose_1 1 "TRUE" 0 "FALSE" ;
VAL_ 148 OBJ_Is_VeryClose_V_1 1 "VALID" 0 "INVALID" ;
VAL_ 146 OBJ_Relative_Long_Velocity_V_0 1 "VALID" 0 "INVALID" ;
VAL_ 146 OBJ_Rel_Long_Vel_STD_V_0 1 "VALID" 0 "INVALID" ;
VAL_ 146 OBJ_Relative_Lat_Velocity_V_0 1 "VALID" 0 "INVALID" ;
VAL_ 146 OBJ_Rel_Lat_Vel_STD_V_0 1 "VALID" 0 "INVALID" ;
VAL_ 146 OBJ_Long_Distance_V_0 1 "VALID" 0 "INVALID" ;
VAL_ 146 OBJ_Long_Distance_STD_V_0 1 "VALID" 0 "INVALID" ;
VAL_ 146 OBJ_Lat_Distance_V_0 1 "VALID" 0 "INVALID" ;
VAL_ 146 OBJ_Lat_Distance_STD_V_0 1 "VALID" 0 "INVALID" ;
VAL_ 146 OBJ_Absolute_Speed_V_0 1 "VALID" 0 "INVALID" ;
VAL_ 146 OBJ_Absolute_Speed_STD_V_0 1 "VALID" 0 "INVALID" ;
VAL_ 146 OBJ_Heading_V_0 1 "VALID" 0 "INVALID" ;
VAL_ 146 OBJ_Heading_STD_V_0 1 "VALID" 0 "INVALID" ;
VAL_ 146 OBJ_Angle_Rate_STD_V_0 1 "VALID" 0 "INVALID" ;
VAL_ 146 OBJ_Angle_Rate_V_0 1 "VALID" 0 "INVALID" ;
VAL_ 146 OBJ_Angle_Right_V_0 1 "VALID" 0 "INVALID" ;
VAL_ 146 OBJ_Angle_Right_STD_V_0 1 "VALID" 0 "INVALID" ;
VAL_ 146 OBJ_Angle_Left_V_0 1 "VALID" 0 "INVALID" ;
VAL_ 146 OBJ_Angle_Left_STD_V_0 1 "VALID" 0 "INVALID" ;
VAL_ 146 OBJ_Angle_Side_V_0 1 "VALID" 0 "INVALID" ;
VAL_ 146 OBJ_Angle_Side_STD_V_0 1 "VALID" 0 "INVALID" ;
VAL_ 146 OBJ_Angle_Mid_V_0 1 "VALID" 0 "INVALID" ;
VAL_ 146 OBJ_Angle_Mid_STD_V_0 1 "VALID" 0 "INVALID" ;
VAL_ 146 OBJ_Angle_Bottom_V_0 1 "VALID" 0 "INVALID" ;
VAL_ 146 OBJ_Angle_Bottom_STD_V_0 1 "VALID" 0 "INVALID" ;
VAL_ 146 OBJ_Visibility_Side_V_0 1 "VALID" 0 "INVALID" ;
VAL_ 146 OBJ_Visibility_Side_0 2 "REAR" 1 "FRONT" 0 "NOT_VISIBLE" ;
VAL_ 146 OBJ_Is_In_Drivable_Area_0 1 "TRUE" 0 "FALSE" ;
VAL_ 146 OBJ_Is_In_Drivable_Area_V_0 1 "VALID" 0 "INVALID" ;
VAL_ 146 OBJ_Is_VeryClose_0 1 "TRUE" 0 "FALSE" ;
VAL_ 146 OBJ_Is_VeryClose_V_0 1 "VALID" 0 "INVALID" ;
VAL_ 145 OBJ_Triggered_SDM_0 2 "NOT_TRIGGERED" 1 "TRIGGERED" 0 "NOT_AVAILABLE" ;
VAL_ 145 OBJ_Motion_Category_0 13 "ONCOMING" 12 "PRECEEDING" 11 "MOVING" 10 "RTAP" 9 "LTAP" 8 "CROSSING" 7 "MOVING_OUT" 6 "MOVING_IN" 5 "CLOSE_CUT_IN" 4 "PASSING_OUT" 3 "PASSING_IN" 2 "PASSING" 1 "UNDEFINED" 0 "INVALID" ;
VAL_ 145 OBJ_Measuring_Status_0 2 "(BIT_2)NOT_VALID_OR_VALID" 1 "(BIT_1)PREDICTED_OR_MEASURED" 0 "(BIT_0)OLD_OR_NEW" ;
VAL_ 145 OBJ_Object_Class_0 8 "UNCERTAIN_VCL" 7 "ANIMAL" 6 "GENERAL_OBJECT" 5 "PEDESTRIAN" 4 "BICYCLE" 3 "MOTOR_BIKE" 2 "TRUCK" 1 "CAR" 0 "INVALID" ;
VAL_ 145 OBJ_Camera_Source_0 11 "PARKING_RIGHT" 10 "PARKING_LEFT" 9 "PARKING_REAR" 8 "PARKING_FRONT" 7 "FRONT_CORNER_RIGHT" 6 "FRONT_CORNER_LEFT" 5 "REAR_CORNER_RIGHT" 4 "REAR_CORNER_LEFT" 3 "REAR" 2 "FRONT_FISHEYE" 1 "FRONT_NARROW" 0 "FRONT_MAIN" ;
VAL_ 145 OBJ_Motion_Status_0 5 "MOVING_SLOWLY" 4 "STOPPED" 3 "STATIONARY" 2 "MOVING" 1 "UNKNOWN" 0 "INVALID" ;
VAL_ 145 OBJ_Motion_Orientation_0 13 "UNKNOWN" 12 "PRECEEDING" 11 "DRIFTING_LEFT" 9 "CROSSING_LEFT" 7 "OC_DRIFTING_LEFT" 6 "ONCOMING" 5 "OC_DRIFTING_RIGHT" 3 "CROSSING_RIGHT" 1 "DRIFTING_RIGHT" 0 "INVALID" ;
VAL_ 145 OBJ_Has_Cut_Lane_0 1 "TRUE" 0 "FALSE" ;
VAL_ 145 OBJ_Has_Cut_Path_0 1 "TRUE" 0 "FALSE" ;
VAL_ 145 OBJ_Brake_Light_0 1 "TRUE" 0 "FALSE" ;
VAL_ 145 OBJ_Turn_Indicator_Right_0 1 "TRUE" 0 "FALSE" ;
VAL_ 145 OBJ_Turn_Indicator_Left_0 1 "TRUE" 0 "FALSE" ;
VAL_ 145 OBJ_Light_Indicator_Validity_0 1 "TRUE" 0 "FALSE" ;
VAL_ 145 OBJ_Right_Out_Of_Image_0 1 "TRUE" 0 "FALSE" ;
VAL_ 145 OBJ_Left_Out_Of_Image_0 1 "TRUE" 0 "FALSE" ;
VAL_ 145 OBJ_Right_Out_Of_Image_V_0 1 "TRUE" 0 "FALSE" ;
VAL_ 145 OBJ_Left_Out_Of_Image_V_0 1 "TRUE" 0 "FALSE" ;
VAL_ 145 OBJ_Top_Out_Of_Image_0 1 "TRUE" 0 "FALSE" ;
VAL_ 145 OBJ_Bottom_Out_Of_Image_0 1 "TRUE" 0 "FALSE" ;
VAL_ 145 OBJ_Top_Out_Of_Image_V_0 1 "VALID" 0 "INVALID" ;
VAL_ 145 OBJ_Bottom_Out_Of_Image_V_0 1 "VALID" 0 "INVALID" ;
VAL_ 145 OBJ_Lane_Assignment_0 5 "RIGHT_RIGHT" 4 "RIGHT" 3 "HOST" 2 "LEFT" 1 "LEFT_LEFT" 0 "UNKNOWN" ;
VAL_ 145 OBJ_Lane_Assignment_V_0 1 "VALID" 0 "INVALID" ;
VAL_ 145 OBJ_Age_Seconds_V_0 1 "VALID" 0 "INVALID" ;
VAL_ 145 OBJ_Width_V_0 1 "VALID" 0 "INVALID" ;
VAL_ 145 OBJ_Width_STD_V_0 1 "VALID" 0 "INVALID" ;
VAL_ 145 OBJ_Length_V_0 1 "VALID" 0 "INVALID" ;
VAL_ 145 OBJ_Length_STD_V_0 1 "VALID" 0 "INVALID" ;
VAL_ 145 OBJ_Height_V_0 1 "VALID" 0 "INVALID" ;
VAL_ 145 OBJ_Height_STD_V_0 1 "VALID" 0 "INVALID" ;
VAL_ 145 OBJ_Abs_Long_Velocity_V_0 1 "VALID" 0 "INVALID" ;
VAL_ 145 OBJ_Abs_Long_Vel_STD_V_0 1 "VALID" 0 "INVALID" ;
VAL_ 145 OBJ_Abs_Lat_Velocity_V_0 1 "VALID" 0 "INVALID" ;
VAL_ 145 OBJ_Abs_Lat_Vel_STD_V_0 1 "VALID" 0 "INVALID" ;
VAL_ 145 OBJ_Abs_Long_Acc_V_0 1 "VALID" 0 "INVALID" ;
VAL_ 145 OBJ_Abs_Long_Acc_STD_V_0 1 "VALID" 0 "INVALID" ;
VAL_ 145 OBJ_Abs_Lat_Acc_V_0 1 "VALID" 0 "INVALID" ;
VAL_ 145 OBJ_Abs_Lat_Acc_STD_V_0 1 "VALID" 0 "INVALID" ;
VAL_ 145 OBJ_Abs_Acceleration_V_0 1 "VALID" 0 "INVALID" ;
VAL_ 145 OBJ_Abs_Acc_STD_V_0 1 "VALID" 0 "INVALID" ;
VAL_ 145 OBJ_Inv_TTC_V_0 1 "VALID" 0 "INVALID" ;
VAL_ 145 OBJ_Inv_TTC_STD_V_0 1 "VALID" 0 "INVALID" ;
VAL_ 145 OBJ_Relative_Long_Acc_V_0 1 "VALID" 0 "INVALID" ;
VAL_ 145 OBJ_Rel_Long_Acc_STD_V_0 1 "VALID" 0 "INVALID" ;
VAL_ 144 OBJ_VD_CIPV_Lost 2 "LOST_TARGET_FOV_IN" 1 "LOST_TARGET_FOV_OUT" 0 "NO_LOSS" ;
VAL_ 144 OBJ_VD_Allow_Acc 2 "FREE_SPACE_UNKNOWN" 1 "SPACE_NOT_FREE" 0 "FREE_SPACE" ;
VAL_ 144 OBJ_Is_Blocked_Left 1 "TRUE" 0 "FALSE" ;
VAL_ 144 OBJ_Is_Blocked_Right 1 "TRUE" 0 "FALSE" ;
VAL_ 111 LRE_Type_3 5 "PARKING_CARS" 4 "CONES_POLES" 3 "CURB" 2 "ELEVATED_STRUCTURE" 1 "ROAD_EDGE" 0 "UNDECIDED" ;
VAL_ 111 LRE_Prediction_Type_3 4 "(BIT_4)HEADWAY_ORIENTED" 3 "(BIT_3)DIST_BASED_EXTRAPOLATION" 2 "(BIT_2)OVERRIDE" 1 "(BIT_1)OTHER_SIDE" 0 "(BIT_0)OCCLUDED" ;
VAL_ 111 LRE_Side_3 2 "RIGHT" 1 "LEFT" 0 "UNKNOWN" ;
VAL_ 111 LRE_Index_3 3 "RESERVED" 2 "SECOND" 1 "FIRST" 0 "UNKNOWN" ;
VAL_ 110 LRE_Type_2 5 "PARKING_CARS" 4 "CONES_POLES" 3 "CURB" 2 "ELEVATED_STRUCTURE" 1 "ROAD_EDGE" 0 "UNDECIDED" ;
VAL_ 110 LRE_Prediction_Type_2 4 "(BIT_4)HEADWAY_ORIENTED" 3 "(BIT_3)DIST_BASED_EXTRAPOLATION" 2 "(BIT_2)OVERRIDE" 1 "(BIT_1)OTHER_SIDE" 0 "(BIT_0)OCCLUDED" ;
VAL_ 110 LRE_Side_2 2 "RIGHT" 1 "LEFT" 0 "UNKNOWN" ;
VAL_ 110 LRE_Index_2 3 "RESERVED" 2 "SECOND" 1 "FIRST" 0 "UNKNOWN" ;
VAL_ 109 LRE_Type_1 5 "PARKING_CARS" 4 "CONES_POLES" 3 "CURB" 2 "ELEVATED_STRUCTURE" 1 "ROAD_EDGE" 0 "UNDECIDED" ;
VAL_ 109 LRE_Prediction_Type_1 4 "(BIT_4)HEADWAY_ORIENTED" 3 "(BIT_3)DIST_BASED_EXTRAPOLATION" 2 "(BIT_2)OVERRIDE" 1 "(BIT_1)OTHER_SIDE" 0 "(BIT_0)OCCLUDED" ;
VAL_ 109 LRE_Side_1 2 "RIGHT" 1 "LEFT" 0 "UNKNOWN" ;
VAL_ 109 LRE_Index_1 3 "RESERVED" 2 "SECOND" 1 "FIRST" 0 "UNKNOWN" ;
VAL_ 108 LRE_Type_0 5 "PARKING_CARS" 4 "CONES_POLES" 3 "CURB" 2 "ELEVATED_STRUCTURE" 1 "ROAD_EDGE" 0 "UNDECIDED" ;
VAL_ 108 LRE_Prediction_Type_0 4 "(BIT_4)HEADWAY_ORIENTED" 3 "(BIT_3)DIST_BASED_EXTRAPOLATION" 2 "(BIT_2)OVERRIDE" 1 "(BIT_1)OTHER_SIDE" 0 "(BIT_0)OCCLUDED" ;
VAL_ 108 LRE_Side_0 2 "RIGHT" 1 "LEFT" 0 "UNKNOWN" ;
VAL_ 108 LRE_Index_0 3 "RESERVED" 2 "SECOND" 1 "FIRST" 0 "UNKNOWN" ;
VAL_ 104 LAP_INTP_Is_Valid_7 1 "VALID" 0 "NOT_VALID" ;
VAL_ 104 LAP_INTP_Line_Role_7 15 "RESERVED_7" 14 "RESERVED_6" 13 "RESERVED_5" 12 "RESERVED_4" 11 "RESERVED_3" 10 "RESERVED_2" 9 "RESERVED_1" 8 "RIGHT_ROAD_EDGE" 7 "LEFT_ROAD_EDGE" 6 "NEXT_RIGHT__RIGHT_LANEMARK" 5 "NEXT_RIGHT__LEFT_LANEMARK" 4 "NEXT_LEFT__RIGHT_LANEMARK" 3 "NEXT_LEFT__LEFT_LANEMARK" 2 "HOST_RIGHT" 1 "HOST_LEFT" 0 "NONE" ;
VAL_ 104 LAP_INTP_Type_7 1 "MERGE" 0 "SPLIT" ;
VAL_ 104 LAP_INTP_Is_Start_7 1 "START_OF_TRANSITION" 0 "END_OF_TRANSITION" ;
VAL_ 104 LAP_INTP_Is_Valid_8 1 "VALID" 0 "NOT_VALID" ;
VAL_ 104 LAP_INTP_Line_Role_8 15 "RESERVED_7" 14 "RESERVED_6" 13 "RESERVED_5" 12 "RESERVED_4" 11 "RESERVED_3" 10 "RESERVED_2" 9 "RESERVED_1" 8 "RIGHT_ROAD_EDGE" 7 "LEFT_ROAD_EDGE" 6 "NEXT_RIGHT__RIGHT_LANEMARK" 5 "NEXT_RIGHT__LEFT_LANEMARK" 4 "NEXT_LEFT__RIGHT_LANEMARK" 3 "NEXT_LEFT__LEFT_LANEMARK" 2 "HOST_RIGHT" 1 "HOST_LEFT" 0 "NONE" ;
VAL_ 104 LAP_INTP_Type_8 1 "MERGE" 0 "SPLIT" ;
VAL_ 104 LAP_INTP_Is_Start_8 1 "START_OF_TRANSITION" 0 "END_OF_TRANSITION" ;
VAL_ 104 LAP_INTP_Is_Valid_9 1 "VALID" 0 "NOT_VALID" ;
VAL_ 104 LAP_INTP_Line_Role_9 15 "RESERVED_7" 14 "RESERVED_6" 13 "RESERVED_5" 12 "RESERVED_4" 11 "RESERVED_3" 10 "RESERVED_2" 9 "RESERVED_1" 8 "RIGHT_ROAD_EDGE" 7 "LEFT_ROAD_EDGE" 6 "NEXT_RIGHT__RIGHT_LANEMARK" 5 "NEXT_RIGHT__LEFT_LANEMARK" 4 "NEXT_LEFT__RIGHT_LANEMARK" 3 "NEXT_LEFT__LEFT_LANEMARK" 2 "HOST_RIGHT" 1 "HOST_LEFT" 0 "NONE" ;
VAL_ 104 LAP_INTP_Type_9 1 "MERGE" 0 "SPLIT" ;
VAL_ 104 LAP_INTP_Is_Start_9 1 "START_OF_TRANSITION" 0 "END_OF_TRANSITION" ;
VAL_ 104 LAP_INTP_Is_Valid_10 1 "VALID" 0 "NOT_VALID" ;
VAL_ 104 LAP_INTP_Line_Role_10 15 "RESERVED_7" 14 "RESERVED_6" 13 "RESERVED_5" 12 "RESERVED_4" 11 "RESERVED_3" 10 "RESERVED_2" 9 "RESERVED_1" 8 "RIGHT_ROAD_EDGE" 7 "LEFT_ROAD_EDGE" 6 "NEXT_RIGHT__RIGHT_LANEMARK" 5 "NEXT_RIGHT__LEFT_LANEMARK" 4 "NEXT_LEFT__RIGHT_LANEMARK" 3 "NEXT_LEFT__LEFT_LANEMARK" 2 "HOST_RIGHT" 1 "HOST_LEFT" 0 "NONE" ;
VAL_ 104 LAP_INTP_Type_10 1 "MERGE" 0 "SPLIT" ;
VAL_ 104 LAP_INTP_Is_Start_10 1 "START_OF_TRANSITION" 0 "END_OF_TRANSITION" ;
VAL_ 104 LAP_INTP_Is_Valid_11 1 "VALID" 0 "NOT_VALID" ;
VAL_ 104 LAP_INTP_Line_Role_11 15 "RESERVED_7" 14 "RESERVED_6" 13 "RESERVED_5" 12 "RESERVED_4" 11 "RESERVED_3" 10 "RESERVED_2" 9 "RESERVED_1" 8 "RIGHT_ROAD_EDGE" 7 "LEFT_ROAD_EDGE" 6 "NEXT_RIGHT__RIGHT_LANEMARK" 5 "NEXT_RIGHT__LEFT_LANEMARK" 4 "NEXT_LEFT__RIGHT_LANEMARK" 3 "NEXT_LEFT__LEFT_LANEMARK" 2 "HOST_RIGHT" 1 "HOST_LEFT" 0 "NONE" ;
VAL_ 104 LAP_INTP_Type_11 1 "MERGE" 0 "SPLIT" ;
VAL_ 104 LAP_INTP_Is_Start_11 1 "START_OF_TRANSITION" 0 "END_OF_TRANSITION" ;
VAL_ 103 LAP_INTP_Is_Valid_0 1 "VALID" 0 "NOT_VALID" ;
VAL_ 103 LAP_INTP_Line_Role_0 15 "RESERVED_7" 14 "RESERVED_6" 13 "RESERVED_5" 12 "RESERVED_4" 11 "RESERVED_3" 10 "RESERVED_2" 9 "RESERVED_1" 8 "RIGHT_ROAD_EDGE" 7 "LEFT_ROAD_EDGE" 6 "NEXT_RIGHT__RIGHT_LANEMARK" 5 "NEXT_RIGHT__LEFT_LANEMARK" 4 "NEXT_LEFT__RIGHT_LANEMARK" 3 "NEXT_LEFT__LEFT_LANEMARK" 2 "HOST_RIGHT" 1 "HOST_LEFT" 0 "NONE" ;
VAL_ 103 LAP_INTP_Type_0 1 "MERGE" 0 "SPLIT" ;
VAL_ 103 LAP_INTP_Is_Start_0 1 "START_OF_TRANSITION" 0 "END_OF_TRANSITION" ;
VAL_ 103 LAP_INTP_Is_Valid_1 1 "VALID" 0 "NOT_VALID" ;
VAL_ 103 LAP_INTP_Line_Role_1 15 "RESERVED_7" 14 "RESERVED_6" 13 "RESERVED_5" 12 "RESERVED_4" 11 "RESERVED_3" 10 "RESERVED_2" 9 "RESERVED_1" 8 "RIGHT_ROAD_EDGE" 7 "LEFT_ROAD_EDGE" 6 "NEXT_RIGHT__RIGHT_LANEMARK" 5 "NEXT_RIGHT__LEFT_LANEMARK" 4 "NEXT_LEFT__RIGHT_LANEMARK" 3 "NEXT_LEFT__LEFT_LANEMARK" 2 "HOST_RIGHT" 1 "HOST_LEFT" 0 "NONE" ;
VAL_ 103 LAP_INTP_Type_1 1 "MERGE" 0 "SPLIT" ;
VAL_ 103 LAP_INTP_Is_Start_1 1 "START_OF_TRANSITION" 0 "END_OF_TRANSITION" ;
VAL_ 103 LAP_INTP_Is_Valid_2 1 "VALID" 0 "NOT_VALID" ;
VAL_ 103 LAP_INTP_Line_Role_2 15 "RESERVED_7" 14 "RESERVED_6" 13 "RESERVED_5" 12 "RESERVED_4" 11 "RESERVED_3" 10 "RESERVED_2" 9 "RESERVED_1" 8 "RIGHT_ROAD_EDGE" 7 "LEFT_ROAD_EDGE" 6 "NEXT_RIGHT__RIGHT_LANEMARK" 5 "NEXT_RIGHT__LEFT_LANEMARK" 4 "NEXT_LEFT__RIGHT_LANEMARK" 3 "NEXT_LEFT__LEFT_LANEMARK" 2 "HOST_RIGHT" 1 "HOST_LEFT" 0 "NONE" ;
VAL_ 103 LAP_INTP_Type_2 1 "MERGE" 0 "SPLIT" ;
VAL_ 103 LAP_INTP_Is_Start_2 1 "START_OF_TRANSITION" 0 "END_OF_TRANSITION" ;
VAL_ 103 LAP_INTP_Is_Valid_3 1 "VALID" 0 "NOT_VALID" ;
VAL_ 103 LAP_INTP_Line_Role_3 15 "RESERVED_7" 14 "RESERVED_6" 13 "RESERVED_5" 12 "RESERVED_4" 11 "RESERVED_3" 10 "RESERVED_2" 9 "RESERVED_1" 8 "RIGHT_ROAD_EDGE" 7 "LEFT_ROAD_EDGE" 6 "NEXT_RIGHT__RIGHT_LANEMARK" 5 "NEXT_RIGHT__LEFT_LANEMARK" 4 "NEXT_LEFT__RIGHT_LANEMARK" 3 "NEXT_LEFT__LEFT_LANEMARK" 2 "HOST_RIGHT" 1 "HOST_LEFT" 0 "NONE" ;
VAL_ 103 LAP_INTP_Type_3 1 "MERGE" 0 "SPLIT" ;
VAL_ 103 LAP_INTP_Is_Start_3 1 "START_OF_TRANSITION" 0 "END_OF_TRANSITION" ;
VAL_ 103 LAP_INTP_Is_Valid_4 1 "VALID" 0 "NOT_VALID" ;
VAL_ 103 LAP_INTP_Line_Role_4 15 "RESERVED_7" 14 "RESERVED_6" 13 "RESERVED_5" 12 "RESERVED_4" 11 "RESERVED_3" 10 "RESERVED_2" 9 "RESERVED_1" 8 "RIGHT_ROAD_EDGE" 7 "LEFT_ROAD_EDGE" 6 "NEXT_RIGHT__RIGHT_LANEMARK" 5 "NEXT_RIGHT__LEFT_LANEMARK" 4 "NEXT_LEFT__RIGHT_LANEMARK" 3 "NEXT_LEFT__LEFT_LANEMARK" 2 "HOST_RIGHT" 1 "HOST_LEFT" 0 "NONE" ;
VAL_ 103 LAP_INTP_Type_4 1 "MERGE" 0 "SPLIT" ;
VAL_ 103 LAP_INTP_Is_Start_4 1 "START_OF_TRANSITION" 0 "END_OF_TRANSITION" ;
VAL_ 103 LAP_INTP_Is_Valid_5 1 "VALID" 0 "NOT_VALID" ;
VAL_ 103 LAP_INTP_Line_Role_5 15 "RESERVED_7" 14 "RESERVED_6" 13 "RESERVED_5" 12 "RESERVED_4" 11 "RESERVED_3" 10 "RESERVED_2" 9 "RESERVED_1" 8 "RIGHT_ROAD_EDGE" 7 "LEFT_ROAD_EDGE" 6 "NEXT_RIGHT__RIGHT_LANEMARK" 5 "NEXT_RIGHT__LEFT_LANEMARK" 4 "NEXT_LEFT__RIGHT_LANEMARK" 3 "NEXT_LEFT__LEFT_LANEMARK" 2 "HOST_RIGHT" 1 "HOST_LEFT" 0 "NONE" ;
VAL_ 103 LAP_INTP_Type_5 1 "MERGE" 0 "SPLIT" ;
VAL_ 103 LAP_INTP_Is_Start_5 1 "START_OF_TRANSITION" 0 "END_OF_TRANSITION" ;
VAL_ 103 LAP_INTP_Is_Valid_6 1 "VALID" 0 "NOT_VALID" ;
VAL_ 103 LAP_INTP_Line_Role_6 15 "RESERVED_7" 14 "RESERVED_6" 13 "RESERVED_5" 12 "RESERVED_4" 11 "RESERVED_3" 10 "RESERVED_2" 9 "RESERVED_1" 8 "RIGHT_ROAD_EDGE" 7 "LEFT_ROAD_EDGE" 6 "NEXT_RIGHT__RIGHT_LANEMARK" 5 "NEXT_RIGHT__LEFT_LANEMARK" 4 "NEXT_LEFT__RIGHT_LANEMARK" 3 "NEXT_LEFT__LEFT_LANEMARK" 2 "HOST_RIGHT" 1 "HOST_LEFT" 0 "NONE" ;
VAL_ 103 LAP_INTP_Type_6 1 "MERGE" 0 "SPLIT" ;
VAL_ 103 LAP_INTP_Is_Start_6 1 "START_OF_TRANSITION" 0 "END_OF_TRANSITION" ;
VAL_ 102 LAP_Is_Construction_Area 1 "TRUE" 0 "FALSE" ;
VAL_ 102 LAP_INTP_Available 1 "TRUE" 0 "FALSE" ;
VAL_ 102 LAP_Exit_Merge_Available 1 "TRUE" 0 "FALSE" ;
VAL_ 102 LAP_Is_Highway_Merge_Left 1 "TRUE" 0 "FALSE" ;
VAL_ 102 LAP_Is_Highway_Merge_Right 1 "TRUE" 0 "FALSE" ;
VAL_ 102 LAP_Is_Highway_Exit_Left 1 "TRUE" 0 "FALSE" ;
VAL_ 102 LAP_Is_Highway_Exit_Right 1 "TRUE" 0 "FALSE" ;
VAL_ 102 LAP_Vertical_Surface_Available 1 "TRUE" 0 "FALSE" ;
VAL_ 102 LAP_Path_Pred_Available 1 "TRUE" 0 "FALSE" ;
VAL_ 102 LAP_Path_Pred_First_Valid 1 "TRUE" 0 "FALSE" ;
VAL_ 102 LAP_Path_Pred_Second_Valid 1 "TRUE" 0 "FALSE" ;
VAL_ 101 LDW_Line_Valid_Left 1 "TRUE" 0 "FALSE" ;
VAL_ 101 LDW_Line_Valid_Right 1 "TRUE" 0 "FALSE" ;
VAL_ 101 LDW_Warning_Status_Left_0 3 "ACTIVE" 2 "ENABLED" 1 "DISABLED" 0 "SUPPRESSED" ;
VAL_ 101 LDW_Warning_Status_Right_0 3 "ACTIVE" 2 "ENABLED" 1 "DISABLED" 0 "SUPPRESSED" ;
VAL_ 101 LDW_Warning_Status_Left_1 3 "ACTIVE" 2 "ENABLED" 1 "DISABLED" 0 "SUPPRESSED" ;
VAL_ 101 LDW_Warning_Status_Right_1 3 "ACTIVE" 2 "ENABLED" 1 "DISABLED" 0 "SUPPRESSED" ;
VAL_ 101 LDW_Warning_Status_Left_2 3 "ACTIVE" 2 "ENABLED" 1 "DISABLED" 0 "SUPPRESSED" ;
VAL_ 101 LDW_Warning_Status_Right_2 3 "ACTIVE" 2 "ENABLED" 1 "DISABLED" 0 "SUPPRESSED" ;
VAL_ 101 LDW_Warning_Status_Left_3 3 "ACTIVE" 2 "ENABLED" 1 "DISABLED" 0 "SUPPRESSED" ;
VAL_ 101 LDW_Warning_Status_Right_3 3 "ACTIVE" 2 "ENABLED" 1 "DISABLED" 0 "SUPPRESSED" ;
VAL_ 99 LA_Line_Role_2 4 "RIGHT__RIGHT_LANEMARK" 3 "RIGHT__LEFT_LANEMARK" 2 "LEFT__RIGHT_LANEMARK" 1 "LEFT__LEFT_LANEMARK" 0 "NONE" ;
VAL_ 99 LA_DLM_Type_2 5 "UNDECIDED" 4 "DASHED_DASHED" 3 "SOLID_SOLID" 2 "DASHED_SOLID" 1 "SOLID_DASHED" 0 "NOT_DLM" ;
VAL_ 99 LA_Lanemark_Type_2 5 "HOV_LANE" 4 "BOTTS" 3 "DLM" 2 "DASHED" 1 "SOLID" 0 "UNDECIDED" ;
VAL_ 99 LA_Prediction_Source_2 1 "LOSS" 0 "NONE" ;
VAL_ 99 LA_Prediction_Type_2 1 "FULL" 0 "NONE" ;
VAL_ 99 LA_Color_2 3 "BLUE_GREEN" 2 "YELLOW_ORANGE_RED" 1 "WHITE" 0 "UNDECIDED" ;
VAL_ 100 LA_Line_Role_3 4 "RIGHT__RIGHT_LANEMARK" 3 "RIGHT__LEFT_LANEMARK" 2 "LEFT__RIGHT_LANEMARK" 1 "LEFT__LEFT_LANEMARK" 0 "NONE" ;
VAL_ 100 LA_DLM_Type_3 5 "UNDECIDED" 4 "DASHED_DASHED" 3 "SOLID_SOLID" 2 "DASHED_SOLID" 1 "SOLID_DASHED" 0 "NOT_DLM" ;
VAL_ 100 LA_Lanemark_Type_3 5 "HOV_LANE" 4 "BOTTS" 3 "DLM" 2 "DASHED" 1 "SOLID" 0 "UNDECIDED" ;
VAL_ 100 LA_Prediction_Source_3 1 "LOSS" 0 "NONE" ;
VAL_ 100 LA_Prediction_Type_3 1 "FULL" 0 "NONE" ;
VAL_ 100 LA_Color_3 3 "BLUE_GREEN" 2 "YELLOW_ORANGE_RED" 1 "WHITE" 0 "UNDECIDED" ;
VAL_ 98 LA_Line_Role_1 4 "RIGHT__RIGHT_LANEMARK" 3 "RIGHT__LEFT_LANEMARK" 2 "LEFT__RIGHT_LANEMARK" 1 "LEFT__LEFT_LANEMARK" 0 "NONE" ;
VAL_ 98 LA_DLM_Type_1 5 "UNDECIDED" 4 "DASHED_DASHED" 3 "SOLID_SOLID" 2 "DASHED_SOLID" 1 "SOLID_DASHED" 0 "NOT_DLM" ;
VAL_ 98 LA_Lanemark_Type_1 5 "HOV_LANE" 4 "BOTTS" 3 "DLM" 2 "DASHED" 1 "SOLID" 0 "UNDECIDED" ;
VAL_ 98 LA_Prediction_Source_1 1 "LOSS" 0 "NONE" ;
VAL_ 98 LA_Prediction_Type_1 1 "FULL" 0 "NONE" ;
VAL_ 98 LA_Color_1 3 "BLUE_GREEN" 2 "YELLOW_ORANGE_RED" 1 "WHITE" 0 "UNDECIDED" ;
VAL_ 97 LA_Line_Role_0 4 "RIGHT__RIGHT_LANEMARK" 3 "RIGHT__LEFT_LANEMARK" 2 "LEFT__RIGHT_LANEMARK" 1 "LEFT__LEFT_LANEMARK" 0 "NONE" ;
VAL_ 97 LA_DLM_Type_0 5 "UNDECIDED" 4 "DASHED_DASHED" 3 "SOLID_SOLID" 2 "DASHED_SOLID" 1 "SOLID_DASHED" 0 "NOT_DLM" ;
VAL_ 97 LA_Lanemark_Type_0 5 "HOV_LANE" 4 "BOTTS" 3 "DLM" 2 "DASHED" 1 "SOLID" 0 "UNDECIDED" ;
VAL_ 97 LA_Prediction_Source_0 1 "LOSS" 0 "NONE" ;
VAL_ 97 LA_Prediction_Type_0 1 "FULL" 0 "NONE" ;
VAL_ 97 LA_Color_0 3 "BLUE_GREEN" 2 "YELLOW_ORANGE_RED" 1 "WHITE" 0 "UNDECIDED" ;
VAL_ 74 HLB_Reason 18 "(BIT_18)TUNNEL" 17 "(BIT_17)IN_ROUNDABOUT" 16 "(BIT_16)APPROACHING_ROUNDABOUT" 15 "(BIT_15)APPROACHING_JUNCTION" 14 "(BIT_14)IN_BLINKING_TRL_SCENE" 13 "(BIT_13)IN_CURVE" 12 "(BIT_12)IN_VERY_SHARPE_CURVE" 11 "(BIT_11)LIT_NIGHT_ECE" 10 "(BIT_10)LIT_NIGHT_US" 9 "(BIT_9)LIT_NIGHT" 8 "(BIT_8)OBVIOUSLY_BRIGHT_SCENE" 7 "(BIT_7)BRIGHT_SCENE" 6 "(BIT_6)SL_SCENE_GRACE" 5 "(BIT_5)STREET_LIGHTS" 4 "(BIT_4)LOW_SPEED" 3 "(BIT_3)TAIL_LIGHT_GRACE" 2 "(BIT_2)ONCOMING_GRACE" 1 "(BIT_1)ONCOMING" 0 "(BIT_0)TAIL_LIGHT" ;
VAL_ 74 HLB_Decision 2 "LOW" 1 "HIGH" 0 "UNKNOWN" ;
VAL_ 74 HLB_Inactive_Reason 6 "DUSK_DELAY" 5 "DEACTIVATED" 4 "IN_GRACE" 3 "OVER_FLOW" 2 "LOW_DETECTION_RATE" 1 "OBVIOUSLY_BRIGHT" 0 "INVALID_REASON" ;
VAL_ 74 HLB_Running_Mode 3 "HLB_FULL" 2 "HLB_INACTIVE" 1 "HLB_OFF" 0 "INVALID_TYPE" ;
VAL_ 71 COM_Is_HighSpeed_Road 1 "TRUE" 0 "FALSE" ;
VAL_ 71 COM_Is_HighSpeed_Road_V 1 "TRUE" 0 "FALSE" ;
VAL_ 71 COM_Driving_Side 2 "RIGHT" 1 "LEFT" 0 "UNKNOWN" ;
VAL_ 71 COM_Driving_Side_V 1 "TRUE" 0 "FALSE" ;
VAL_ 71 COM_Region_Code 15 "RESERVED_5" 14 "RESERVED_4" 13 "RESERVED_3" 12 "RESERVED_2" 11 "RESERVED_1" 10 "UK" 9 "AUSTRALIA_AND_NZ" 8 "KOREA" 7 "SOUTH_AFRICA" 6 "CHINA" 5 "JAPAN" 4 "CANADA" 3 "USA" 2 "GULF" 1 "EUROPE" 0 "WORLD" ;
VAL_ 71 COM_Region_Code_V 1 "TRUE" 0 "FALSE" ;
VAL_ 71 COM_Exposure_Type 1 "COLOR" 0 "TEXTURE" ;
VAL_ 71 COM_HIL_Mode_Status 1 "ACTIVE" 0 "NOT_ACTIVE" ;
VAL_ 71 COM_DayTime_Indicator 2 "NIGHT" 1 "NA" 0 "DAY" ;
VAL_ 71 COM_Last_Clock_Sync_Error 1 "TRUE" 0 "FALSE" ;
VAL_ 67 Boot_Stage 7 "RESERVED_2" 6 "RESERVED_1" 5 "APP_AUTH_LOADING_RESULT" 4 "DRAM_TEST_RESULT" 3 "DRAM_INIT_TRAINING_RESULT" 2 "BOOT_AUTH_RESULT" 1 "BIST_RESULTS" 0 "RESERVED" ;
VAL_ 66 BOOT_LPDDR4_Temperature_Status 7 "DEVICE_GREATER_85C_025X" 6 "DEVICE_GREATER_85C_05X" 5 "DEVICE_LESS_85C_DEF" 4 "DEVICE_MUCH_LESS_85C_DEF" 3 "DEVICE_MUCH_GREATER_85C_025X" 2 "SDRAM_HIGH_TEMP_EXCEEDED" 1 "SDRAM_LOW_TEMP_EXCEEDED" 0 "85_DEF" ;
VAL_ 66 BOOT_Test_results 15 "RESERVED_4" 14 "RESERVED_3" 13 "RESERVED_2" 12 "RESERVED_1" 11 "AUTHENTICATION_FAILURE" 10 "UNSUPPORTED_EYEQ_VERSION" 9 "FLASH_CRC_OF_FFS" 8 "FLASH_CRC_OF_APPLICATION" 7 "DDR_TEST" 6 "DDR_TEMPERATURE" 5 "DDR_INIT_FINISHED" 4 "FLASH_CRC_OF_BOOT" 3 "PARITY_CHECK" 2 "PLL_INIT_FINISHED" 1 "BIST" 0 "EYEQ_Over_TEMPERATURE" ;
VAL_ 64 APP_Valid_cameras_information 0 "(BIT_0)VALID" ;
VAL_ 64 APP_Valid_second_cam_temp_info 0 "(BIT_0)VALID" ;
VAL_ 64 APP_Camera3_VideoErrorRange 0 "(BIT_0)VALID" ;
VAL_ 64 APP_Camera2_VideoErrorRange 0 "(BIT_0)VALID" ;
VAL_ 64 APP_Camera1_VideoErrorRange 3 "(BIT_3)SPI_SEQ_CONTINUOUS_BIT" 2 "(BIT_2)SPI_SEQ_BIT" 1 "(BIT_1)SPI_CRC_CONTINUOUS_BIT" 0 "(BIT_0)CRC" ;
VAL_ 64 APP_spiErrors 3 "(BIT_3)SPI_SEQ_CONTINUOUS_BIT" 2 "(BIT_2)SPI_SEQ_BIT" 1 "(BIT_1)SPI_CRC_CONTINUOUS_BIT" 0 "(BIT_0)CRC" ;
VAL_ 64 APP_Temperature_DDR 7 "TEMP_RANGE_EVEN_WARMER" 6 "TEMP_RANGE_WARM" 5 "TEMP_COOL" 4 "TEMP_EVEN_COLDER" 3 "ABOVE_85C" 2 "ABOVE_SPEC" 1 "BELOW_SPEC" 0 "RANGE_OK" -1 "TEMP_ERROR" ;
VAL_ 64 APP_Minor_Error 5014 "BM_EM_ERR_FAILED_NB_OPERATION" 5013 "BM_EM_ERR_FAILED_CHECK_VERSIONS" 5012 "BM_EM_ERR_FAILED_INIT_IL" 5011 "BM_EM_ERR_FAILED_CREATE_LOGGER" 5010 "BM_EM_ERR_FAILED_POST_INIT_EP" 5009 "BM_EM_ERR_FAILED_INIT_EP" 5008 "BM_EM_ERR_FAILED_OPEN_BLACKBOX" 5007 "BM_EM_ERR_FAILED_INIT_BB_REG" 5006 "BM_EM_ERR_FAILED_INIT_BB" 5005 "BM_EM_ERR_FAILED_INIT" 5004 "BM_EM_ERR_FAILED_INIT_REGISTRY" 5003 "BM_EM_ERR_FAILED_LOAD_REGISTRY" 5002 "BM_EM_ERR_FAILED_LOAD_SETTING" 5001 "BM_EM_ERROR" 1 "BM_ERROR" 0 "BM_OK" ;
VAL_ 64 APP_Fatal_Error 129 "EDR_WROTE_TO_FLASH" 127 "APP_GVPU_STATE_TERMINAL" 91 "PV_VERIFICATION_ERROR" 90 "PV_GENERAL_ERROR" 83 "APP_DDR_DRIFT_COMPARISON_FAILED" 82 "APP_CPS_STL_FAILED" 81 "PLL_COMPARISON_ERROR" 80 "APP_CAM_PARAMS_CCFT_CRC_FAILED" 70 "APP_PATTERN_TEST" 52 "APP_I2C_TIMEOUT_ERROR" 51 "APP_I2C_CAMERA_SELF_RESET" 50 "APP_I2C_VIDEO_GRAB_FAILED" 30 "APP_GRAB_CAM_FAILED" 22 "APP_INIT_CAMERA_EEPROM" 21 "APP_INIT_CAMERA_INIT" 20 "APP_INIT_FAILED" 11 "APP_CALIBRATION_ERROR" 10 "APP_FS_ERROR" 1 "APP_ERROR" 0 "APP_OK" ;
SIG_GROUP_ 156 ICM_Object_Prot5_B 1 : OBJ_Buffer_5 OBJ_Is_VeryClose_V_5 OBJ_Is_VeryClose_5 OBJ_Is_In_Drivable_Area_V_5 OBJ_Is_In_Drivable_Area_5 OBJ_Visibility_Side_5 OBJ_Visibility_Side_V_5 OBJ_Angle_Bottom_STD_V_5 OBJ_Angle_Bottom_STD_5 OBJ_Angle_Bottom_5 OBJ_Angle_Bottom_V_5 OBJ_Angle_Mid_STD_V_5 OBJ_Angle_Mid_STD_5 OBJ_Angle_Mid_5 OBJ_Angle_Mid_V_5 OBJ_Angle_Side_STD_V_5 OBJ_Angle_Side_STD_5 OBJ_Angle_Side_V_5 OBJ_Angle_Side_5 OBJ_Angle_Left_STD_V_5 OBJ_Angle_Left_STD_5 OBJ_Angle_Left_V_5 OBJ_Angle_Left_5 OBJ_Angle_Right_STD_V_5 OBJ_Angle_Right_STD_5 OBJ_Angle_Right_V_5 OBJ_Angle_Right_5 OBJ_Angle_Rate_V_5 OBJ_Angle_Rate_5 OBJ_Angle_Rate_STD_V_5 OBJ_Angle_Rate_STD_5 OBJ_Heading_STD_V_5 OBJ_Heading_STD_5 OBJ_Heading_V_5 OBJ_Heading_5 OBJ_Absolute_Speed_STD_V_5 OBJ_Absolute_Speed_STD_5 OBJ_Absolute_Speed_V_5 OBJ_Absolute_Speed_5 OBJ_Lat_Distance_STD_V_5 OBJ_Lat_Distance_STD_5 OBJ_Lat_Distance_V_5 OBJ_Lat_Distance_5 OBJ_Long_Distance_STD_V_5 OBJ_Long_Distance_STD_5 OBJ_Long_Distance_V_5 OBJ_Long_Distance_5 OBJ_Rel_Lat_Vel_STD_V_5 OBJ_Relative_Lat_Velocity_STD_5 OBJ_Relative_Lat_Velocity_V_5 OBJ_Relative_Lat_Velocity_5 OBJ_Rel_Long_Vel_STD_V_5 OBJ_Relative_Long_Vel_STD_5 OBJ_Relative_Long_Velocity_V_5 OBJ_Relative_Long_Velocity_5 ICM_Object_Prot5_B_Header;
SIG_GROUP_ 155 ICM_Object_Prot5_A 1 : OBJ_Rel_Long_Acc_STD_V_5 OBJ_Relative_Long_Acc_STD_5 OBJ_Relative_Long_Acc_V_5 OBJ_Relative_Long_Acc_5 OBJ_Inv_TTC_STD_V_5 OBJ_Inv_TTC_STD_5 OBJ_Inv_TTC_V_5 OBJ_Inv_TTC_5 OBJ_Abs_Acc_STD_V_5 OBJ_Abs_Acc_STD_5 OBJ_Abs_Acceleration_V_5 OBJ_Abs_Acceleration_5 OBJ_Abs_Lat_Acc_STD_V_5 OBJ_Abs_Lat_Acc_STD_5 OBJ_Abs_Lat_Acc_V_5 OBJ_Abs_Lat_Acc_5 OBJ_Abs_Long_Acc_STD_V_5 OBJ_Abs_Long_Acc_STD_5 OBJ_Abs_Long_Acc_V_5 OBJ_Abs_Long_Acc_5 OBJ_Abs_Lat_Vel_STD_V_5 OBJ_Abs_Lat_Velocity_STD_5 OBJ_Abs_Lat_Velocity_V_5 OBJ_Abs_Lat_Velocity_5 OBJ_Abs_Long_Vel_STD_V_5 OBJ_Abs_Long_Velocity_STD_5 OBJ_Abs_Long_Velocity_V_5 OBJ_Abs_Long_Velocity_5 OBJ_Height_STD_V_5 OBJ_Height_STD_5 OBJ_Height_V_5 OBJ_Height_5 OBJ_Length_STD_V_5 OBJ_Length_STD_5 OBJ_Length_V_5 OBJ_Length_5 OBJ_Width_STD_V_5 OBJ_Width_STD_5 OBJ_Width_V_5 OBJ_Width_5 OBJ_Age_Seconds_V_5 OBJ_Age_Seconds_5 OBJ_Lane_Assignment_V_5 OBJ_Lane_Assignment_5 OBJ_Bottom_Out_Of_Image_V_5 OBJ_Top_Out_Of_Image_V_5 OBJ_Bottom_Out_Of_Image_5 OBJ_Top_Out_Of_Image_5 OBJ_Left_Out_Of_Image_V_5 OBJ_Right_Out_Of_Image_V_5 OBJ_Left_Out_Of_Image_5 OBJ_Right_Out_Of_Image_5 OBJ_Light_Indicator_Validity_5 OBJ_Turn_Indicator_Left_5 OBJ_Turn_Indicator_Right_5 OBJ_Brake_Light_5 OBJ_Has_Cut_Path_5 OBJ_Has_Cut_Lane_5 OBJ_Motion_Orientation_5 OBJ_Motion_Status_5 OBJ_Camera_Source_5 OBJ_Bike_Probability_5 OBJ_Truck_Probability_5 OBJ_Car_Probability_5 OBJ_Class_Probability_5 OBJ_Object_Class_5 OBJ_Measuring_Status_5 OBJ_Object_Age_5 OBJ_Moving_IN_Probability_5 OBJ_Motion_Category_5 OBJ_Triggered_SDM_5 OBJ_Fusion_Source_5 OBJ_Existence_Probability_5 OBJ_ID_5 OBJ_CRC_5 ICM_Object_Prot5_A_Header;
SIG_GROUP_ 154 ICM_Object_Prot4_B 1 : OBJ_Buffer_4 OBJ_Is_VeryClose_V_4 OBJ_Is_VeryClose_4 OBJ_Is_In_Drivable_Area_V_4 OBJ_Is_In_Drivable_Area_4 OBJ_Visibility_Side_4 OBJ_Visibility_Side_V_4 OBJ_Angle_Bottom_STD_V_4 OBJ_Angle_Bottom_STD_4 OBJ_Angle_Bottom_4 OBJ_Angle_Bottom_V_4 OBJ_Angle_Mid_STD_V_4 OBJ_Angle_Mid_STD_4 OBJ_Angle_Mid_4 OBJ_Angle_Mid_V_4 OBJ_Angle_Side_STD_V_4 OBJ_Angle_Side_STD_4 OBJ_Angle_Side_V_4 OBJ_Angle_Side_4 OBJ_Angle_Left_STD_V_4 OBJ_Angle_Left_STD_4 OBJ_Angle_Left_V_4 OBJ_Angle_Left_4 OBJ_Angle_Right_STD_V_4 OBJ_Angle_Right_STD_4 OBJ_Angle_Right_V_4 OBJ_Angle_Right_4 OBJ_Angle_Rate_V_4 OBJ_Angle_Rate_4 OBJ_Angle_Rate_STD_V_4 OBJ_Angle_Rate_STD_4 OBJ_Heading_STD_V_4 OBJ_Heading_STD_4 OBJ_Heading_V_4 OBJ_Heading_4 OBJ_Absolute_Speed_STD_V_4 OBJ_Absolute_Speed_STD_4 OBJ_Absolute_Speed_V_4 OBJ_Absolute_Speed_4 OBJ_Lat_Distance_STD_V_4 OBJ_Lat_Distance_STD_4 OBJ_Lat_Distance_V_4 OBJ_Lat_Distance_4 OBJ_Long_Distance_STD_V_4 OBJ_Long_Distance_STD_4 OBJ_Long_Distance_V_4 OBJ_Long_Distance_4 OBJ_Rel_Lat_Vel_STD_V_4 OBJ_Relative_Lat_Velocity_STD_4 OBJ_Relative_Lat_Velocity_V_4 OBJ_Relative_Lat_Velocity_4 OBJ_Rel_Long_Vel_STD_V_4 OBJ_Relative_Long_Vel_STD_4 OBJ_Relative_Long_Velocity_V_4 OBJ_Relative_Long_Velocity_4 ICM_Object_Prot4_B_Header;
SIG_GROUP_ 153 ICM_Object_Prot4_A 1 : OBJ_Rel_Long_Acc_STD_V_4 OBJ_Relative_Long_Acc_STD_4 OBJ_Relative_Long_Acc_V_4 OBJ_Relative_Long_Acc_4 OBJ_Inv_TTC_STD_V_4 OBJ_Inv_TTC_STD_4 OBJ_Inv_TTC_V_4 OBJ_Inv_TTC_4 OBJ_Abs_Acc_STD_V_4 OBJ_Abs_Acc_STD_4 OBJ_Abs_Acceleration_V_4 OBJ_Abs_Acceleration_4 OBJ_Abs_Lat_Acc_STD_V_4 OBJ_Abs_Lat_Acc_STD_4 OBJ_Abs_Lat_Acc_V_4 OBJ_Abs_Lat_Acc_4 OBJ_Abs_Long_Acc_STD_V_4 OBJ_Abs_Long_Acc_STD_4 OBJ_Abs_Long_Acc_V_4 OBJ_Abs_Long_Acc_4 OBJ_Abs_Lat_Vel_STD_V_4 OBJ_Abs_Lat_Velocity_STD_4 OBJ_Abs_Lat_Velocity_V_4 OBJ_Abs_Lat_Velocity_4 OBJ_Abs_Long_Vel_STD_V_4 OBJ_Abs_Long_Velocity_STD_4 OBJ_Abs_Long_Velocity_V_4 OBJ_Abs_Long_Velocity_4 OBJ_Height_STD_V_4 OBJ_Height_STD_4 OBJ_Height_V_4 OBJ_Height_4 OBJ_Length_STD_V_4 OBJ_Length_STD_4 OBJ_Length_V_4 OBJ_Length_4 OBJ_Width_STD_V_4 OBJ_Width_STD_4 OBJ_Width_V_4 OBJ_Width_4 OBJ_Age_Seconds_V_4 OBJ_Age_Seconds_4 OBJ_Lane_Assignment_V_4 OBJ_Lane_Assignment_4 OBJ_Bottom_Out_Of_Image_V_4 OBJ_Top_Out_Of_Image_V_4 OBJ_Bottom_Out_Of_Image_4 OBJ_Top_Out_Of_Image_4 OBJ_Left_Out_Of_Image_V_4 OBJ_Right_Out_Of_Image_V_4 OBJ_Left_Out_Of_Image_4 OBJ_Right_Out_Of_Image_4 OBJ_Light_Indicator_Validity_4 OBJ_Turn_Indicator_Left_4 OBJ_Turn_Indicator_Right_4 OBJ_Brake_Light_4 OBJ_Has_Cut_Path_4 OBJ_Has_Cut_Lane_4 OBJ_Motion_Orientation_4 OBJ_Motion_Status_4 OBJ_Camera_Source_4 OBJ_Bike_Probability_4 OBJ_Truck_Probability_4 OBJ_Car_Probability_4 OBJ_Class_Probability_4 OBJ_Object_Class_4 OBJ_Measuring_Status_4 OBJ_Object_Age_4 OBJ_Moving_IN_Probability_4 OBJ_Motion_Category_4 OBJ_Triggered_SDM_4 OBJ_Fusion_Source_4 OBJ_Existence_Probability_4 OBJ_ID_4 OBJ_CRC_4 ICM_Object_Prot4_A_Header;
SIG_GROUP_ 152 ICM_Object_Prot3_B 1 : OBJ_Buffer_3 OBJ_Is_VeryClose_V_3 OBJ_Is_VeryClose_3 OBJ_Is_In_Drivable_Area_V_3 OBJ_Is_In_Drivable_Area_3 OBJ_Visibility_Side_3 OBJ_Visibility_Side_V_3 OBJ_Angle_Bottom_STD_V_3 OBJ_Angle_Bottom_STD_3 OBJ_Angle_Bottom_3 OBJ_Angle_Bottom_V_3 OBJ_Angle_Mid_STD_V_3 OBJ_Angle_Mid_STD_3 OBJ_Angle_Mid_3 OBJ_Angle_Mid_V_3 OBJ_Angle_Side_STD_V_3 OBJ_Angle_Side_STD_3 OBJ_Angle_Side_V_3 OBJ_Angle_Side_3 OBJ_Angle_Left_STD_V_3 OBJ_Angle_Left_STD_3 OBJ_Angle_Left_V_3 OBJ_Angle_Left_3 OBJ_Angle_Right_STD_V_3 OBJ_Angle_Right_STD_3 OBJ_Angle_Right_V_3 OBJ_Angle_Right_3 OBJ_Angle_Rate_V_3 OBJ_Angle_Rate_3 OBJ_Angle_Rate_STD_V_3 OBJ_Angle_Rate_STD_3 OBJ_Heading_STD_V_3 OBJ_Heading_STD_3 OBJ_Heading_V_3 OBJ_Heading_3 OBJ_Absolute_Speed_STD_V_3 OBJ_Absolute_Speed_STD_3 OBJ_Absolute_Speed_V_3 OBJ_Absolute_Speed_3 OBJ_Lat_Distance_STD_V_3 OBJ_Lat_Distance_STD_3 OBJ_Lat_Distance_V_3 OBJ_Lat_Distance_3 OBJ_Long_Distance_STD_V_3 OBJ_Long_Distance_STD_3 OBJ_Long_Distance_V_3 OBJ_Long_Distance_3 OBJ_Rel_Lat_Vel_STD_V_3 OBJ_Relative_Lat_Velocity_STD_3 OBJ_Relative_Lat_Velocity_V_3 OBJ_Relative_Lat_Velocity_3 OBJ_Rel_Long_Vel_STD_V_3 OBJ_Relative_Long_Vel_STD_3 OBJ_Relative_Long_Velocity_V_3 OBJ_Relative_Long_Velocity_3 ICM_Object_Prot3_B_Header;
SIG_GROUP_ 151 ICM_Object_Prot3_A 1 : OBJ_Rel_Long_Acc_STD_V_3 OBJ_Relative_Long_Acc_STD_3 OBJ_Relative_Long_Acc_V_3 OBJ_Relative_Long_Acc_3 OBJ_Inv_TTC_STD_V_3 OBJ_Inv_TTC_STD_3 OBJ_Inv_TTC_V_3 OBJ_Inv_TTC_3 OBJ_Abs_Acc_STD_V_3 OBJ_Abs_Acc_STD_3 OBJ_Abs_Acceleration_V_3 OBJ_Abs_Acceleration_3 OBJ_Abs_Lat_Acc_STD_V_3 OBJ_Abs_Lat_Acc_STD_3 OBJ_Abs_Lat_Acc_V_3 OBJ_Abs_Lat_Acc_3 OBJ_Abs_Long_Acc_STD_V_3 OBJ_Abs_Long_Acc_STD_3 OBJ_Abs_Long_Acc_V_3 OBJ_Abs_Long_Acc_3 OBJ_Abs_Lat_Vel_STD_V_3 OBJ_Abs_Lat_Velocity_STD_3 OBJ_Abs_Lat_Velocity_V_3 OBJ_Abs_Lat_Velocity_3 OBJ_Abs_Long_Vel_STD_V_3 OBJ_Abs_Long_Velocity_STD_3 OBJ_Abs_Long_Velocity_V_3 OBJ_Abs_Long_Velocity_3 OBJ_Height_STD_V_3 OBJ_Height_STD_3 OBJ_Height_V_3 OBJ_Height_3 OBJ_Length_STD_V_3 OBJ_Length_STD_3 OBJ_Length_V_3 OBJ_Length_3 OBJ_Width_STD_V_3 OBJ_Width_STD_3 OBJ_Width_V_3 OBJ_Width_3 OBJ_Age_Seconds_V_3 OBJ_Age_Seconds_3 OBJ_Lane_Assignment_V_3 OBJ_Lane_Assignment_3 OBJ_Bottom_Out_Of_Image_V_3 OBJ_Top_Out_Of_Image_V_3 OBJ_Bottom_Out_Of_Image_3 OBJ_Top_Out_Of_Image_3 OBJ_Left_Out_Of_Image_V_3 OBJ_Right_Out_Of_Image_V_3 OBJ_Left_Out_Of_Image_3 OBJ_Right_Out_Of_Image_3 OBJ_Light_Indicator_Validity_3 OBJ_Turn_Indicator_Left_3 OBJ_Turn_Indicator_Right_3 OBJ_Brake_Light_3 OBJ_Has_Cut_Path_3 OBJ_Has_Cut_Lane_3 OBJ_Motion_Orientation_3 OBJ_Motion_Status_3 OBJ_Camera_Source_3 OBJ_Bike_Probability_3 OBJ_Truck_Probability_3 OBJ_Car_Probability_3 OBJ_Class_Probability_3 OBJ_Object_Class_3 OBJ_Measuring_Status_3 OBJ_Object_Age_3 OBJ_Moving_IN_Probability_3 OBJ_Motion_Category_3 OBJ_Triggered_SDM_3 OBJ_Fusion_Source_3 OBJ_Existence_Probability_3 OBJ_ID_3 OBJ_CRC_3 ICM_Object_Prot3_A_Header;
SIG_GROUP_ 149 ICM_Object_Prot2_A 1 : OBJ_Rel_Long_Acc_STD_V_2 OBJ_Relative_Long_Acc_STD_2 OBJ_Relative_Long_Acc_V_2 OBJ_Relative_Long_Acc_2 OBJ_Inv_TTC_STD_V_2 OBJ_Inv_TTC_STD_2 OBJ_Inv_TTC_V_2 OBJ_Inv_TTC_2 OBJ_Abs_Acc_STD_V_2 OBJ_Abs_Acc_STD_2 OBJ_Abs_Acceleration_V_2 OBJ_Abs_Acceleration_2 OBJ_Abs_Lat_Acc_STD_V_2 OBJ_Abs_Lat_Acc_STD_2 OBJ_Abs_Lat_Acc_V_2 OBJ_Abs_Lat_Acc_2 OBJ_Abs_Long_Acc_STD_V_2 OBJ_Abs_Long_Acc_STD_2 OBJ_Abs_Long_Acc_V_2 OBJ_Abs_Long_Acc_2 OBJ_Abs_Lat_Vel_STD_V_2 OBJ_Abs_Lat_Velocity_STD_2 OBJ_Abs_Lat_Velocity_V_2 OBJ_Abs_Lat_Velocity_2 OBJ_Abs_Long_Vel_STD_V_2 OBJ_Abs_Long_Velocity_STD_2 OBJ_Abs_Long_Velocity_V_2 OBJ_Abs_Long_Velocity_2 OBJ_Height_STD_V_2 OBJ_Height_STD_2 OBJ_Height_V_2 OBJ_Height_2 OBJ_Length_STD_V_2 OBJ_Length_STD_2 OBJ_Length_V_2 OBJ_Length_2 OBJ_Width_STD_V_2 OBJ_Width_STD_2 OBJ_Width_V_2 OBJ_Width_2 OBJ_Age_Seconds_V_2 OBJ_Age_Seconds_2 OBJ_Lane_Assignment_V_2 OBJ_Lane_Assignment_2 OBJ_Bottom_Out_Of_Image_V_2 OBJ_Top_Out_Of_Image_V_2 OBJ_Bottom_Out_Of_Image_2 OBJ_Top_Out_Of_Image_2 OBJ_Left_Out_Of_Image_V_2 OBJ_Right_Out_Of_Image_V_2 OBJ_Left_Out_Of_Image_2 OBJ_Right_Out_Of_Image_2 OBJ_Light_Indicator_Validity_2 OBJ_Turn_Indicator_Left_2 OBJ_Turn_Indicator_Right_2 OBJ_Brake_Light_2 OBJ_Has_Cut_Path_2 OBJ_Has_Cut_Lane_2 OBJ_Motion_Orientation_2 OBJ_Motion_Status_2 OBJ_Camera_Source_2 OBJ_Bike_Probability_2 OBJ_Truck_Probability_2 OBJ_Car_Probability_2 OBJ_Class_Probability_2 OBJ_Object_Class_2 OBJ_Measuring_Status_2 OBJ_Object_Age_2 OBJ_Moving_IN_Probability_2 OBJ_Motion_Category_2 OBJ_Triggered_SDM_2 OBJ_Fusion_Source_2 OBJ_Existence_Probability_2 OBJ_ID_2 OBJ_CRC_2 ICM_Object_Prot2_A_Header;
SIG_GROUP_ 150 ICM_Object_Prot2_B 1 : OBJ_Buffer_2 OBJ_Is_VeryClose_V_2 OBJ_Is_VeryClose_2 OBJ_Is_In_Drivable_Area_V_2 OBJ_Is_In_Drivable_Area_2 OBJ_Visibility_Side_2 OBJ_Visibility_Side_V_2 OBJ_Angle_Bottom_STD_V_2 OBJ_Angle_Bottom_STD_2 OBJ_Angle_Bottom_2 OBJ_Angle_Bottom_V_2 OBJ_Angle_Mid_STD_V_2 OBJ_Angle_Mid_STD_2 OBJ_Angle_Mid_2 OBJ_Angle_Mid_V_2 OBJ_Angle_Side_STD_V_2 OBJ_Angle_Side_STD_2 OBJ_Angle_Side_V_2 OBJ_Angle_Side_2 OBJ_Angle_Left_STD_V_2 OBJ_Angle_Left_STD_2 OBJ_Angle_Left_V_2 OBJ_Angle_Left_2 OBJ_Angle_Right_STD_V_2 OBJ_Angle_Right_STD_2 OBJ_Angle_Right_V_2 OBJ_Angle_Right_2 OBJ_Angle_Rate_V_2 OBJ_Angle_Rate_2 OBJ_Angle_Rate_STD_V_2 OBJ_Angle_Rate_STD_2 OBJ_Heading_STD_V_2 OBJ_Heading_STD_2 OBJ_Heading_V_2 OBJ_Heading_2 OBJ_Absolute_Speed_STD_V_2 OBJ_Absolute_Speed_STD_2 OBJ_Absolute_Speed_V_2 OBJ_Absolute_Speed_2 OBJ_Lat_Distance_STD_V_2 OBJ_Lat_Distance_STD_2 OBJ_Lat_Distance_V_2 OBJ_Lat_Distance_2 OBJ_Long_Distance_STD_V_2 OBJ_Long_Distance_STD_2 OBJ_Long_Distance_V_2 OBJ_Long_Distance_2 OBJ_Rel_Lat_Vel_STD_V_2 OBJ_Relative_Lat_Velocity_STD_2 OBJ_Relative_Lat_Velocity_V_2 OBJ_Relative_Lat_Velocity_2 OBJ_Rel_Long_Vel_STD_V_2 OBJ_Relative_Long_Vel_STD_2 OBJ_Relative_Long_Velocity_V_2 OBJ_Relative_Long_Velocity_2 ICM_Object_Prot2_B_Header;
SIG_GROUP_ 147 ICM_Object_Prot1_A 1 : OBJ_Rel_Long_Acc_STD_V_1 OBJ_Relative_Long_Acc_STD_1 OBJ_Relative_Long_Acc_V_1 OBJ_Relative_Long_Acc_1 OBJ_Inv_TTC_STD_V_1 OBJ_Inv_TTC_STD_1 OBJ_Inv_TTC_V_1 OBJ_Inv_TTC_1 OBJ_Abs_Acc_STD_V_1 OBJ_Abs_Acc_STD_1 OBJ_Abs_Acceleration_V_1 OBJ_Abs_Acceleration_1 OBJ_Abs_Lat_Acc_STD_V_1 OBJ_Abs_Lat_Acc_STD_1 OBJ_Abs_Lat_Acc_V_1 OBJ_Abs_Lat_Acc_1 OBJ_Abs_Long_Acc_STD_V_1 OBJ_Abs_Long_Acc_STD_1 OBJ_Abs_Long_Acc_V_1 OBJ_Abs_Long_Acc_1 OBJ_Abs_Lat_Vel_STD_V_1 OBJ_Abs_Lat_Velocity_STD_1 OBJ_Abs_Lat_Velocity_V_1 OBJ_Abs_Lat_Velocity_1 OBJ_Abs_Long_Vel_STD_V_1 OBJ_Abs_Long_Velocity_STD_1 OBJ_Abs_Long_Velocity_V_1 OBJ_Abs_Long_Velocity_1 OBJ_Height_STD_V_1 OBJ_Height_STD_1 OBJ_Height_V_1 OBJ_Height_1 OBJ_Length_STD_V_1 OBJ_Length_STD_1 OBJ_Length_V_1 OBJ_Length_1 OBJ_Width_STD_V_1 OBJ_Width_STD_1 OBJ_Width_V_1 OBJ_Width_1 OBJ_Age_Seconds_V_1 OBJ_Age_Seconds_1 OBJ_Lane_Assignment_V_1 OBJ_Lane_Assignment_1 OBJ_Bottom_Out_Of_Image_V_1 OBJ_Top_Out_Of_Image_V_1 OBJ_Bottom_Out_Of_Image_1 OBJ_Top_Out_Of_Image_1 OBJ_Left_Out_Of_Image_V_1 OBJ_Right_Out_Of_Image_V_1 OBJ_Left_Out_Of_Image_1 OBJ_Right_Out_Of_Image_1 OBJ_Light_Indicator_Validity_1 OBJ_Turn_Indicator_Left_1 OBJ_Turn_Indicator_Right_1 OBJ_Brake_Light_1 OBJ_Has_Cut_Path_1 OBJ_Has_Cut_Lane_1 OBJ_Motion_Orientation_1 OBJ_Motion_Status_1 OBJ_Camera_Source_1 OBJ_Bike_Probability_1 OBJ_Truck_Probability_1 OBJ_Car_Probability_1 OBJ_Class_Probability_1 OBJ_Object_Class_1 OBJ_Measuring_Status_1 OBJ_Object_Age_1 OBJ_Moving_IN_Probability_1 OBJ_Motion_Category_1 OBJ_Triggered_SDM_1 OBJ_Fusion_Source_1 OBJ_Existence_Probability_1 OBJ_ID_1 OBJ_CRC_1 ICM_Object_Prot1_A_Header;
SIG_GROUP_ 148 ICM_Object_Prot1_B 1 : OBJ_Buffer_1 OBJ_Is_VeryClose_V_1 OBJ_Is_VeryClose_1 OBJ_Is_In_Drivable_Area_V_1 OBJ_Is_In_Drivable_Area_1 OBJ_Visibility_Side_1 OBJ_Visibility_Side_V_1 OBJ_Angle_Bottom_STD_V_1 OBJ_Angle_Bottom_STD_1 OBJ_Angle_Bottom_1 OBJ_Angle_Bottom_V_1 OBJ_Angle_Mid_STD_V_1 OBJ_Angle_Mid_STD_1 OBJ_Angle_Mid_1 OBJ_Angle_Mid_V_1 OBJ_Angle_Side_STD_V_1 OBJ_Angle_Side_STD_1 OBJ_Angle_Side_V_1 OBJ_Angle_Side_1 OBJ_Angle_Left_STD_V_1 OBJ_Angle_Left_STD_1 OBJ_Angle_Left_V_1 OBJ_Angle_Left_1 OBJ_Angle_Right_STD_V_1 OBJ_Angle_Right_STD_1 OBJ_Angle_Right_V_1 OBJ_Angle_Right_1 OBJ_Angle_Rate_V_1 OBJ_Angle_Rate_1 OBJ_Angle_Rate_STD_V_1 OBJ_Angle_Rate_STD_1 OBJ_Heading_STD_V_1 OBJ_Heading_STD_1 OBJ_Heading_V_1 OBJ_Heading_1 OBJ_Absolute_Speed_STD_V_1 OBJ_Absolute_Speed_STD_1 OBJ_Absolute_Speed_V_1 OBJ_Absolute_Speed_1 OBJ_Lat_Distance_STD_V_1 OBJ_Lat_Distance_STD_1 OBJ_Lat_Distance_V_1 OBJ_Lat_Distance_1 OBJ_Long_Distance_STD_V_1 OBJ_Long_Distance_STD_1 OBJ_Long_Distance_V_1 OBJ_Long_Distance_1 OBJ_Rel_Lat_Vel_STD_V_1 OBJ_Relative_Lat_Velocity_STD_1 OBJ_Relative_Lat_Velocity_V_1 OBJ_Relative_Lat_Velocity_1 OBJ_Rel_Long_Vel_STD_V_1 OBJ_Relative_Long_Vel_STD_1 OBJ_Relative_Long_Velocity_V_1 OBJ_Relative_Long_Velocity_1 ICM_Object_Prot1_B_Header;
SIG_GROUP_ 146 ICM_Object_Prot0_B 1 : OBJ_Buffer_0 OBJ_Is_VeryClose_V_0 OBJ_Is_VeryClose_0 OBJ_Is_In_Drivable_Area_V_0 OBJ_Is_In_Drivable_Area_0 OBJ_Visibility_Side_0 OBJ_Visibility_Side_V_0 OBJ_Angle_Bottom_STD_V_0 OBJ_Angle_Bottom_STD_0 OBJ_Angle_Bottom_0 OBJ_Angle_Bottom_V_0 OBJ_Angle_Mid_STD_V_0 OBJ_Angle_Mid_STD_0 OBJ_Angle_Mid_0 OBJ_Angle_Mid_V_0 OBJ_Angle_Side_STD_V_0 OBJ_Angle_Side_STD_0 OBJ_Angle_Side_V_0 OBJ_Angle_Side_0 OBJ_Angle_Left_STD_V_0 OBJ_Angle_Left_STD_0 OBJ_Angle_Left_V_0 OBJ_Angle_Left_0 OBJ_Angle_Right_STD_V_0 OBJ_Angle_Right_STD_0 OBJ_Angle_Right_V_0 OBJ_Angle_Right_0 OBJ_Angle_Rate_V_0 OBJ_Angle_Rate_0 OBJ_Angle_Rate_STD_V_0 OBJ_Angle_Rate_STD_0 OBJ_Heading_STD_V_0 OBJ_Heading_STD_0 OBJ_Heading_V_0 OBJ_Heading_0 OBJ_Absolute_Speed_STD_V_0 OBJ_Absolute_Speed_STD_0 OBJ_Absolute_Speed_V_0 OBJ_Absolute_Speed_0 OBJ_Lat_Distance_STD_V_0 OBJ_Lat_Distance_STD_0 OBJ_Lat_Distance_V_0 OBJ_Lat_Distance_0 OBJ_Long_Distance_STD_V_0 OBJ_Long_Distance_STD_0 OBJ_Long_Distance_V_0 OBJ_Long_Distance_0 OBJ_Rel_Lat_Vel_STD_V_0 OBJ_Relative_Lat_Velocity_STD_0 OBJ_Relative_Lat_Velocity_V_0 OBJ_Relative_Lat_Velocity_0 OBJ_Rel_Long_Vel_STD_V_0 OBJ_Relative_Long_Vel_STD_0 OBJ_Relative_Long_Velocity_V_0 OBJ_Relative_Long_Velocity_0 ICM_Object_Prot0_B_Header;
SIG_GROUP_ 145 ICM_Object_Prot0_A 1 : OBJ_Rel_Long_Acc_STD_V_0 OBJ_Relative_Long_Acc_STD_0 OBJ_Relative_Long_Acc_V_0 OBJ_Relative_Long_Acc_0 OBJ_Inv_TTC_STD_V_0 OBJ_Inv_TTC_STD_0 OBJ_Inv_TTC_V_0 OBJ_Inv_TTC_0 OBJ_Abs_Acc_STD_V_0 OBJ_Abs_Acc_STD_0 OBJ_Abs_Acceleration_V_0 OBJ_Abs_Acceleration_0 OBJ_Abs_Lat_Acc_STD_V_0 OBJ_Abs_Lat_Acc_STD_0 OBJ_Abs_Lat_Acc_V_0 OBJ_Abs_Lat_Acc_0 OBJ_Abs_Long_Acc_STD_V_0 OBJ_Abs_Long_Acc_STD_0 OBJ_Abs_Long_Acc_V_0 OBJ_Abs_Long_Acc_0 OBJ_Abs_Lat_Vel_STD_V_0 OBJ_Abs_Lat_Velocity_STD_0 OBJ_Abs_Lat_Velocity_V_0 OBJ_Abs_Lat_Velocity_0 OBJ_Abs_Long_Vel_STD_V_0 OBJ_Abs_Long_Velocity_STD_0 OBJ_Abs_Long_Velocity_V_0 OBJ_Abs_Long_Velocity_0 OBJ_Height_STD_V_0 OBJ_Height_STD_0 OBJ_Height_V_0 OBJ_Height_0 OBJ_Length_STD_V_0 OBJ_Length_STD_0 OBJ_Length_V_0 OBJ_Length_0 OBJ_Width_STD_V_0 OBJ_Width_STD_0 OBJ_Width_V_0 OBJ_Width_0 OBJ_Age_Seconds_V_0 OBJ_Age_Seconds_0 OBJ_Lane_Assignment_V_0 OBJ_Lane_Assignment_0 OBJ_Bottom_Out_Of_Image_V_0 OBJ_Top_Out_Of_Image_V_0 OBJ_Bottom_Out_Of_Image_0 OBJ_Top_Out_Of_Image_0 OBJ_Left_Out_Of_Image_V_0 OBJ_Right_Out_Of_Image_V_0 OBJ_Left_Out_Of_Image_0 OBJ_Right_Out_Of_Image_0 OBJ_Light_Indicator_Validity_0 OBJ_Turn_Indicator_Left_0 OBJ_Turn_Indicator_Right_0 OBJ_Brake_Light_0 OBJ_Has_Cut_Path_0 OBJ_Has_Cut_Lane_0 OBJ_Motion_Orientation_0 OBJ_Motion_Status_0 OBJ_Camera_Source_0 OBJ_Bike_Probability_0 OBJ_Truck_Probability_0 OBJ_Car_Probability_0 OBJ_Class_Probability_0 OBJ_Object_Class_0 OBJ_Measuring_Status_0 OBJ_Object_Age_0 OBJ_Moving_IN_Probability_0 OBJ_Motion_Category_0 OBJ_Triggered_SDM_0 OBJ_Fusion_Source_0 OBJ_Existence_Probability_0 OBJ_ID_0 OBJ_CRC_0 ICM_Object_Prot0_A_Header;
SIG_GROUP_ 144 ICM_Object_Prot_Header 1 : OBJ_Header_Buffer OBJ_Is_Blocked_Right OBJ_Is_Blocked_Left OBJ_VD_Allow_Acc OBJ_VD_CIPV_Lost OBJ_VD_CIPV_ID OBJ_VD_NIV_Right OBJ_VD_NIV_Left OBJ_Animal_Count OBJ_General_OBJ_Count OBJ_VD_Count OBJ_VRU_Count OBJ_Sync_ID OBJ_Protocol_Version OBJ_Header_CRC OBJ_Zero_byte ICM_Object_Prot_Head_Header;
SIG_GROUP_ 75 ICM_Safety_Diag_Prot 1 : SD_Challenge_Identifier SD_Challenge_Response4 SD_Challenge_Response3 SD_Challenge_Response2 SD_Challenge_Response1 SD_Bit_63 SD_Bit_62 SD_Bit_61 SD_Bit_60 SD_Bit_59 SD_Bit_58 SD_Bit_57 SD_Bit_56 SD_Bit_55 SD_Bit_54 SD_Bit_53 SD_Bit_52 SD_Bit_51 SD_Bit_50 SD_Bit_49 SD_Bit_48 SD_Bit_47 SD_Bit_46 SD_Bit_45 SD_Bit_44 SD_Bit_43 SD_Bit_42 SD_Bit_41 SD_Bit_40 SD_Bit_39 SD_Bit_38 SD_Bit_37 SD_Bit_36 SD_Bit_35 SD_Bit_34 SD_Bit_33 SD_Bit_32 SD_Bit_31 SD_Bit_30 SD_Bit_29 SD_Bit_28 SD_Bit_27 SD_Bit_26 SD_Bit_25 SD_Bit_24 SD_Bit_23 SD_Bit_22 SD_Bit_21 SD_Bit_20 SD_Bit_19 SD_Bit_18 SD_Bit_17 SD_Bit_16 SD_Bit_15 SD_Bit_14 SD_Bit_13 SD_Bit_12 SD_Bit_11 SD_Bit_10 SD_Bit_9 SD_Bit_8 SD_Bit_7 SD_Bit_6 SD_Bit_5 SD_Bit_4 SD_Bit_3 SD_Bit_2 SD_Bit_1 SD_Bit_0 SD_Sync_ID SD_Protocol_Version SD_CRC SD_Zero_byte ICM_Safety_Diag_Prot_Header ICM_Safety_Diag_Prot_CRC;
SIG_GROUP_ 111 ICM_Lanes_Road_Edge_Prot_C 1 : LRE_Is_Triggered_SDM_Model_3 ICM_La_Ro_Ed_Prot_C_CRC ICM_La_Ro_Ed_Prot_C_Header LRE_Line_C0_3 LRE_Line_C1_3 LRE_Line_C2_3 LRE_Line_C3_3 LRE_Index_3 LRE_Side_3 LRE_Measured_VR_End_3 LRE_View_Range_End_3 LRE_View_Range_Start_3 LRE_Height_STD_3 LRE_Height_3 LRE_Prediction_Type_3 LRE_Type_3 LRE_Exist_Prob_3 LRE_Age_3 LRE_ID_3;
SIG_GROUP_ 110 ICM_Lanes_Road_Edge_Prot_B 1 : LRE_Is_Triggered_SDM_Model_2 ICM_La_Ro_Ed_Prot_B_Header LRE_Line_C0_2 LRE_Line_C1_2 LRE_Line_C2_2 LRE_Line_C3_2 LRE_Index_2 LRE_Side_2 LRE_Measured_VR_End_2 LRE_View_Range_End_2 LRE_View_Range_Start_2 LRE_Height_STD_2 LRE_Height_2 LRE_Prediction_Type_2 LRE_Type_2 LRE_Exist_Prob_2 LRE_Age_2 LRE_ID_2;
SIG_GROUP_ 109 ICM_Lanes_Road_Edge_Prot_A 1 : LRE_Is_Triggered_SDM_Model_1 ICM_La_Ro_Ed_Prot_A_Header LRE_Line_C0_1 LRE_Line_C1_1 LRE_Line_C2_1 LRE_Line_C3_1 LRE_Index_1 LRE_Side_1 LRE_Measured_VR_End_1 LRE_View_Range_End_1 LRE_View_Range_Start_1 LRE_Height_STD_1 LRE_Height_1 LRE_Prediction_Type_1 LRE_Type_1 LRE_Exist_Prob_1 LRE_Age_1 LRE_ID_1;
SIG_GROUP_ 108 ICM_Lanes_Road_Edge_Prot_Header 1 : LRE_Count LRE_Is_Triggered_SDM_Model_0 LRE_Header_Buffer LRE_Sync_ID LRE_Protocol_Version LRE_CRC LRE_Zero_byte ICM_La_Ro_Ed_Prot_Head_Header LRE_Line_C0_0 LRE_Line_C1_0 LRE_Line_C2_0 LRE_Line_C3_0 LRE_Index_0 LRE_Side_0 LRE_Measured_VR_End_0 LRE_View_Range_End_0 LRE_View_Range_Start_0 LRE_Height_STD_0 LRE_Height_0 LRE_Prediction_Type_0 LRE_Type_0 LRE_Exist_Prob_0 LRE_Age_0 LRE_ID_0;
SIG_GROUP_ 105 ICM_Lanes_Host_Prot_Header 1 : LH_Snow_On_Road_Prob ICM_La_Host_Prot_Head_Header LH_Header_Buffer LH_Estimated_Width LH_Lanes_Count LH_Sync_ID LH_Protocol_Version LH_Zero_byte;
SIG_GROUP_ 104 ICM_Lanes_App_Prot_C 1 : LAP_INTP_Buffer_7 LAP_INTP_Long_Distance_7 LAP_INTP_Lat_Distance_7 LAP_INTP_Is_Start_7 LAP_INTP_Type_7 LAP_INTP_Line_Role_7 LAP_INTP_Is_Valid_7 LAP_INTP_Exist_Probability_7 LAP_INTP_Age_7 LAP_INTP_ID_7 LAP_INTP_Buffer_8 LAP_INTP_Long_Distance_8 LAP_INTP_Lat_Distance_8 LAP_INTP_Is_Start_8 LAP_INTP_Type_8 LAP_INTP_Line_Role_8 LAP_INTP_Is_Valid_8 LAP_INTP_Exist_Probability_8 LAP_INTP_Age_8 LAP_INTP_ID_8 LAP_INTP_Buffer_9 LAP_INTP_Long_Distance_9 LAP_INTP_Lat_Distance_9 LAP_INTP_Is_Start_9 LAP_INTP_Type_9 LAP_INTP_Line_Role_9 LAP_INTP_Is_Valid_9 LAP_INTP_Exist_Probability_9 LAP_INTP_Age_9 LAP_INTP_ID_9 LAP_INTP_Buffer_10 LAP_INTP_Long_Distance_10 LAP_INTP_Lat_Distance_10 LAP_INTP_Is_Start_10 LAP_INTP_Type_10 LAP_INTP_Line_Role_10 LAP_INTP_Is_Valid_10 LAP_INTP_Exist_Probability_10 LAP_INTP_Age_10 LAP_INTP_ID_10 LAP_INTP_Buffer_11 LAP_INTP_Long_Distance_11 LAP_INTP_Lat_Distance_11 LAP_INTP_Is_Start_11 LAP_INTP_Type_11 LAP_INTP_Line_Role_11 LAP_INTP_Is_Valid_11 LAP_INTP_Exist_Probability_11 LAP_INTP_Age_11 LAP_INTP_ID_11 ICM_La_App_Prot_C_Header ICM_La_App_Prot_C_CRC;
SIG_GROUP_ 103 ICM_Lanes_App_Prot_B 1 : ICM_La_App_Prot_B_Header LAP_INTP_Buffer_6 LAP_INTP_Long_Distance_6 LAP_INTP_Lat_Distance_6 LAP_INTP_Is_Start_6 LAP_INTP_Type_6 LAP_INTP_Line_Role_6 LAP_INTP_Is_Valid_6 LAP_INTP_Exist_Probability_6 LAP_INTP_Age_6 LAP_INTP_ID_6 LAP_INTP_Buffer_5 LAP_INTP_Long_Distance_5 LAP_INTP_Lat_Distance_5 LAP_INTP_Is_Start_5 LAP_INTP_Type_5 LAP_INTP_Line_Role_5 LAP_INTP_Is_Valid_5 LAP_INTP_Exist_Probability_5 LAP_INTP_Age_5 LAP_INTP_ID_5 LAP_INTP_Buffer_4 LAP_INTP_Long_Distance_4 LAP_INTP_Lat_Distance_4 LAP_INTP_Is_Start_4 LAP_INTP_Type_4 LAP_INTP_Line_Role_4 LAP_INTP_Is_Valid_4 LAP_INTP_Exist_Probability_4 LAP_INTP_Age_4 LAP_INTP_ID_4 LAP_INTP_Buffer_3 LAP_INTP_Long_Distance_3 LAP_INTP_Lat_Distance_3 LAP_INTP_Is_Start_3 LAP_INTP_Type_3 LAP_INTP_Line_Role_3 LAP_INTP_Is_Valid_3 LAP_INTP_Exist_Probability_3 LAP_INTP_Age_3 LAP_INTP_ID_3 LAP_INTP_Buffer_2 LAP_INTP_Long_Distance_2 LAP_INTP_Lat_Distance_2 LAP_INTP_Is_Start_2 LAP_INTP_Type_2 LAP_INTP_Line_Role_2 LAP_INTP_Is_Valid_2 LAP_INTP_Exist_Probability_2 LAP_INTP_Age_2 LAP_INTP_ID_2 LAP_INTP_Buffer_1 LAP_INTP_Long_Distance_1 LAP_INTP_Lat_Distance_1 LAP_INTP_Is_Start_1 LAP_INTP_Type_1 LAP_INTP_Line_Role_1 LAP_INTP_Is_Valid_1 LAP_INTP_Exist_Probability_1 LAP_INTP_Age_1 LAP_INTP_ID_1 LAP_INTP_Buffer_0 LAP_INTP_Long_Distance_0 LAP_INTP_Lat_Distance_0 LAP_INTP_Is_Start_0 LAP_INTP_Type_0 LAP_INTP_Line_Role_0 LAP_INTP_Is_Valid_0 LAP_INTP_Exist_Probability_0 LAP_INTP_Age_0 LAP_INTP_ID_0;
SIG_GROUP_ 102 ICM_Lanes_App_Prot_A 1 : LAP_Is_Triggered_SDM_Model LAP_Path_Pred_Second_C3 LAP_Path_Pred_Second_C2 LAP_Path_Pred_Second_C1 LAP_Path_Pred_Second_C0 LAP_Path_Pred_First_C3 LAP_Path_Pred_First_C2 LAP_Path_Pred_First_C1 LAP_Path_Pred_First_C0 LAP_Path_Pred_Second_VR_End LAP_Path_Pred_First_VR_End LAP_Path_Pred_Conf LAP_Path_Pred_Half_Width LAP_Path_Pred_Second_Valid LAP_Path_Pred_First_Valid LAP_Path_Pred_Available LAP_Path_Pred_CRC LAP_Vertical_Surface_VR_End LAP_Vertical_Surface_C3 LAP_Vertical_Surface_C2 LAP_Vertical_Surface_C1 LAP_Vertical_Surface_C0 LAP_Vertical_Surface_Available LAP_Is_Highway_Exit_Right LAP_Is_Highway_Exit_Left LAP_Is_Highway_Merge_Right LAP_Is_Highway_Merge_Left LAP_Exit_Merge_Available LAP_INTP_Count LAP_INTP_Available LAP_Is_Construction_Area LAP_ADV_Sync_ID LAP_ADV_Protocol_Version LAP_ADV_Zero_byte ICM_La_App_Prot_A_Header;
SIG_GROUP_ 101 ICM_LDW_Prot 1 : LDW_Time_To_Host_Right LDW_Time_To_Host_Left LDW_Buffer_3 LDW_Warning_Status_Right_3 LDW_Warning_Status_Left_3 LDW_Time_To_Warning_Right_3 LDW_Time_To_Warning_Left_3 LDW_Suppression_Reason_3 LDW_Buffer_2 LDW_Warning_Status_Right_2 LDW_Warning_Status_Left_2 LDW_Time_To_Warning_Right_2 LDW_Time_To_Warning_Left_2 LDW_Suppression_Reason_2 LDW_Buffer_1 LDW_Warning_Status_Right_1 LDW_Warning_Status_Left_1 LDW_Time_To_Warning_Right_1 LDW_Time_To_Warning_Left_1 LDW_Suppression_Reason_1 LDW_Buffer_0 LDW_Warning_Status_Right_0 LDW_Warning_Status_Left_0 LDW_Time_To_Warning_Right_0 LDW_Time_To_Warning_Left_0 LDW_Suppression_Reason_0 LDW_Header_Buffer LDW_Line_Valid_Right LDW_Line_Valid_Left LDW_Sync_ID LDW_Protocol_Version LDW_Zero_byte ICM_LDW_Prot_Header ICM_LDW_Prot_CRC;
SIG_GROUP_ 99 ICM_Lanes_Adja_Prot_C 1 : ICM_La_Adja_Prot_C_Header LA_Lane_Track_ID_2 LA_Age_2 LA_Exist_Probability_2 LA_Color_2 LA_Color_Conf_2 LA_Prediction_Type_2 LA_Prediction_Source_2 LA_View_Range_Start_2 LA_View_Range_End_2 LA_Measured_VR_End_2 LA_Lanemark_Type_2 LA_DLM_Type_2 LA_Lanemark_Type_Conf_2 LA_Line_Role_2 LA_Marker_Width_2 LA_Marker_Width_STD_2 LA_Line_C3_2 LA_Line_C2_2 LA_Line_C1_2 LA_Line_C0_2;
SIG_GROUP_ 100 ICM_Lanes_Adja_Prot_D 1 : ICM_La_Adja_Prot_D_CRC ICM_La_Adja_Prot_D_Header LA_Lane_Track_ID_3 LA_Age_3 LA_Exist_Probability_3 LA_Color_3 LA_Color_Conf_3 LA_Prediction_Type_3 LA_Prediction_Source_3 LA_View_Range_Start_3 LA_View_Range_End_3 LA_Measured_VR_End_3 LA_Lanemark_Type_3 LA_DLM_Type_3 LA_Lanemark_Type_Conf_3 LA_Line_Role_3 LA_Marker_Width_3 LA_Marker_Width_STD_3 LA_Line_C3_3 LA_Line_C2_3 LA_Line_C1_3 LA_Line_C0_3;
SIG_GROUP_ 98 ICM_Lanes_Adja_Prot_B 1 : ICM_La_Adja_Prot_B_Header LA_Lane_Track_ID_1 LA_Age_1 LA_Exist_Probability_1 LA_Color_1 LA_Color_Conf_1 LA_Prediction_Type_1 LA_Prediction_Source_1 LA_View_Range_Start_1 LA_View_Range_End_1 LA_Measured_VR_End_1 LA_Lanemark_Type_1 LA_DLM_Type_1 LA_Lanemark_Type_Conf_1 LA_Line_Role_1 LA_Marker_Width_1 LA_Marker_Width_STD_1 LA_Line_C3_1 LA_Line_C2_1 LA_Line_C1_1 LA_Line_C0_1;
SIG_GROUP_ 97 ICM_Lanes_Adja_Prot_A 1 : ICM_La_Adja_Prot_A_Header LA_Lane_Track_ID_0 LA_Age_0 LA_Exist_Probability_0 LA_Color_0 LA_Color_Conf_0 LA_Prediction_Type_0 LA_Prediction_Source_0 LA_View_Range_Start_0 LA_View_Range_End_0 LA_Measured_VR_End_0 LA_Lanemark_Type_0 LA_DLM_Type_0 LA_Lanemark_Type_Conf_0 LA_Line_Role_0 LA_Marker_Width_0 LA_Marker_Width_STD_0 LA_Line_C3_0 LA_Line_C2_0 LA_Line_C1_0 LA_Line_C0_0;
SIG_GROUP_ 96 ICM_Lanes_Adja_Prot_Header 1 : ICM_La_Adja_Prot_Head_Header LA_Zero_byte LA_Protocol_Version LA_Sync_ID LA_Adjacent_Count LA_Header_Buffer;
SIG_GROUP_ 74 ICM_HLB_Prot 1 : HLB_Brightness_Score ICM_HLB_Prot_Header HLB_Zero_byte HLB_Protocol_Version HLB_Sync_ID HLB_Running_Mode HLB_Inactive_Reason HLB_Decision HLB_Reason ICM_HLB_Prot_CRC;
SIG_GROUP_ 72 ICM_Common_Port_B 1 : COM_SCA_Factor_Variance COM_SCA_Factor_Mean COM_SCA_Weight COM_SCA_Cov_Y_Y COM_SCA_Cov_X_Y COM_SCA_Cov_X_X COM_SCA_Mean_Y COM_SCA_Mean_X ICM_Common_Prot_B_Header ICM_Common_Prot_B_CRC;
SIG_GROUP_ 71 ICM_Common_Port_A 1 : ICM_Common_Prot_A_Header COM_Zero_byte COM_CRC COM_Protocol_Version COM_Sync_Frame_ID COM_Frame_MCU_TS_Start COM_Last_MCU_Sync_TS COM_Last_Clock_Sync_Skew COM_Last_Clock_Sync_Error COM_EyeQ_Frame_ID COM_Cam_Frame_ID COM_DayTime_Indicator COM_HIL_Mode_Status COM_Exposure_Type COM_Region_Code_V COM_Region_Code COM_Driving_Side_V COM_Driving_Side COM_Is_HighSpeed_Road_V COM_Is_HighSpeed_Road;
SIG_GROUP_ 67 ICM_Boot_Diag_Message_B 1 : BOOT_Flash2_Man_Code BOOT_Flash_2_Size Boot_Stage BOOT_Failure_info_0 BOOT_Failure_info_1 BOOT_Failure_info_2 BOOT_Failure_info_3 BOOT_Failure_info_4 BOOT_Failure_info_5 BOOT_Failure_info_6 BOOT_Failure_info_7 ICM_Boot_Diag_Mes_B_Header ICM_Boot_Diag_Mes_B_CRC;
SIG_GROUP_ 66 ICM_Boot_Diag_Message_A 1 : BOOT_Flash_Size ICM_Boot_Diag_Mes_A_Header BOOT_CPU_Temperature BOOT_VMP_Temperature BOOT_LPDDR4_Temperature_Status BOOT_Zero_byte BootMsg_Protocol_Version BOOT_Test_results BOOT_Board_project_code BOOT_Board_revision BOOT_Version BOOT_Application_version BOOT_EyeQ_ID BOOT_EyeQ_Type BOOT_DDR_manufacturer_code BOOT_DDR_Size BOOT_Flash_Man_Code;
SIG_GROUP_ 65 ICM_Application_Message_B 1 : APP_appMode APP_Application_ver APP_Camera1_VideoErrorFlags_pt2 APP_Camera2_VideoErrorFlags_pt2 APP_Camera3_VideoErrorFlags_pt2 APP_SPI_Bus_Load_Rx APP_SPI_Bus_Load_Tx APP_SPI_Retransmit_Tx APP_Camera3_VideoErrorFlags_pt1 APP_Camera2_VideoErrorFlags_pt1 APP_Brain_drops_counter ICM_App_Message_B_CRC ICM_App_Message_B_Header;
SIG_GROUP_ 64 ICM_Application_Message_A 1 : APP_Camera1_VideoErrorFlags_pt1 APP_Zero_Byte APP_Diagnostics_part_1 APP_Diagnostics_part_2 Application_Message_Version APP_Main_State APP_Sub_State APP_EyeQ_Process_Index APP_EyeQ_Timestamp APP_EyeQ_Current_Timestamp APP_Fatal_Error APP_Minor_Error APP_EyeQTemperature1 APP_EyeQTemperature2 APP_Temperature_DDR APP_spiErrors APP_Camera1_temperature_1 APP_Camera1_temperature_2 APP_Camera2_temperature_1 APP_Camera2_temperature_2 APP_Camera3_temperature_1 APP_Camera3_temperature_2 APP_Camera1_VideoErrorRange APP_Camera2_VideoErrorRange APP_Camera3_VideoErrorRange APP_Valid_second_cam_temp_info APP_Valid_cameras_information ICM_App_Message_A_Header;
