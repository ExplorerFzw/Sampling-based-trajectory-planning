VERSION "3"

NS_ :

BS_:

BU_: MyECU ACM

BO_ 196 ICM_Object_Prot25_B: 64 MyECU
 SG_ ICM_Object_Prot25_B_Header : 0|16@1+ (1,0) [0|65535] ""  ACM
 SG_ OBJ_Relative_Long_Velocity_25 : 16|13@1+ (0.05,-120) [-120|130] "MPS"  ACM
 SG_ OBJ_Relative_Long_Velocity_V_25 : 29|1@1+ (1,0) [0|1] "bool"  ACM
 SG_ OBJ_Relative_Long_Vel_STD_25 : 30|12@1+ (0.05,0) [0|130] "MPS"  ACM
 SG_ OBJ_Rel_Long_Vel_STD_V_25 : 42|1@1+ (1,0) [0|1] "bool"  ACM
 SG_ OBJ_Relative_Lat_Velocity_25 : 48|11@1+ (0.05,-50) [-50|50] "MPS"  ACM
 SG_ OBJ_Relative_Lat_Velocity_V_25 : 59|1@1+ (1,0) [0|1] "bool"  ACM
 SG_ OBJ_Relative_Lat_Velocity_STD_25 : 60|10@1+ (0.05,0) [0|50] "MPS"  ACM
 SG_ OBJ_Rel_Lat_Vel_STD_V_25 : 70|1@1+ (1,0) [0|1] "bool"  ACM
 SG_ OBJ_Long_Distance_25 : 80|14@1+ (0.05,-200) [-200|250] "m"  ACM
 SG_ OBJ_Long_Distance_V_25 : 94|1@1+ (1,0) [0|1] "bool"  ACM
 SG_ OBJ_Long_Distance_STD_25 : 95|13@1+ (0.05,0) [0|250] "m"  ACM
 SG_ OBJ_Long_Distance_STD_V_25 : 108|1@1+ (1,0) [0|1] "bool"  ACM
 SG_ OBJ_Lat_Distance_25 : 112|12@1+ (0.05,-100) [-100|100] "m"  ACM
 SG_ OBJ_Lat_Distance_V_25 : 124|1@1+ (1,0) [0|1] "bool"  ACM
 SG_ OBJ_Lat_Distance_STD_25 : 125|11@1+ (0.05,0) [0|100] "m"  ACM
 SG_ OBJ_Lat_Distance_STD_V_25 : 136|1@1+ (1,0) [0|1] "bool"  ACM
 SG_ OBJ_Absolute_Speed_25 : 144|12@1+ (0.05,-65) [-65|65] "MPS"  ACM
 SG_ OBJ_Absolute_Speed_V_25 : 156|1@1+ (1,0) [0|1] "bool"  ACM
 SG_ OBJ_Absolute_Speed_STD_25 : 157|11@1+ (0.05,-65) [0|65] "MPS"  ACM
 SG_ OBJ_Absolute_Speed_STD_V_25 : 168|1@1+ (1,0) [0|1] "bool"  ACM
 SG_ OBJ_Heading_25 : 176|10@1+ (0.01,-3.14) [-3.14|3.14] "rad"  ACM
 SG_ OBJ_Heading_V_25 : 186|1@1+ (1,0) [0|1] "bool"  ACM
 SG_ OBJ_Heading_STD_25 : 187|9@1+ (0.01,0) [0|3.14] "rad"  ACM
 SG_ OBJ_Heading_STD_V_25 : 196|1@1+ (1,0) [0|1] "bool"  ACM
 SG_ OBJ_Angle_Rate_STD_25 : 197|11@1+ (0.002,0) [0|2.2318] "RPS"  ACM
 SG_ OBJ_Angle_Rate_STD_V_25 : 208|1@1+ (1,0) [0|1] "bool"  ACM
 SG_ OBJ_Angle_Rate_25 : 209|12@1+ (0.002,-2.234) [-2.234|2.2318] "RPS"  ACM
 SG_ OBJ_Angle_Rate_V_25 : 221|1@1+ (1,0) [0|1] "bool"  ACM
 SG_ OBJ_Angle_Right_25 : 222|14@1+ (0.0002,-1.571) [-1.571|1.571] "rad "  ACM
 SG_ OBJ_Angle_Right_V_25 : 236|1@1+ (1,0) [0|1] "bool"  ACM
 SG_ OBJ_Angle_Right_STD_25 : 240|13@1+ (0.0002,0) [0|1.571] "rad "  ACM
 SG_ OBJ_Angle_Right_STD_V_25 : 253|1@1+ (1,0) [0|1] "bool"  ACM
 SG_ OBJ_Angle_Left_25 : 254|14@1+ (0.0002,-1.571) [-1.571|1.571] "rad "  ACM
 SG_ OBJ_Angle_Left_V_25 : 268|1@1+ (1,0) [0|1] "bool"  ACM
 SG_ OBJ_Angle_Left_STD_25 : 272|13@1+ (0.0002,0) [0|1.571] "rad"  ACM
 SG_ OBJ_Angle_Left_STD_V_25 : 285|1@1+ (1,0) [0|1] "bool"  ACM
 SG_ OBJ_Angle_Side_25 : 286|14@1+ (0.0002,-1.571) [-1.571|1.571] "rad"  ACM
 SG_ OBJ_Angle_Side_V_25 : 300|1@1+ (1,0) [0|1] "bool"  ACM
 SG_ OBJ_Angle_Side_STD_25 : 304|13@1+ (0.0002,0) [0|1.571] "rad"  ACM
 SG_ OBJ_Angle_Side_STD_V_25 : 317|1@1+ (1,0) [0|1] "bool"  ACM
 SG_ OBJ_Angle_Mid_V_25 : 318|1@1+ (1,0) [0|1] "bool"  ACM
 SG_ OBJ_Angle_Mid_25 : 319|14@1+ (0.0002,-1.571) [-1.571|1.571] "rad"  ACM
 SG_ OBJ_Angle_Mid_STD_25 : 336|13@1+ (0.0002,0) [0|1.571] "rad"  ACM
 SG_ OBJ_Angle_Mid_STD_V_25 : 349|1@1+ (1,0) [0|1] "bool"  ACM
 SG_ OBJ_Angle_Bottom_V_25 : 350|1@1+ (1,0) [0|1] "bool"  ACM
 SG_ OBJ_Angle_Bottom_25 : 351|14@1+ (0.0002,-1.571) [-1.571|1.571] "rad"  ACM
 SG_ OBJ_Angle_Bottom_STD_25 : 368|13@1+ (0.0002,0) [0|1.571] "rad"  ACM
 SG_ OBJ_Angle_Bottom_STD_V_25 : 381|1@1+ (1,0) [0|1] "bool"  ACM
 SG_ OBJ_Visibility_Side_V_25 : 382|1@1+ (1,0) [0|1] "bool"  ACM
 SG_ OBJ_Visibility_Side_25 : 383|2@1+ (1,0) [0|2] "ENUM"  ACM
 SG_ OBJ_Is_In_Drivable_Area_25 : 385|1@1+ (1,0) [0|1] "bool"  ACM
 SG_ OBJ_Is_In_Drivable_Area_V_25 : 386|1@1+ (1,0) [0|1] "bool"  ACM
 SG_ OBJ_Is_VeryClose_25 : 387|1@1+ (1,0) [0|1] "bool"  ACM
 SG_ OBJ_Is_VeryClose_V_25 : 388|1@1+ (1,0) [0|1] "bool"  ACM
 SG_ OBJ_Buffer_25 : 389|11@1+ (1,0) [0|0] "NA"  ACM

BO_ 195 ICM_Object_Prot25_A: 64 MyECU
 SG_ ICM_Object_Prot25_A_Header : 0|16@1+ (1,0) [0|65535] ""  ACM
 SG_ OBJ_CRC_25 : 16|32@1+ (1,0) [0|4294967295] "NA"  ACM
 SG_ OBJ_ID_25 : 48|8@1+ (1,0) [0|255] "NA"  ACM
 SG_ OBJ_Existence_Probability_25 : 56|8@1+ (0.01,0) [0|1] "NA"  ACM
 SG_ OBJ_Fusion_Source_25 : 64|16@1+ (1,0) [0|65535] "BITWIZE"  ACM
 SG_ OBJ_Triggered_SDM_25 : 80|2@1+ (1,0) [0|2] "ENUM"  ACM
 SG_ OBJ_Motion_Category_25 : 82|4@1+ (1,0) [0|13] "ENUM "  ACM
 SG_ OBJ_Moving_IN_Probability_25 : 86|7@1+ (0.01,0) [0|0] "NA"  ACM
 SG_ OBJ_Object_Age_25 : 93|11@1+ (1,0) [0|2047] "Frame"  ACM
 SG_ OBJ_Measuring_Status_25 : 104|3@1+ (1,0) [0|7] "BITWIZE"  ACM
 SG_ OBJ_Object_Class_25 : 107|4@1+ (1,0) [0|8] "ENUM"  ACM
 SG_ OBJ_Class_Probability_25 : 112|7@1+ (0.01,0) [0|1] "NA"  ACM
 SG_ OBJ_Car_Probability_25 : 119|7@1+ (0.01,0) [0|0] "NA"  ACM
 SG_ OBJ_Truck_Probability_25 : 126|7@1+ (0.01,0) [0|0] "NA"  ACM
 SG_ OBJ_Bike_Probability_25 : 133|7@1+ (0.01,0) [0|0] "NA"  ACM
 SG_ OBJ_Camera_Source_25 : 140|4@1+ (1,0) [0|15] "ENUM"  ACM
 SG_ OBJ_Motion_Status_25 : 144|3@1+ (1,0) [0|5] "ENUM "  ACM
 SG_ OBJ_Motion_Orientation_25 : 147|4@1+ (1,0) [0|13] "ENUM "  ACM
 SG_ OBJ_Has_Cut_Lane_25 : 151|1@1+ (1,0) [0|1] "bool"  ACM
 SG_ OBJ_Has_Cut_Path_25 : 152|1@1+ (1,0) [0|1] "bool"  ACM
 SG_ OBJ_Brake_Light_25 : 153|1@1+ (1,0) [0|1] "bool"  ACM
 SG_ OBJ_Turn_Indicator_Right_25 : 154|1@1+ (1,0) [0|1] "bool"  ACM
 SG_ OBJ_Turn_Indicator_Left_25 : 155|1@1+ (1,0) [0|1] "bool"  ACM
 SG_ OBJ_Light_Indicator_Validity_25 : 156|1@1+ (1,0) [0|1] "bool"  ACM
 SG_ OBJ_Right_Out_Of_Image_25 : 157|1@1+ (1,0) [0|1] "bool"  ACM
 SG_ OBJ_Left_Out_Of_Image_25 : 158|1@1+ (1,0) [0|1] "bool"  ACM
 SG_ OBJ_Right_Out_Of_Image_V_25 : 159|1@1+ (1,0) [0|1] "bool"  ACM
 SG_ OBJ_Left_Out_Of_Image_V_25 : 160|1@1+ (1,0) [0|1] "bool"  ACM
 SG_ OBJ_Top_Out_Of_Image_25 : 161|1@1+ (1,0) [0|1] "bool"  ACM
 SG_ OBJ_Bottom_Out_Of_Image_25 : 162|1@1+ (1,0) [0|1] "bool"  ACM
 SG_ OBJ_Top_Out_Of_Image_V_25 : 163|1@1+ (1,0) [0|1] "bool"  ACM
 SG_ OBJ_Bottom_Out_Of_Image_V_25 : 164|1@1+ (1,0) [0|1] "bool"  ACM
 SG_ OBJ_Lane_Assignment_25 : 165|3@1+ (1,0) [0|5] "ENUM"  ACM
 SG_ OBJ_Lane_Assignment_V_25 : 168|1@1+ (1,0) [0|1] "bool"  ACM
 SG_ OBJ_Age_Seconds_25 : 169|7@1+ (1,0) [0|100] "s"  ACM
 SG_ OBJ_Age_Seconds_V_25 : 176|1@1+ (1,0) [0|1] "bool"  ACM
 SG_ OBJ_Width_25 : 177|9@1+ (0.01,0) [0.4|2.95] "m"  ACM
 SG_ OBJ_Width_V_25 : 186|1@1+ (1,0) [0|1] "bool"  ACM
 SG_ OBJ_Width_STD_25 : 187|8@1+ (0.01,0) [0|2] "m"  ACM
 SG_ OBJ_Width_STD_V_25 : 195|1@1+ (1,0) [0|1] "bool"  ACM
 SG_ OBJ_Length_25 : 196|9@1+ (0.05,0) [1.2|21] "m"  ACM
 SG_ OBJ_Length_V_25 : 205|1@1+ (1,0) [0|1] "bool"  ACM
 SG_ OBJ_Length_STD_25 : 208|8@1+ (0.05,0) [0|10] "m"  ACM
 SG_ OBJ_Length_STD_V_25 : 216|1@1+ (1,0) [0|1] "bool"  ACM
 SG_ OBJ_Height_25 : 217|9@1+ (0.01,0) [0|2.95] "m"  ACM
 SG_ OBJ_Height_V_25 : 226|1@1+ (1,0) [0|1] "bool"  ACM
 SG_ OBJ_Height_STD_25 : 227|8@1+ (0.01,0) [0|2] "m"  ACM
 SG_ OBJ_Height_STD_V_25 : 235|1@1+ (1,0) [0|1] "bool"  ACM
 SG_ OBJ_Abs_Long_Velocity_25 : 240|12@1+ (0.05,-30) [-30|100] "MPS"  ACM
 SG_ OBJ_Abs_Long_Velocity_V_25 : 252|1@1+ (1,0) [0|1] "bool"  ACM
 SG_ OBJ_Abs_Long_Velocity_STD_25 : 253|11@1+ (0.05,0) [0|65] "MPS"  ACM
 SG_ OBJ_Abs_Long_Vel_STD_V_25 : 264|1@1+ (1,0) [0|1] "bool"  ACM
 SG_ OBJ_Abs_Lat_Velocity_25 : 272|11@1+ (0.05,-50) [-50|50] "MPS"  ACM
 SG_ OBJ_Abs_Lat_Velocity_V_25 : 283|1@1+ (1,0) [0|1] "bool"  ACM
 SG_ OBJ_Abs_Lat_Velocity_STD_25 : 284|10@1+ (0.05,0) [0|50] "MPS"  ACM
 SG_ OBJ_Abs_Lat_Vel_STD_V_25 : 294|1@1+ (1,0) [0|1] "bool"  ACM
 SG_ OBJ_Abs_Long_Acc_25 : 295|9@1+ (0.05,-10.3) [-10.3|7.3] "MPS2"  ACM
 SG_ OBJ_Abs_Long_Acc_V_25 : 304|1@1+ (1,0) [0|1] "bool"  ACM
 SG_ OBJ_Abs_Long_Acc_STD_25 : 305|8@1+ (0.05,0) [0|7.3] "MPS2"  ACM
 SG_ OBJ_Abs_Long_Acc_STD_V_25 : 313|1@1+ (1,0) [0|1] "bool"  ACM
 SG_ OBJ_Abs_Lat_Acc_25 : 314|9@1+ (0.05,-10.3) [-10.3|7.3] "MPS2"  ACM
 SG_ OBJ_Abs_Lat_Acc_V_25 : 323|1@1+ (1,0) [0|1] "bool"  ACM
 SG_ OBJ_Abs_Lat_Acc_STD_25 : 324|8@1+ (0.05,0) [0|7.3] "MPS2"  ACM
 SG_ OBJ_Abs_Lat_Acc_STD_V_25 : 332|1@1+ (1,0) [0|1] "bool"  ACM
 SG_ OBJ_Abs_Acceleration_25 : 336|9@1+ (0.05,-10.3) [-10.3|7.3] "MPS2"  ACM
 SG_ OBJ_Abs_Acceleration_V_25 : 345|1@1+ (1,0) [0|1] "bool"  ACM
 SG_ OBJ_Abs_Acc_STD_25 : 346|8@1+ (0.05,0) [0|7.3] "MPS2"  ACM
 SG_ OBJ_Abs_Acc_STD_V_25 : 354|1@1+ (1,0) [0|1] "bool"  ACM
 SG_ OBJ_Inv_TTC_25 : 355|11@1+ (0.01,-8) [-8|8] "INV(s)"  ACM
 SG_ OBJ_Inv_TTC_V_25 : 366|1@1+ (1,0) [0|1] "bool"  ACM
 SG_ OBJ_Inv_TTC_STD_25 : 368|11@1+ (0.01,0) [0|4] "INV(s)"  ACM
 SG_ OBJ_Inv_TTC_STD_V_25 : 379|1@1+ (1,0) [0|1] "bool"  ACM
 SG_ OBJ_Relative_Long_Acc_25 : 380|9@1+ (0.05,-10.3) [-10.3|7.3] "MPS2"  ACM
 SG_ OBJ_Relative_Long_Acc_V_25 : 389|1@1+ (1,0) [0|1] "bool"  ACM
 SG_ OBJ_Relative_Long_Acc_STD_25 : 390|8@1+ (0.05,0) [0|7.3] "MPS2"  ACM
 SG_ OBJ_Rel_Long_Acc_STD_V_25 : 398|1@1+ (1,0) [0|1] "bool"  ACM

BO_ 194 ICM_Object_Prot24_B: 64 MyECU
 SG_ ICM_Object_Prot24_B_Header : 0|16@1+ (1,0) [0|65535] ""  ACM
 SG_ OBJ_Relative_Long_Velocity_24 : 16|13@1+ (0.05,-120) [-120|130] "MPS"  ACM
 SG_ OBJ_Relative_Long_Velocity_V_24 : 29|1@1+ (1,0) [0|1] "bool"  ACM
 SG_ OBJ_Relative_Long_Vel_STD_24 : 30|12@1+ (0.05,0) [0|130] "MPS"  ACM
 SG_ OBJ_Rel_Long_Vel_STD_V_24 : 42|1@1+ (1,0) [0|1] "bool"  ACM
 SG_ OBJ_Relative_Lat_Velocity_24 : 48|11@1+ (0.05,-50) [-50|50] "MPS"  ACM
 SG_ OBJ_Relative_Lat_Velocity_V_24 : 59|1@1+ (1,0) [0|1] "bool"  ACM
 SG_ OBJ_Relative_Lat_Velocity_STD_24 : 60|10@1+ (0.05,0) [0|50] "MPS"  ACM
 SG_ OBJ_Rel_Lat_Vel_STD_V_24 : 70|1@1+ (1,0) [0|1] "bool"  ACM
 SG_ OBJ_Long_Distance_24 : 80|14@1+ (0.05,-200) [-200|250] "m"  ACM
 SG_ OBJ_Long_Distance_V_24 : 94|1@1+ (1,0) [0|1] "bool"  ACM
 SG_ OBJ_Long_Distance_STD_24 : 95|13@1+ (0.05,0) [0|250] "m"  ACM
 SG_ OBJ_Long_Distance_STD_V_24 : 108|1@1+ (1,0) [0|1] "bool"  ACM
 SG_ OBJ_Lat_Distance_24 : 112|12@1+ (0.05,-100) [-100|100] "m"  ACM
 SG_ OBJ_Lat_Distance_V_24 : 124|1@1+ (1,0) [0|1] "bool"  ACM
 SG_ OBJ_Lat_Distance_STD_24 : 125|11@1+ (0.05,0) [0|100] "m"  ACM
 SG_ OBJ_Lat_Distance_STD_V_24 : 136|1@1+ (1,0) [0|1] "bool"  ACM
 SG_ OBJ_Absolute_Speed_24 : 144|12@1+ (0.05,-65) [-65|65] "MPS"  ACM
 SG_ OBJ_Absolute_Speed_V_24 : 156|1@1+ (1,0) [0|1] "bool"  ACM
 SG_ OBJ_Absolute_Speed_STD_24 : 157|11@1+ (0.05,-65) [0|65] "MPS"  ACM
 SG_ OBJ_Absolute_Speed_STD_V_24 : 168|1@1+ (1,0) [0|1] "bool"  ACM
 SG_ OBJ_Heading_24 : 176|10@1+ (0.01,-3.14) [-3.14|3.14] "rad"  ACM
 SG_ OBJ_Heading_V_24 : 186|1@1+ (1,0) [0|1] "bool"  ACM
 SG_ OBJ_Heading_STD_24 : 187|9@1+ (0.01,0) [0|3.14] "rad"  ACM
 SG_ OBJ_Heading_STD_V_24 : 196|1@1+ (1,0) [0|1] "bool"  ACM
 SG_ OBJ_Angle_Rate_STD_24 : 197|11@1+ (0.002,0) [0|2.2318] "RPS"  ACM
 SG_ OBJ_Angle_Rate_STD_V_24 : 208|1@1+ (1,0) [0|1] "bool"  ACM
 SG_ OBJ_Angle_Rate_24 : 209|12@1+ (0.002,-2.234) [-2.234|2.2318] "RPS"  ACM
 SG_ OBJ_Angle_Rate_V_24 : 221|1@1+ (1,0) [0|1] "bool"  ACM
 SG_ OBJ_Angle_Right_24 : 222|14@1+ (0.0002,-1.571) [-1.571|1.571] "rad "  ACM
 SG_ OBJ_Angle_Right_V_24 : 236|1@1+ (1,0) [0|1] "bool"  ACM
 SG_ OBJ_Angle_Right_STD_24 : 240|13@1+ (0.0002,0) [0|1.571] "rad "  ACM
 SG_ OBJ_Angle_Right_STD_V_24 : 253|1@1+ (1,0) [0|1] "bool"  ACM
 SG_ OBJ_Angle_Left_24 : 254|14@1+ (0.0002,-1.571) [-1.571|1.571] "rad "  ACM
 SG_ OBJ_Angle_Left_V_24 : 268|1@1+ (1,0) [0|1] "bool"  ACM
 SG_ OBJ_Angle_Left_STD_24 : 272|13@1+ (0.0002,0) [0|1.571] "rad"  ACM
 SG_ OBJ_Angle_Left_STD_V_24 : 285|1@1+ (1,0) [0|1] "bool"  ACM
 SG_ OBJ_Angle_Side_24 : 286|14@1+ (0.0002,-1.571) [-1.571|1.571] "rad"  ACM
 SG_ OBJ_Angle_Side_V_24 : 300|1@1+ (1,0) [0|1] "bool"  ACM
 SG_ OBJ_Angle_Side_STD_24 : 304|13@1+ (0.0002,0) [0|1.571] "rad"  ACM
 SG_ OBJ_Angle_Side_STD_V_24 : 317|1@1+ (1,0) [0|1] "bool"  ACM
 SG_ OBJ_Angle_Mid_V_24 : 318|1@1+ (1,0) [0|1] "bool"  ACM
 SG_ OBJ_Angle_Mid_24 : 319|14@1+ (0.0002,-1.571) [-1.571|1.571] "rad"  ACM
 SG_ OBJ_Angle_Mid_STD_24 : 336|13@1+ (0.0002,0) [0|1.571] "rad"  ACM
 SG_ OBJ_Angle_Mid_STD_V_24 : 349|1@1+ (1,0) [0|1] "bool"  ACM
 SG_ OBJ_Angle_Bottom_V_24 : 350|1@1+ (1,0) [0|1] "bool"  ACM
 SG_ OBJ_Angle_Bottom_24 : 351|14@1+ (0.0002,-1.571) [-1.571|1.571] "rad"  ACM
 SG_ OBJ_Angle_Bottom_STD_24 : 368|13@1+ (0.0002,0) [0|1.571] "rad"  ACM
 SG_ OBJ_Angle_Bottom_STD_V_24 : 381|1@1+ (1,0) [0|1] "bool"  ACM
 SG_ OBJ_Visibility_Side_V_24 : 382|1@1+ (1,0) [0|1] "bool"  ACM
 SG_ OBJ_Visibility_Side_24 : 383|2@1+ (1,0) [0|2] "ENUM"  ACM
 SG_ OBJ_Is_In_Drivable_Area_24 : 385|1@1+ (1,0) [0|1] "bool"  ACM
 SG_ OBJ_Is_In_Drivable_Area_V_24 : 386|1@1+ (1,0) [0|1] "bool"  ACM
 SG_ OBJ_Is_VeryClose_24 : 387|1@1+ (1,0) [0|1] "bool"  ACM
 SG_ OBJ_Is_VeryClose_V_24 : 388|1@1+ (1,0) [0|1] "bool"  ACM
 SG_ OBJ_Buffer_24 : 389|11@1+ (1,0) [0|0] "NA"  ACM

BO_ 193 ICM_Object_Prot24_A: 64 MyECU
 SG_ ICM_Object_Prot24_A_Header : 0|16@1+ (1,0) [0|65535] ""  ACM
 SG_ OBJ_CRC_24 : 16|32@1+ (1,0) [0|4294967295] "NA"  ACM
 SG_ OBJ_ID_24 : 48|8@1+ (1,0) [0|255] "NA"  ACM
 SG_ OBJ_Existence_Probability_24 : 56|8@1+ (0.01,0) [0|1] "NA"  ACM
 SG_ OBJ_Fusion_Source_24 : 64|16@1+ (1,0) [0|65535] "BITWIZE"  ACM
 SG_ OBJ_Triggered_SDM_24 : 80|2@1+ (1,0) [0|2] "ENUM"  ACM
 SG_ OBJ_Motion_Category_24 : 82|4@1+ (1,0) [0|13] "ENUM "  ACM
 SG_ OBJ_Moving_IN_Probability_24 : 86|7@1+ (0.01,0) [0|0] "NA"  ACM
 SG_ OBJ_Object_Age_24 : 93|11@1+ (1,0) [0|2047] "Frame"  ACM
 SG_ OBJ_Measuring_Status_24 : 104|3@1+ (1,0) [0|7] "BITWIZE"  ACM
 SG_ OBJ_Object_Class_24 : 107|4@1+ (1,0) [0|8] "ENUM"  ACM
 SG_ OBJ_Class_Probability_24 : 112|7@1+ (0.01,0) [0|1] "NA"  ACM
 SG_ OBJ_Car_Probability_24 : 119|7@1+ (0.01,0) [0|0] "NA"  ACM
 SG_ OBJ_Truck_Probability_24 : 126|7@1+ (0.01,0) [0|0] "NA"  ACM
 SG_ OBJ_Bike_Probability_24 : 133|7@1+ (0.01,0) [0|0] "NA"  ACM
 SG_ OBJ_Camera_Source_24 : 140|4@1+ (1,0) [0|15] "ENUM"  ACM
 SG_ OBJ_Motion_Status_24 : 144|3@1+ (1,0) [0|5] "ENUM "  ACM
 SG_ OBJ_Motion_Orientation_24 : 147|4@1+ (1,0) [0|13] "ENUM "  ACM
 SG_ OBJ_Has_Cut_Lane_24 : 151|1@1+ (1,0) [0|1] "bool"  ACM
 SG_ OBJ_Has_Cut_Path_24 : 152|1@1+ (1,0) [0|1] "bool"  ACM
 SG_ OBJ_Brake_Light_24 : 153|1@1+ (1,0) [0|1] "bool"  ACM
 SG_ OBJ_Turn_Indicator_Right_24 : 154|1@1+ (1,0) [0|1] "bool"  ACM
 SG_ OBJ_Turn_Indicator_Left_24 : 155|1@1+ (1,0) [0|1] "bool"  ACM
 SG_ OBJ_Light_Indicator_Validity_24 : 156|1@1+ (1,0) [0|1] "bool"  ACM
 SG_ OBJ_Right_Out_Of_Image_24 : 157|1@1+ (1,0) [0|1] "bool"  ACM
 SG_ OBJ_Left_Out_Of_Image_24 : 158|1@1+ (1,0) [0|1] "bool"  ACM
 SG_ OBJ_Right_Out_Of_Image_V_24 : 159|1@1+ (1,0) [0|1] "bool"  ACM
 SG_ OBJ_Left_Out_Of_Image_V_24 : 160|1@1+ (1,0) [0|1] "bool"  ACM
 SG_ OBJ_Top_Out_Of_Image_24 : 161|1@1+ (1,0) [0|1] "bool"  ACM
 SG_ OBJ_Bottom_Out_Of_Image_24 : 162|1@1+ (1,0) [0|1] "bool"  ACM
 SG_ OBJ_Top_Out_Of_Image_V_24 : 163|1@1+ (1,0) [0|1] "bool"  ACM
 SG_ OBJ_Bottom_Out_Of_Image_V_24 : 164|1@1+ (1,0) [0|1] "bool"  ACM
 SG_ OBJ_Lane_Assignment_24 : 165|3@1+ (1,0) [0|5] "ENUM"  ACM
 SG_ OBJ_Lane_Assignment_V_24 : 168|1@1+ (1,0) [0|1] "bool"  ACM
 SG_ OBJ_Age_Seconds_24 : 169|7@1+ (1,0) [0|100] "s"  ACM
 SG_ OBJ_Age_Seconds_V_24 : 176|1@1+ (1,0) [0|1] "bool"  ACM
 SG_ OBJ_Width_24 : 177|9@1+ (0.01,0) [0.4|2.95] "m"  ACM
 SG_ OBJ_Width_V_24 : 186|1@1+ (1,0) [0|1] "bool"  ACM
 SG_ OBJ_Width_STD_24 : 187|8@1+ (0.01,0) [0|2] "m"  ACM
 SG_ OBJ_Width_STD_V_24 : 195|1@1+ (1,0) [0|1] "bool"  ACM
 SG_ OBJ_Length_24 : 196|9@1+ (0.05,0) [1.2|21] "m"  ACM
 SG_ OBJ_Length_V_24 : 205|1@1+ (1,0) [0|1] "bool"  ACM
 SG_ OBJ_Length_STD_24 : 208|8@1+ (0.05,0) [0|10] "m"  ACM
 SG_ OBJ_Length_STD_V_24 : 216|1@1+ (1,0) [0|1] "bool"  ACM
 SG_ OBJ_Height_24 : 217|9@1+ (0.01,0) [0|2.95] "m"  ACM
 SG_ OBJ_Height_V_24 : 226|1@1+ (1,0) [0|1] "bool"  ACM
 SG_ OBJ_Height_STD_24 : 227|8@1+ (0.01,0) [0|2] "m"  ACM
 SG_ OBJ_Height_STD_V_24 : 235|1@1+ (1,0) [0|1] "bool"  ACM
 SG_ OBJ_Abs_Long_Velocity_24 : 240|12@1+ (0.05,-30) [-30|100] "MPS"  ACM
 SG_ OBJ_Abs_Long_Velocity_V_24 : 252|1@1+ (1,0) [0|1] "bool"  ACM
 SG_ OBJ_Abs_Long_Velocity_STD_24 : 253|11@1+ (0.05,0) [0|65] "MPS"  ACM
 SG_ OBJ_Abs_Long_Vel_STD_V_24 : 264|1@1+ (1,0) [0|1] "bool"  ACM
 SG_ OBJ_Abs_Lat_Velocity_24 : 272|11@1+ (0.05,-50) [-50|50] "MPS"  ACM
 SG_ OBJ_Abs_Lat_Velocity_V_24 : 283|1@1+ (1,0) [0|1] "bool"  ACM
 SG_ OBJ_Abs_Lat_Velocity_STD_24 : 284|10@1+ (0.05,0) [0|50] "MPS"  ACM
 SG_ OBJ_Abs_Lat_Vel_STD_V_24 : 294|1@1+ (1,0) [0|1] "bool"  ACM
 SG_ OBJ_Abs_Long_Acc_24 : 295|9@1+ (0.05,-10.3) [-10.3|7.3] "MPS2"  ACM
 SG_ OBJ_Abs_Long_Acc_V_24 : 304|1@1+ (1,0) [0|1] "bool"  ACM
 SG_ OBJ_Abs_Long_Acc_STD_24 : 305|8@1+ (0.05,0) [0|7.3] "MPS2"  ACM
 SG_ OBJ_Abs_Long_Acc_STD_V_24 : 313|1@1+ (1,0) [0|1] "bool"  ACM
 SG_ OBJ_Abs_Lat_Acc_24 : 314|9@1+ (0.05,-10.3) [-10.3|7.3] "MPS2"  ACM
 SG_ OBJ_Abs_Lat_Acc_V_24 : 323|1@1+ (1,0) [0|1] "bool"  ACM
 SG_ OBJ_Abs_Lat_Acc_STD_24 : 324|8@1+ (0.05,0) [0|7.3] "MPS2"  ACM
 SG_ OBJ_Abs_Lat_Acc_STD_V_24 : 332|1@1+ (1,0) [0|1] "bool"  ACM
 SG_ OBJ_Abs_Acceleration_24 : 336|9@1+ (0.05,-10.3) [-10.3|7.3] "MPS2"  ACM
 SG_ OBJ_Abs_Acceleration_V_24 : 345|1@1+ (1,0) [0|1] "bool"  ACM
 SG_ OBJ_Abs_Acc_STD_24 : 346|8@1+ (0.05,0) [0|7.3] "MPS2"  ACM
 SG_ OBJ_Abs_Acc_STD_V_24 : 354|1@1+ (1,0) [0|1] "bool"  ACM
 SG_ OBJ_Inv_TTC_24 : 355|11@1+ (0.01,-8) [-8|8] "INV(s)"  ACM
 SG_ OBJ_Inv_TTC_V_24 : 366|1@1+ (1,0) [0|1] "bool"  ACM
 SG_ OBJ_Inv_TTC_STD_24 : 368|11@1+ (0.01,0) [0|4] "INV(s)"  ACM
 SG_ OBJ_Inv_TTC_STD_V_24 : 379|1@1+ (1,0) [0|1] "bool"  ACM
 SG_ OBJ_Relative_Long_Acc_24 : 380|9@1+ (0.05,-10.3) [-10.3|7.3] "MPS2"  ACM
 SG_ OBJ_Relative_Long_Acc_V_24 : 389|1@1+ (1,0) [0|1] "bool"  ACM
 SG_ OBJ_Relative_Long_Acc_STD_24 : 390|8@1+ (0.05,0) [0|7.3] "MPS2"  ACM
 SG_ OBJ_Rel_Long_Acc_STD_V_24 : 398|1@1+ (1,0) [0|1] "bool"  ACM

BO_ 192 ICM_Object_Prot23_B: 64 MyECU
 SG_ ICM_Object_Prot23_B_Header : 0|16@1+ (1,0) [0|65535] ""  ACM
 SG_ OBJ_Relative_Long_Velocity_23 : 16|13@1+ (0.05,-120) [-120|130] "MPS"  ACM
 SG_ OBJ_Relative_Long_Velocity_V_23 : 29|1@1+ (1,0) [0|1] "bool"  ACM
 SG_ OBJ_Relative_Long_Vel_STD_23 : 30|12@1+ (0.05,0) [0|130] "MPS"  ACM
 SG_ OBJ_Rel_Long_Vel_STD_V_23 : 42|1@1+ (1,0) [0|1] "bool"  ACM
 SG_ OBJ_Relative_Lat_Velocity_23 : 48|11@1+ (0.05,-50) [-50|50] "MPS"  ACM
 SG_ OBJ_Relative_Lat_Velocity_V_23 : 59|1@1+ (1,0) [0|1] "bool"  ACM
 SG_ OBJ_Relative_Lat_Velocity_STD_23 : 60|10@1+ (0.05,0) [0|50] "MPS"  ACM
 SG_ OBJ_Rel_Lat_Vel_STD_V_23 : 70|1@1+ (1,0) [0|1] "bool"  ACM
 SG_ OBJ_Long_Distance_23 : 80|14@1+ (0.05,-200) [-200|250] "m"  ACM
 SG_ OBJ_Long_Distance_V_23 : 94|1@1+ (1,0) [0|1] "bool"  ACM
 SG_ OBJ_Long_Distance_STD_23 : 95|13@1+ (0.05,0) [0|250] "m"  ACM
 SG_ OBJ_Long_Distance_STD_V_23 : 108|1@1+ (1,0) [0|1] "bool"  ACM
 SG_ OBJ_Lat_Distance_23 : 112|12@1+ (0.05,-100) [-100|100] "m"  ACM
 SG_ OBJ_Lat_Distance_V_23 : 124|1@1+ (1,0) [0|1] "bool"  ACM
 SG_ OBJ_Lat_Distance_STD_23 : 125|11@1+ (0.05,0) [0|100] "m"  ACM
 SG_ OBJ_Lat_Distance_STD_V_23 : 136|1@1+ (1,0) [0|1] "bool"  ACM
 SG_ OBJ_Absolute_Speed_23 : 144|12@1+ (0.05,-65) [-65|65] "MPS"  ACM
 SG_ OBJ_Absolute_Speed_V_23 : 156|1@1+ (1,0) [0|1] "bool"  ACM
 SG_ OBJ_Absolute_Speed_STD_23 : 157|11@1+ (0.05,-65) [0|65] "MPS"  ACM
 SG_ OBJ_Absolute_Speed_STD_V_23 : 168|1@1+ (1,0) [0|1] "bool"  ACM
 SG_ OBJ_Heading_23 : 176|10@1+ (0.01,-3.14) [-3.14|3.14] "rad"  ACM
 SG_ OBJ_Heading_V_23 : 186|1@1+ (1,0) [0|1] "bool"  ACM
 SG_ OBJ_Heading_STD_23 : 187|9@1+ (0.01,0) [0|3.14] "rad"  ACM
 SG_ OBJ_Heading_STD_V_23 : 196|1@1+ (1,0) [0|1] "bool"  ACM
 SG_ OBJ_Angle_Rate_STD_23 : 197|11@1+ (0.002,0) [0|2.2318] "RPS"  ACM
 SG_ OBJ_Angle_Rate_STD_V_23 : 208|1@1+ (1,0) [0|1] "bool"  ACM
 SG_ OBJ_Angle_Rate_23 : 209|12@1+ (0.002,-2.234) [-2.234|2.2318] "RPS"  ACM
 SG_ OBJ_Angle_Rate_V_23 : 221|1@1+ (1,0) [0|1] "bool"  ACM
 SG_ OBJ_Angle_Right_23 : 222|14@1+ (0.0002,-1.571) [-1.571|1.571] "rad "  ACM
 SG_ OBJ_Angle_Right_V_23 : 236|1@1+ (1,0) [0|1] "bool"  ACM
 SG_ OBJ_Angle_Right_STD_23 : 240|13@1+ (0.0002,0) [0|1.571] "rad "  ACM
 SG_ OBJ_Angle_Right_STD_V_23 : 253|1@1+ (1,0) [0|1] "bool"  ACM
 SG_ OBJ_Angle_Left_23 : 254|14@1+ (0.0002,-1.571) [-1.571|1.571] "rad "  ACM
 SG_ OBJ_Angle_Left_V_23 : 268|1@1+ (1,0) [0|1] "bool"  ACM
 SG_ OBJ_Angle_Left_STD_23 : 272|13@1+ (0.0002,0) [0|1.571] "rad"  ACM
 SG_ OBJ_Angle_Left_STD_V_23 : 285|1@1+ (1,0) [0|1] "bool"  ACM
 SG_ OBJ_Angle_Side_23 : 286|14@1+ (0.0002,-1.571) [-1.571|1.571] "rad"  ACM
 SG_ OBJ_Angle_Side_V_23 : 300|1@1+ (1,0) [0|1] "bool"  ACM
 SG_ OBJ_Angle_Side_STD_23 : 304|13@1+ (0.0002,0) [0|1.571] "rad"  ACM
 SG_ OBJ_Angle_Side_STD_V_23 : 317|1@1+ (1,0) [0|1] "bool"  ACM
 SG_ OBJ_Angle_Mid_V_23 : 318|1@1+ (1,0) [0|1] "bool"  ACM
 SG_ OBJ_Angle_Mid_23 : 319|14@1+ (0.0002,-1.571) [-1.571|1.571] "rad"  ACM
 SG_ OBJ_Angle_Mid_STD_23 : 336|13@1+ (0.0002,0) [0|1.571] "rad"  ACM
 SG_ OBJ_Angle_Mid_STD_V_23 : 349|1@1+ (1,0) [0|1] "bool"  ACM
 SG_ OBJ_Angle_Bottom_V_23 : 350|1@1+ (1,0) [0|1] "bool"  ACM
 SG_ OBJ_Angle_Bottom_23 : 351|14@1+ (0.0002,-1.571) [-1.571|1.571] "rad"  ACM
 SG_ OBJ_Angle_Bottom_STD_23 : 368|13@1+ (0.0002,0) [0|1.571] "rad"  ACM
 SG_ OBJ_Angle_Bottom_STD_V_23 : 381|1@1+ (1,0) [0|1] "bool"  ACM
 SG_ OBJ_Visibility_Side_V_23 : 382|1@1+ (1,0) [0|1] "bool"  ACM
 SG_ OBJ_Visibility_Side_23 : 383|2@1+ (1,0) [0|2] "ENUM"  ACM
 SG_ OBJ_Is_In_Drivable_Area_23 : 385|1@1+ (1,0) [0|1] "bool"  ACM
 SG_ OBJ_Is_In_Drivable_Area_V_23 : 386|1@1+ (1,0) [0|1] "bool"  ACM
 SG_ OBJ_Is_VeryClose_23 : 387|1@1+ (1,0) [0|1] "bool"  ACM
 SG_ OBJ_Is_VeryClose_V_23 : 388|1@1+ (1,0) [0|1] "bool"  ACM
 SG_ OBJ_Buffer_23 : 389|11@1+ (1,0) [0|0] "NA"  ACM

BO_ 191 ICM_Object_Prot23_A: 64 MyECU
 SG_ ICM_Object_Prot23_A_Header : 0|16@1+ (1,0) [0|65535] ""  ACM
 SG_ OBJ_CRC_23 : 16|32@1+ (1,0) [0|4294967295] "NA"  ACM
 SG_ OBJ_ID_23 : 48|8@1+ (1,0) [0|255] "NA"  ACM
 SG_ OBJ_Existence_Probability_23 : 56|8@1+ (0.01,0) [0|1] "NA"  ACM
 SG_ OBJ_Fusion_Source_23 : 64|16@1+ (1,0) [0|65535] "BITWIZE"  ACM
 SG_ OBJ_Triggered_SDM_23 : 80|2@1+ (1,0) [0|2] "ENUM"  ACM
 SG_ OBJ_Motion_Category_23 : 82|4@1+ (1,0) [0|13] "ENUM "  ACM
 SG_ OBJ_Moving_IN_Probability_23 : 86|7@1+ (0.01,0) [0|0] "NA"  ACM
 SG_ OBJ_Object_Age_23 : 93|11@1+ (1,0) [0|2047] "Frame"  ACM
 SG_ OBJ_Measuring_Status_23 : 104|3@1+ (1,0) [0|7] "BITWIZE"  ACM
 SG_ OBJ_Object_Class_23 : 107|4@1+ (1,0) [0|8] "ENUM"  ACM
 SG_ OBJ_Class_Probability_23 : 112|7@1+ (0.01,0) [0|1] "NA"  ACM
 SG_ OBJ_Car_Probability_23 : 119|7@1+ (0.01,0) [0|0] "NA"  ACM
 SG_ OBJ_Truck_Probability_23 : 126|7@1+ (0.01,0) [0|0] "NA"  ACM
 SG_ OBJ_Bike_Probability_23 : 133|7@1+ (0.01,0) [0|0] "NA"  ACM
 SG_ OBJ_Camera_Source_23 : 140|4@1+ (1,0) [0|15] "ENUM"  ACM
 SG_ OBJ_Motion_Status_23 : 144|3@1+ (1,0) [0|5] "ENUM "  ACM
 SG_ OBJ_Motion_Orientation_23 : 147|4@1+ (1,0) [0|13] "ENUM "  ACM
 SG_ OBJ_Has_Cut_Lane_23 : 151|1@1+ (1,0) [0|1] "bool"  ACM
 SG_ OBJ_Has_Cut_Path_23 : 152|1@1+ (1,0) [0|1] "bool"  ACM
 SG_ OBJ_Brake_Light_23 : 153|1@1+ (1,0) [0|1] "bool"  ACM
 SG_ OBJ_Turn_Indicator_Right_23 : 154|1@1+ (1,0) [0|1] "bool"  ACM
 SG_ OBJ_Turn_Indicator_Left_23 : 155|1@1+ (1,0) [0|1] "bool"  ACM
 SG_ OBJ_Light_Indicator_Validity_23 : 156|1@1+ (1,0) [0|1] "bool"  ACM
 SG_ OBJ_Right_Out_Of_Image_23 : 157|1@1+ (1,0) [0|1] "bool"  ACM
 SG_ OBJ_Left_Out_Of_Image_23 : 158|1@1+ (1,0) [0|1] "bool"  ACM
 SG_ OBJ_Right_Out_Of_Image_V_23 : 159|1@1+ (1,0) [0|1] "bool"  ACM
 SG_ OBJ_Left_Out_Of_Image_V_23 : 160|1@1+ (1,0) [0|1] "bool"  ACM
 SG_ OBJ_Top_Out_Of_Image_23 : 161|1@1+ (1,0) [0|1] "bool"  ACM
 SG_ OBJ_Bottom_Out_Of_Image_23 : 162|1@1+ (1,0) [0|1] "bool"  ACM
 SG_ OBJ_Top_Out_Of_Image_V_23 : 163|1@1+ (1,0) [0|1] "bool"  ACM
 SG_ OBJ_Bottom_Out_Of_Image_V_23 : 164|1@1+ (1,0) [0|1] "bool"  ACM
 SG_ OBJ_Lane_Assignment_23 : 165|3@1+ (1,0) [0|5] "ENUM"  ACM
 SG_ OBJ_Lane_Assignment_V_23 : 168|1@1+ (1,0) [0|1] "bool"  ACM
 SG_ OBJ_Age_Seconds_23 : 169|7@1+ (1,0) [0|100] "s"  ACM
 SG_ OBJ_Age_Seconds_V_23 : 176|1@1+ (1,0) [0|1] "bool"  ACM
 SG_ OBJ_Width_23 : 177|9@1+ (0.01,0) [0.4|2.95] "m"  ACM
 SG_ OBJ_Width_V_23 : 186|1@1+ (1,0) [0|1] "bool"  ACM
 SG_ OBJ_Width_STD_23 : 187|8@1+ (0.01,0) [0|2] "m"  ACM
 SG_ OBJ_Width_STD_V_23 : 195|1@1+ (1,0) [0|1] "bool"  ACM
 SG_ OBJ_Length_23 : 196|9@1+ (0.05,0) [1.2|21] "m"  ACM
 SG_ OBJ_Length_V_23 : 205|1@1+ (1,0) [0|1] "bool"  ACM
 SG_ OBJ_Length_STD_23 : 208|8@1+ (0.05,0) [0|10] "m"  ACM
 SG_ OBJ_Length_STD_V_23 : 216|1@1+ (1,0) [0|1] "bool"  ACM
 SG_ OBJ_Height_23 : 217|9@1+ (0.01,0) [0|2.95] "m"  ACM
 SG_ OBJ_Height_V_23 : 226|1@1+ (1,0) [0|1] "bool"  ACM
 SG_ OBJ_Height_STD_23 : 227|8@1+ (0.01,0) [0|2] "m"  ACM
 SG_ OBJ_Height_STD_V_23 : 235|1@1+ (1,0) [0|1] "bool"  ACM
 SG_ OBJ_Abs_Long_Velocity_23 : 240|12@1+ (0.05,-30) [-30|100] "MPS"  ACM
 SG_ OBJ_Abs_Long_Velocity_V_23 : 252|1@1+ (1,0) [0|1] "bool"  ACM
 SG_ OBJ_Abs_Long_Velocity_STD_23 : 253|11@1+ (0.05,0) [0|65] "MPS"  ACM
 SG_ OBJ_Abs_Long_Vel_STD_V_23 : 264|1@1+ (1,0) [0|1] "bool"  ACM
 SG_ OBJ_Abs_Lat_Velocity_23 : 272|11@1+ (0.05,-50) [-50|50] "MPS"  ACM
 SG_ OBJ_Abs_Lat_Velocity_V_23 : 283|1@1+ (1,0) [0|1] "bool"  ACM
 SG_ OBJ_Abs_Lat_Velocity_STD_23 : 284|10@1+ (0.05,0) [0|50] "MPS"  ACM
 SG_ OBJ_Abs_Lat_Vel_STD_V_23 : 294|1@1+ (1,0) [0|1] "bool"  ACM
 SG_ OBJ_Abs_Long_Acc_23 : 295|9@1+ (0.05,-10.3) [-10.3|7.3] "MPS2"  ACM
 SG_ OBJ_Abs_Long_Acc_V_23 : 304|1@1+ (1,0) [0|1] "bool"  ACM
 SG_ OBJ_Abs_Long_Acc_STD_23 : 305|8@1+ (0.05,0) [0|7.3] "MPS2"  ACM
 SG_ OBJ_Abs_Long_Acc_STD_V_23 : 313|1@1+ (1,0) [0|1] "bool"  ACM
 SG_ OBJ_Abs_Lat_Acc_23 : 314|9@1+ (0.05,-10.3) [-10.3|7.3] "MPS2"  ACM
 SG_ OBJ_Abs_Lat_Acc_V_23 : 323|1@1+ (1,0) [0|1] "bool"  ACM
 SG_ OBJ_Abs_Lat_Acc_STD_23 : 324|8@1+ (0.05,0) [0|7.3] "MPS2"  ACM
 SG_ OBJ_Abs_Lat_Acc_STD_V_23 : 332|1@1+ (1,0) [0|1] "bool"  ACM
 SG_ OBJ_Abs_Acceleration_23 : 336|9@1+ (0.05,-10.3) [-10.3|7.3] "MPS2"  ACM
 SG_ OBJ_Abs_Acceleration_V_23 : 345|1@1+ (1,0) [0|1] "bool"  ACM
 SG_ OBJ_Abs_Acc_STD_23 : 346|8@1+ (0.05,0) [0|7.3] "MPS2"  ACM
 SG_ OBJ_Abs_Acc_STD_V_23 : 354|1@1+ (1,0) [0|1] "bool"  ACM
 SG_ OBJ_Inv_TTC_23 : 355|11@1+ (0.01,-8) [-8|8] "INV(s)"  ACM
 SG_ OBJ_Inv_TTC_V_23 : 366|1@1+ (1,0) [0|1] "bool"  ACM
 SG_ OBJ_Inv_TTC_STD_23 : 368|11@1+ (0.01,0) [0|4] "INV(s)"  ACM
 SG_ OBJ_Inv_TTC_STD_V_23 : 379|1@1+ (1,0) [0|1] "bool"  ACM
 SG_ OBJ_Relative_Long_Acc_23 : 380|9@1+ (0.05,-10.3) [-10.3|7.3] "MPS2"  ACM
 SG_ OBJ_Relative_Long_Acc_V_23 : 389|1@1+ (1,0) [0|1] "bool"  ACM
 SG_ OBJ_Relative_Long_Acc_STD_23 : 390|8@1+ (0.05,0) [0|7.3] "MPS2"  ACM
 SG_ OBJ_Rel_Long_Acc_STD_V_23 : 398|1@1+ (1,0) [0|1] "bool"  ACM

BO_ 190 ICM_Object_Prot22_B: 64 MyECU
 SG_ ICM_Object_Prot22_B_Header : 0|16@1+ (1,0) [0|65535] ""  ACM
 SG_ OBJ_Relative_Long_Velocity_22 : 16|13@1+ (0.05,-120) [-120|130] "MPS"  ACM
 SG_ OBJ_Relative_Long_Velocity_V_22 : 29|1@1+ (1,0) [0|1] "bool"  ACM
 SG_ OBJ_Relative_Long_Vel_STD_22 : 30|12@1+ (0.05,0) [0|130] "MPS"  ACM
 SG_ OBJ_Rel_Long_Vel_STD_V_22 : 42|1@1+ (1,0) [0|1] "bool"  ACM
 SG_ OBJ_Relative_Lat_Velocity_22 : 48|11@1+ (0.05,-50) [-50|50] "MPS"  ACM
 SG_ OBJ_Relative_Lat_Velocity_V_22 : 59|1@1+ (1,0) [0|1] "bool"  ACM
 SG_ OBJ_Relative_Lat_Velocity_STD_22 : 60|10@1+ (0.05,0) [0|50] "MPS"  ACM
 SG_ OBJ_Rel_Lat_Vel_STD_V_22 : 70|1@1+ (1,0) [0|1] "bool"  ACM
 SG_ OBJ_Long_Distance_22 : 80|14@1+ (0.05,-200) [-200|250] "m"  ACM
 SG_ OBJ_Long_Distance_V_22 : 94|1@1+ (1,0) [0|1] "bool"  ACM
 SG_ OBJ_Long_Distance_STD_22 : 95|13@1+ (0.05,0) [0|250] "m"  ACM
 SG_ OBJ_Long_Distance_STD_V_22 : 108|1@1+ (1,0) [0|1] "bool"  ACM
 SG_ OBJ_Lat_Distance_22 : 112|12@1+ (0.05,-100) [-100|100] "m"  ACM
 SG_ OBJ_Lat_Distance_V_22 : 124|1@1+ (1,0) [0|1] "bool"  ACM
 SG_ OBJ_Lat_Distance_STD_22 : 125|11@1+ (0.05,0) [0|100] "m"  ACM
 SG_ OBJ_Lat_Distance_STD_V_22 : 136|1@1+ (1,0) [0|1] "bool"  ACM
 SG_ OBJ_Absolute_Speed_22 : 144|12@1+ (0.05,-65) [-65|65] "MPS"  ACM
 SG_ OBJ_Absolute_Speed_V_22 : 156|1@1+ (1,0) [0|1] "bool"  ACM
 SG_ OBJ_Absolute_Speed_STD_22 : 157|11@1+ (0.05,-65) [0|65] "MPS"  ACM
 SG_ OBJ_Absolute_Speed_STD_V_22 : 168|1@1+ (1,0) [0|1] "bool"  ACM
 SG_ OBJ_Heading_22 : 176|10@1+ (0.01,-3.14) [-3.14|3.14] "rad"  ACM
 SG_ OBJ_Heading_V_22 : 186|1@1+ (1,0) [0|1] "bool"  ACM
 SG_ OBJ_Heading_STD_22 : 187|9@1+ (0.01,0) [0|3.14] "rad"  ACM
 SG_ OBJ_Heading_STD_V_22 : 196|1@1+ (1,0) [0|1] "bool"  ACM
 SG_ OBJ_Angle_Rate_STD_22 : 197|11@1+ (0.002,0) [0|2.2318] "RPS"  ACM
 SG_ OBJ_Angle_Rate_STD_V_22 : 208|1@1+ (1,0) [0|1] "bool"  ACM
 SG_ OBJ_Angle_Rate_22 : 209|12@1+ (0.002,-2.234) [-2.234|2.2318] "RPS"  ACM
 SG_ OBJ_Angle_Rate_V_22 : 221|1@1+ (1,0) [0|1] "bool"  ACM
 SG_ OBJ_Angle_Right_22 : 222|14@1+ (0.0002,-1.571) [-1.571|1.571] "rad "  ACM
 SG_ OBJ_Angle_Right_V_22 : 236|1@1+ (1,0) [0|1] "bool"  ACM
 SG_ OBJ_Angle_Right_STD_22 : 240|13@1+ (0.0002,0) [0|1.571] "rad "  ACM
 SG_ OBJ_Angle_Right_STD_V_22 : 253|1@1+ (1,0) [0|1] "bool"  ACM
 SG_ OBJ_Angle_Left_22 : 254|14@1+ (0.0002,-1.571) [-1.571|1.571] "rad "  ACM
 SG_ OBJ_Angle_Left_V_22 : 268|1@1+ (1,0) [0|1] "bool"  ACM
 SG_ OBJ_Angle_Left_STD_22 : 272|13@1+ (0.0002,0) [0|1.571] "rad"  ACM
 SG_ OBJ_Angle_Left_STD_V_22 : 285|1@1+ (1,0) [0|1] "bool"  ACM
 SG_ OBJ_Angle_Side_22 : 286|14@1+ (0.0002,-1.571) [-1.571|1.571] "rad"  ACM
 SG_ OBJ_Angle_Side_V_22 : 300|1@1+ (1,0) [0|1] "bool"  ACM
 SG_ OBJ_Angle_Side_STD_22 : 304|13@1+ (0.0002,0) [0|1.571] "rad"  ACM
 SG_ OBJ_Angle_Side_STD_V_22 : 317|1@1+ (1,0) [0|1] "bool"  ACM
 SG_ OBJ_Angle_Mid_V_22 : 318|1@1+ (1,0) [0|1] "bool"  ACM
 SG_ OBJ_Angle_Mid_22 : 319|14@1+ (0.0002,-1.571) [-1.571|1.571] "rad"  ACM
 SG_ OBJ_Angle_Mid_STD_22 : 336|13@1+ (0.0002,0) [0|1.571] "rad"  ACM
 SG_ OBJ_Angle_Mid_STD_V_22 : 349|1@1+ (1,0) [0|1] "bool"  ACM
 SG_ OBJ_Angle_Bottom_V_22 : 350|1@1+ (1,0) [0|1] "bool"  ACM
 SG_ OBJ_Angle_Bottom_22 : 351|14@1+ (0.0002,-1.571) [-1.571|1.571] "rad"  ACM
 SG_ OBJ_Angle_Bottom_STD_22 : 368|13@1+ (0.0002,0) [0|1.571] "rad"  ACM
 SG_ OBJ_Angle_Bottom_STD_V_22 : 381|1@1+ (1,0) [0|1] "bool"  ACM
 SG_ OBJ_Visibility_Side_V_22 : 382|1@1+ (1,0) [0|1] "bool"  ACM
 SG_ OBJ_Visibility_Side_22 : 383|2@1+ (1,0) [0|2] "ENUM"  ACM
 SG_ OBJ_Is_In_Drivable_Area_22 : 385|1@1+ (1,0) [0|1] "bool"  ACM
 SG_ OBJ_Is_In_Drivable_Area_V_22 : 386|1@1+ (1,0) [0|1] "bool"  ACM
 SG_ OBJ_Is_VeryClose_22 : 387|1@1+ (1,0) [0|1] "bool"  ACM
 SG_ OBJ_Is_VeryClose_V_22 : 388|1@1+ (1,0) [0|1] "bool"  ACM
 SG_ OBJ_Buffer_22 : 389|11@1+ (1,0) [0|0] "NA"  ACM

BO_ 189 ICM_Object_Prot22_A: 64 MyECU
 SG_ ICM_Object_Prot22_A_Header : 0|16@1+ (1,0) [0|65535] ""  ACM
 SG_ OBJ_CRC_22 : 16|32@1+ (1,0) [0|4294967295] "NA"  ACM
 SG_ OBJ_ID_22 : 48|8@1+ (1,0) [0|255] "NA"  ACM
 SG_ OBJ_Existence_Probability_22 : 56|8@1+ (0.01,0) [0|1] "NA"  ACM
 SG_ OBJ_Fusion_Source_22 : 64|16@1+ (1,0) [0|65535] "BITWIZE"  ACM
 SG_ OBJ_Triggered_SDM_22 : 80|2@1+ (1,0) [0|2] "ENUM"  ACM
 SG_ OBJ_Motion_Category_22 : 82|4@1+ (1,0) [0|13] "ENUM "  ACM
 SG_ OBJ_Moving_IN_Probability_22 : 86|7@1+ (0.01,0) [0|0] "NA"  ACM
 SG_ OBJ_Object_Age_22 : 93|11@1+ (1,0) [0|2047] "Frame"  ACM
 SG_ OBJ_Measuring_Status_22 : 104|3@1+ (1,0) [0|7] "BITWIZE"  ACM
 SG_ OBJ_Object_Class_22 : 107|4@1+ (1,0) [0|8] "ENUM"  ACM
 SG_ OBJ_Class_Probability_22 : 112|7@1+ (0.01,0) [0|1] "NA"  ACM
 SG_ OBJ_Car_Probability_22 : 119|7@1+ (0.01,0) [0|0] "NA"  ACM
 SG_ OBJ_Truck_Probability_22 : 126|7@1+ (0.01,0) [0|0] "NA"  ACM
 SG_ OBJ_Bike_Probability_22 : 133|7@1+ (0.01,0) [0|0] "NA"  ACM
 SG_ OBJ_Camera_Source_22 : 140|4@1+ (1,0) [0|15] "ENUM"  ACM
 SG_ OBJ_Motion_Status_22 : 144|3@1+ (1,0) [0|5] "ENUM "  ACM
 SG_ OBJ_Motion_Orientation_22 : 147|4@1+ (1,0) [0|13] "ENUM "  ACM
 SG_ OBJ_Has_Cut_Lane_22 : 151|1@1+ (1,0) [0|1] "bool"  ACM
 SG_ OBJ_Has_Cut_Path_22 : 152|1@1+ (1,0) [0|1] "bool"  ACM
 SG_ OBJ_Brake_Light_22 : 153|1@1+ (1,0) [0|1] "bool"  ACM
 SG_ OBJ_Turn_Indicator_Right_22 : 154|1@1+ (1,0) [0|1] "bool"  ACM
 SG_ OBJ_Turn_Indicator_Left_22 : 155|1@1+ (1,0) [0|1] "bool"  ACM
 SG_ OBJ_Light_Indicator_Validity_22 : 156|1@1+ (1,0) [0|1] "bool"  ACM
 SG_ OBJ_Right_Out_Of_Image_22 : 157|1@1+ (1,0) [0|1] "bool"  ACM
 SG_ OBJ_Left_Out_Of_Image_22 : 158|1@1+ (1,0) [0|1] "bool"  ACM
 SG_ OBJ_Right_Out_Of_Image_V_22 : 159|1@1+ (1,0) [0|1] "bool"  ACM
 SG_ OBJ_Left_Out_Of_Image_V_22 : 160|1@1+ (1,0) [0|1] "bool"  ACM
 SG_ OBJ_Top_Out_Of_Image_22 : 161|1@1+ (1,0) [0|1] "bool"  ACM
 SG_ OBJ_Bottom_Out_Of_Image_22 : 162|1@1+ (1,0) [0|1] "bool"  ACM
 SG_ OBJ_Top_Out_Of_Image_V_22 : 163|1@1+ (1,0) [0|1] "bool"  ACM
 SG_ OBJ_Bottom_Out_Of_Image_V_22 : 164|1@1+ (1,0) [0|1] "bool"  ACM
 SG_ OBJ_Lane_Assignment_22 : 165|3@1+ (1,0) [0|5] "ENUM"  ACM
 SG_ OBJ_Lane_Assignment_V_22 : 168|1@1+ (1,0) [0|1] "bool"  ACM
 SG_ OBJ_Age_Seconds_22 : 169|7@1+ (1,0) [0|100] "s"  ACM
 SG_ OBJ_Age_Seconds_V_22 : 176|1@1+ (1,0) [0|1] "bool"  ACM
 SG_ OBJ_Width_22 : 177|9@1+ (0.01,0) [0.4|2.95] "m"  ACM
 SG_ OBJ_Width_V_22 : 186|1@1+ (1,0) [0|1] "bool"  ACM
 SG_ OBJ_Width_STD_22 : 187|8@1+ (0.01,0) [0|2] "m"  ACM
 SG_ OBJ_Width_STD_V_22 : 195|1@1+ (1,0) [0|1] "bool"  ACM
 SG_ OBJ_Length_22 : 196|9@1+ (0.05,0) [1.2|21] "m"  ACM
 SG_ OBJ_Length_V_22 : 205|1@1+ (1,0) [0|1] "bool"  ACM
 SG_ OBJ_Length_STD_22 : 208|8@1+ (0.05,0) [0|10] "m"  ACM
 SG_ OBJ_Length_STD_V_22 : 216|1@1+ (1,0) [0|1] "bool"  ACM
 SG_ OBJ_Height_22 : 217|9@1+ (0.01,0) [0|2.95] "m"  ACM
 SG_ OBJ_Height_V_22 : 226|1@1+ (1,0) [0|1] "bool"  ACM
 SG_ OBJ_Height_STD_22 : 227|8@1+ (0.01,0) [0|2] "m"  ACM
 SG_ OBJ_Height_STD_V_22 : 235|1@1+ (1,0) [0|1] "bool"  ACM
 SG_ OBJ_Abs_Long_Velocity_22 : 240|12@1+ (0.05,-30) [-30|100] "MPS"  ACM
 SG_ OBJ_Abs_Long_Velocity_V_22 : 252|1@1+ (1,0) [0|1] "bool"  ACM
 SG_ OBJ_Abs_Long_Velocity_STD_22 : 253|11@1+ (0.05,0) [0|65] "MPS"  ACM
 SG_ OBJ_Abs_Long_Vel_STD_V_22 : 264|1@1+ (1,0) [0|1] "bool"  ACM
 SG_ OBJ_Abs_Lat_Velocity_22 : 272|11@1+ (0.05,-50) [-50|50] "MPS"  ACM
 SG_ OBJ_Abs_Lat_Velocity_V_22 : 283|1@1+ (1,0) [0|1] "bool"  ACM
 SG_ OBJ_Abs_Lat_Velocity_STD_22 : 284|10@1+ (0.05,0) [0|50] "MPS"  ACM
 SG_ OBJ_Abs_Lat_Vel_STD_V_22 : 294|1@1+ (1,0) [0|1] "bool"  ACM
 SG_ OBJ_Abs_Long_Acc_22 : 295|9@1+ (0.05,-10.3) [-10.3|7.3] "MPS2"  ACM
 SG_ OBJ_Abs_Long_Acc_V_22 : 304|1@1+ (1,0) [0|1] "bool"  ACM
 SG_ OBJ_Abs_Long_Acc_STD_22 : 305|8@1+ (0.05,0) [0|7.3] "MPS2"  ACM
 SG_ OBJ_Abs_Long_Acc_STD_V_22 : 313|1@1+ (1,0) [0|1] "bool"  ACM
 SG_ OBJ_Abs_Lat_Acc_22 : 314|9@1+ (0.05,-10.3) [-10.3|7.3] "MPS2"  ACM
 SG_ OBJ_Abs_Lat_Acc_V_22 : 323|1@1+ (1,0) [0|1] "bool"  ACM
 SG_ OBJ_Abs_Lat_Acc_STD_22 : 324|8@1+ (0.05,0) [0|7.3] "MPS2"  ACM
 SG_ OBJ_Abs_Lat_Acc_STD_V_22 : 332|1@1+ (1,0) [0|1] "bool"  ACM
 SG_ OBJ_Abs_Acceleration_22 : 336|9@1+ (0.05,-10.3) [-10.3|7.3] "MPS2"  ACM
 SG_ OBJ_Abs_Acceleration_V_22 : 345|1@1+ (1,0) [0|1] "bool"  ACM
 SG_ OBJ_Abs_Acc_STD_22 : 346|8@1+ (0.05,0) [0|7.3] "MPS2"  ACM
 SG_ OBJ_Abs_Acc_STD_V_22 : 354|1@1+ (1,0) [0|1] "bool"  ACM
 SG_ OBJ_Inv_TTC_22 : 355|11@1+ (0.01,-8) [-8|8] "INV(s)"  ACM
 SG_ OBJ_Inv_TTC_V_22 : 366|1@1+ (1,0) [0|1] "bool"  ACM
 SG_ OBJ_Inv_TTC_STD_22 : 368|11@1+ (0.01,0) [0|4] "INV(s)"  ACM
 SG_ OBJ_Inv_TTC_STD_V_22 : 379|1@1+ (1,0) [0|1] "bool"  ACM
 SG_ OBJ_Relative_Long_Acc_22 : 380|9@1+ (0.05,-10.3) [-10.3|7.3] "MPS2"  ACM
 SG_ OBJ_Relative_Long_Acc_V_22 : 389|1@1+ (1,0) [0|1] "bool"  ACM
 SG_ OBJ_Relative_Long_Acc_STD_22 : 390|8@1+ (0.05,0) [0|7.3] "MPS2"  ACM
 SG_ OBJ_Rel_Long_Acc_STD_V_22 : 398|1@1+ (1,0) [0|1] "bool"  ACM

BO_ 188 ICM_Object_Prot21_B: 64 MyECU
 SG_ ICM_Object_Prot21_B_Header : 0|16@1+ (1,0) [0|65535] ""  ACM
 SG_ OBJ_Relative_Long_Velocity_21 : 16|13@1+ (0.05,-120) [-120|130] "MPS"  ACM
 SG_ OBJ_Relative_Long_Velocity_V_21 : 29|1@1+ (1,0) [0|1] "bool"  ACM
 SG_ OBJ_Relative_Long_Vel_STD_21 : 30|12@1+ (0.05,0) [0|130] "MPS"  ACM
 SG_ OBJ_Rel_Long_Vel_STD_V_21 : 42|1@1+ (1,0) [0|1] "bool"  ACM
 SG_ OBJ_Relative_Lat_Velocity_21 : 48|11@1+ (0.05,-50) [-50|50] "MPS"  ACM
 SG_ OBJ_Relative_Lat_Velocity_V_21 : 59|1@1+ (1,0) [0|1] "bool"  ACM
 SG_ OBJ_Relative_Lat_Velocity_STD_21 : 60|10@1+ (0.05,0) [0|50] "MPS"  ACM
 SG_ OBJ_Rel_Lat_Vel_STD_V_21 : 70|1@1+ (1,0) [0|1] "bool"  ACM
 SG_ OBJ_Long_Distance_21 : 80|14@1+ (0.05,-200) [-200|250] "m"  ACM
 SG_ OBJ_Long_Distance_V_21 : 94|1@1+ (1,0) [0|1] "bool"  ACM
 SG_ OBJ_Long_Distance_STD_21 : 95|13@1+ (0.05,0) [0|250] "m"  ACM
 SG_ OBJ_Long_Distance_STD_V_21 : 108|1@1+ (1,0) [0|1] "bool"  ACM
 SG_ OBJ_Lat_Distance_21 : 112|12@1+ (0.05,-100) [-100|100] "m"  ACM
 SG_ OBJ_Lat_Distance_V_21 : 124|1@1+ (1,0) [0|1] "bool"  ACM
 SG_ OBJ_Lat_Distance_STD_21 : 125|11@1+ (0.05,0) [0|100] "m"  ACM
 SG_ OBJ_Lat_Distance_STD_V_21 : 136|1@1+ (1,0) [0|1] "bool"  ACM
 SG_ OBJ_Absolute_Speed_21 : 144|12@1+ (0.05,-65) [-65|65] "MPS"  ACM
 SG_ OBJ_Absolute_Speed_V_21 : 156|1@1+ (1,0) [0|1] "bool"  ACM
 SG_ OBJ_Absolute_Speed_STD_21 : 157|11@1+ (0.05,-65) [0|65] "MPS"  ACM
 SG_ OBJ_Absolute_Speed_STD_V_21 : 168|1@1+ (1,0) [0|1] "bool"  ACM
 SG_ OBJ_Heading_21 : 176|10@1+ (0.01,-3.14) [-3.14|3.14] "rad"  ACM
 SG_ OBJ_Heading_V_21 : 186|1@1+ (1,0) [0|1] "bool"  ACM
 SG_ OBJ_Heading_STD_21 : 187|9@1+ (0.01,0) [0|3.14] "rad"  ACM
 SG_ OBJ_Heading_STD_V_21 : 196|1@1+ (1,0) [0|1] "bool"  ACM
 SG_ OBJ_Angle_Rate_STD_21 : 197|11@1+ (0.002,0) [0|2.2318] "RPS"  ACM
 SG_ OBJ_Angle_Rate_STD_V_21 : 208|1@1+ (1,0) [0|1] "bool"  ACM
 SG_ OBJ_Angle_Rate_21 : 209|12@1+ (0.002,-2.234) [-2.234|2.2318] "RPS"  ACM
 SG_ OBJ_Angle_Rate_V_21 : 221|1@1+ (1,0) [0|1] "bool"  ACM
 SG_ OBJ_Angle_Right_21 : 222|14@1+ (0.0002,-1.571) [-1.571|1.571] "rad "  ACM
 SG_ OBJ_Angle_Right_V_21 : 236|1@1+ (1,0) [0|1] "bool"  ACM
 SG_ OBJ_Angle_Right_STD_21 : 240|13@1+ (0.0002,0) [0|1.571] "rad "  ACM
 SG_ OBJ_Angle_Right_STD_V_21 : 253|1@1+ (1,0) [0|1] "bool"  ACM
 SG_ OBJ_Angle_Left_21 : 254|14@1+ (0.0002,-1.571) [-1.571|1.571] "rad "  ACM
 SG_ OBJ_Angle_Left_V_21 : 268|1@1+ (1,0) [0|1] "bool"  ACM
 SG_ OBJ_Angle_Left_STD_21 : 272|13@1+ (0.0002,0) [0|1.571] "rad"  ACM
 SG_ OBJ_Angle_Left_STD_V_21 : 285|1@1+ (1,0) [0|1] "bool"  ACM
 SG_ OBJ_Angle_Side_21 : 286|14@1+ (0.0002,-1.571) [-1.571|1.571] "rad"  ACM
 SG_ OBJ_Angle_Side_V_21 : 300|1@1+ (1,0) [0|1] "bool"  ACM
 SG_ OBJ_Angle_Side_STD_21 : 304|13@1+ (0.0002,0) [0|1.571] "rad"  ACM
 SG_ OBJ_Angle_Side_STD_V_21 : 317|1@1+ (1,0) [0|1] "bool"  ACM
 SG_ OBJ_Angle_Mid_V_21 : 318|1@1+ (1,0) [0|1] "bool"  ACM
 SG_ OBJ_Angle_Mid_21 : 319|14@1+ (0.0002,-1.571) [-1.571|1.571] "rad"  ACM
 SG_ OBJ_Angle_Mid_STD_21 : 336|13@1+ (0.0002,0) [0|1.571] "rad"  ACM
 SG_ OBJ_Angle_Mid_STD_V_21 : 349|1@1+ (1,0) [0|1] "bool"  ACM
 SG_ OBJ_Angle_Bottom_V_21 : 350|1@1+ (1,0) [0|1] "bool"  ACM
 SG_ OBJ_Angle_Bottom_21 : 351|14@1+ (0.0002,-1.571) [-1.571|1.571] "rad"  ACM
 SG_ OBJ_Angle_Bottom_STD_21 : 368|13@1+ (0.0002,0) [0|1.571] "rad"  ACM
 SG_ OBJ_Angle_Bottom_STD_V_21 : 381|1@1+ (1,0) [0|1] "bool"  ACM
 SG_ OBJ_Visibility_Side_V_21 : 382|1@1+ (1,0) [0|1] "bool"  ACM
 SG_ OBJ_Visibility_Side_21 : 383|2@1+ (1,0) [0|2] "ENUM"  ACM
 SG_ OBJ_Is_In_Drivable_Area_21 : 385|1@1+ (1,0) [0|1] "bool"  ACM
 SG_ OBJ_Is_In_Drivable_Area_V_21 : 386|1@1+ (1,0) [0|1] "bool"  ACM
 SG_ OBJ_Is_VeryClose_21 : 387|1@1+ (1,0) [0|1] "bool"  ACM
 SG_ OBJ_Is_VeryClose_V_21 : 388|1@1+ (1,0) [0|1] "bool"  ACM
 SG_ OBJ_Buffer_21 : 389|11@1+ (1,0) [0|0] "NA"  ACM

BO_ 187 ICM_Object_Prot21_A: 64 MyECU
 SG_ ICM_Object_Prot21_A_Header : 0|16@1+ (1,0) [0|65535] ""  ACM
 SG_ OBJ_CRC_21 : 16|32@1+ (1,0) [0|4294967295] "NA"  ACM
 SG_ OBJ_ID_21 : 48|8@1+ (1,0) [0|255] "NA"  ACM
 SG_ OBJ_Existence_Probability_21 : 56|8@1+ (0.01,0) [0|1] "NA"  ACM
 SG_ OBJ_Fusion_Source_21 : 64|16@1+ (1,0) [0|65535] "BITWIZE"  ACM
 SG_ OBJ_Triggered_SDM_21 : 80|2@1+ (1,0) [0|2] "ENUM"  ACM
 SG_ OBJ_Motion_Category_21 : 82|4@1+ (1,0) [0|13] "ENUM "  ACM
 SG_ OBJ_Moving_IN_Probability_21 : 86|7@1+ (0.01,0) [0|0] "NA"  ACM
 SG_ OBJ_Object_Age_21 : 93|11@1+ (1,0) [0|2047] "Frame"  ACM
 SG_ OBJ_Measuring_Status_21 : 104|3@1+ (1,0) [0|7] "BITWIZE"  ACM
 SG_ OBJ_Object_Class_21 : 107|4@1+ (1,0) [0|8] "ENUM"  ACM
 SG_ OBJ_Class_Probability_21 : 112|7@1+ (0.01,0) [0|1] "NA"  ACM
 SG_ OBJ_Car_Probability_21 : 119|7@1+ (0.01,0) [0|0] "NA"  ACM
 SG_ OBJ_Truck_Probability_21 : 126|7@1+ (0.01,0) [0|0] "NA"  ACM
 SG_ OBJ_Bike_Probability_21 : 133|7@1+ (0.01,0) [0|0] "NA"  ACM
 SG_ OBJ_Camera_Source_21 : 140|4@1+ (1,0) [0|15] "ENUM"  ACM
 SG_ OBJ_Motion_Status_21 : 144|3@1+ (1,0) [0|5] "ENUM "  ACM
 SG_ OBJ_Motion_Orientation_21 : 147|4@1+ (1,0) [0|13] "ENUM "  ACM
 SG_ OBJ_Has_Cut_Lane_21 : 151|1@1+ (1,0) [0|1] "bool"  ACM
 SG_ OBJ_Has_Cut_Path_21 : 152|1@1+ (1,0) [0|1] "bool"  ACM
 SG_ OBJ_Brake_Light_21 : 153|1@1+ (1,0) [0|1] "bool"  ACM
 SG_ OBJ_Turn_Indicator_Right_21 : 154|1@1+ (1,0) [0|1] "bool"  ACM
 SG_ OBJ_Turn_Indicator_Left_21 : 155|1@1+ (1,0) [0|1] "bool"  ACM
 SG_ OBJ_Light_Indicator_Validity_21 : 156|1@1+ (1,0) [0|1] "bool"  ACM
 SG_ OBJ_Right_Out_Of_Image_21 : 157|1@1+ (1,0) [0|1] "bool"  ACM
 SG_ OBJ_Left_Out_Of_Image_21 : 158|1@1+ (1,0) [0|1] "bool"  ACM
 SG_ OBJ_Right_Out_Of_Image_V_21 : 159|1@1+ (1,0) [0|1] "bool"  ACM
 SG_ OBJ_Left_Out_Of_Image_V_21 : 160|1@1+ (1,0) [0|1] "bool"  ACM
 SG_ OBJ_Top_Out_Of_Image_21 : 161|1@1+ (1,0) [0|1] "bool"  ACM
 SG_ OBJ_Bottom_Out_Of_Image_21 : 162|1@1+ (1,0) [0|1] "bool"  ACM
 SG_ OBJ_Top_Out_Of_Image_V_21 : 163|1@1+ (1,0) [0|1] "bool"  ACM
 SG_ OBJ_Bottom_Out_Of_Image_V_21 : 164|1@1+ (1,0) [0|1] "bool"  ACM
 SG_ OBJ_Lane_Assignment_21 : 165|3@1+ (1,0) [0|5] "ENUM"  ACM
 SG_ OBJ_Lane_Assignment_V_21 : 168|1@1+ (1,0) [0|1] "bool"  ACM
 SG_ OBJ_Age_Seconds_21 : 169|7@1+ (1,0) [0|100] "s"  ACM
 SG_ OBJ_Age_Seconds_V_21 : 176|1@1+ (1,0) [0|1] "bool"  ACM
 SG_ OBJ_Width_21 : 177|9@1+ (0.01,0) [0.4|2.95] "m"  ACM
 SG_ OBJ_Width_V_21 : 186|1@1+ (1,0) [0|1] "bool"  ACM
 SG_ OBJ_Width_STD_21 : 187|8@1+ (0.01,0) [0|2] "m"  ACM
 SG_ OBJ_Width_STD_V_21 : 195|1@1+ (1,0) [0|1] "bool"  ACM
 SG_ OBJ_Length_21 : 196|9@1+ (0.05,0) [1.2|21] "m"  ACM
 SG_ OBJ_Length_V_21 : 205|1@1+ (1,0) [0|1] "bool"  ACM
 SG_ OBJ_Length_STD_21 : 208|8@1+ (0.05,0) [0|10] "m"  ACM
 SG_ OBJ_Length_STD_V_21 : 216|1@1+ (1,0) [0|1] "bool"  ACM
 SG_ OBJ_Height_21 : 217|9@1+ (0.01,0) [0|2.95] "m"  ACM
 SG_ OBJ_Height_V_21 : 226|1@1+ (1,0) [0|1] "bool"  ACM
 SG_ OBJ_Height_STD_21 : 227|8@1+ (0.01,0) [0|2] "m"  ACM
 SG_ OBJ_Height_STD_V_21 : 235|1@1+ (1,0) [0|1] "bool"  ACM
 SG_ OBJ_Abs_Long_Velocity_21 : 240|12@1+ (0.05,-30) [-30|100] "MPS"  ACM
 SG_ OBJ_Abs_Long_Velocity_V_21 : 252|1@1+ (1,0) [0|1] "bool"  ACM
 SG_ OBJ_Abs_Long_Velocity_STD_21 : 253|11@1+ (0.05,0) [0|65] "MPS"  ACM
 SG_ OBJ_Abs_Long_Vel_STD_V_21 : 264|1@1+ (1,0) [0|1] "bool"  ACM
 SG_ OBJ_Abs_Lat_Velocity_21 : 272|11@1+ (0.05,-50) [-50|50] "MPS"  ACM
 SG_ OBJ_Abs_Lat_Velocity_V_21 : 283|1@1+ (1,0) [0|1] "bool"  ACM
 SG_ OBJ_Abs_Lat_Velocity_STD_21 : 284|10@1+ (0.05,0) [0|50] "MPS"  ACM
 SG_ OBJ_Abs_Lat_Vel_STD_V_21 : 294|1@1+ (1,0) [0|1] "bool"  ACM
 SG_ OBJ_Abs_Long_Acc_21 : 295|9@1+ (0.05,-10.3) [-10.3|7.3] "MPS2"  ACM
 SG_ OBJ_Abs_Long_Acc_V_21 : 304|1@1+ (1,0) [0|1] "bool"  ACM
 SG_ OBJ_Abs_Long_Acc_STD_21 : 305|8@1+ (0.05,0) [0|7.3] "MPS2"  ACM
 SG_ OBJ_Abs_Long_Acc_STD_V_21 : 313|1@1+ (1,0) [0|1] "bool"  ACM
 SG_ OBJ_Abs_Lat_Acc_21 : 314|9@1+ (0.05,-10.3) [-10.3|7.3] "MPS2"  ACM
 SG_ OBJ_Abs_Lat_Acc_V_21 : 323|1@1+ (1,0) [0|1] "bool"  ACM
 SG_ OBJ_Abs_Lat_Acc_STD_21 : 324|8@1+ (0.05,0) [0|7.3] "MPS2"  ACM
 SG_ OBJ_Abs_Lat_Acc_STD_V_21 : 332|1@1+ (1,0) [0|1] "bool"  ACM
 SG_ OBJ_Abs_Acceleration_21 : 336|9@1+ (0.05,-10.3) [-10.3|7.3] "MPS2"  ACM
 SG_ OBJ_Abs_Acceleration_V_21 : 345|1@1+ (1,0) [0|1] "bool"  ACM
 SG_ OBJ_Abs_Acc_STD_21 : 346|8@1+ (0.05,0) [0|7.3] "MPS2"  ACM
 SG_ OBJ_Abs_Acc_STD_V_21 : 354|1@1+ (1,0) [0|1] "bool"  ACM
 SG_ OBJ_Inv_TTC_21 : 355|11@1+ (0.01,-8) [-8|8] "INV(s)"  ACM
 SG_ OBJ_Inv_TTC_V_21 : 366|1@1+ (1,0) [0|1] "bool"  ACM
 SG_ OBJ_Inv_TTC_STD_21 : 368|11@1+ (0.01,0) [0|4] "INV(s)"  ACM
 SG_ OBJ_Inv_TTC_STD_V_21 : 379|1@1+ (1,0) [0|1] "bool"  ACM
 SG_ OBJ_Relative_Long_Acc_21 : 380|9@1+ (0.05,-10.3) [-10.3|7.3] "MPS2"  ACM
 SG_ OBJ_Relative_Long_Acc_V_21 : 389|1@1+ (1,0) [0|1] "bool"  ACM
 SG_ OBJ_Relative_Long_Acc_STD_21 : 390|8@1+ (0.05,0) [0|7.3] "MPS2"  ACM
 SG_ OBJ_Rel_Long_Acc_STD_V_21 : 398|1@1+ (1,0) [0|1] "bool"  ACM

BO_ 186 ICM_Object_Prot20_B: 64 MyECU
 SG_ ICM_Object_Prot20_B_Header : 0|16@1+ (1,0) [0|65535] ""  ACM
 SG_ OBJ_Relative_Long_Velocity_20 : 16|13@1+ (0.05,-120) [-120|130] "MPS"  ACM
 SG_ OBJ_Relative_Long_Velocity_V_20 : 29|1@1+ (1,0) [0|1] "bool"  ACM
 SG_ OBJ_Relative_Long_Vel_STD_20 : 30|12@1+ (0.05,0) [0|130] "MPS"  ACM
 SG_ OBJ_Rel_Long_Vel_STD_V_20 : 42|1@1+ (1,0) [0|1] "bool"  ACM
 SG_ OBJ_Relative_Lat_Velocity_20 : 48|11@1+ (0.05,-50) [-50|50] "MPS"  ACM
 SG_ OBJ_Relative_Lat_Velocity_V_20 : 59|1@1+ (1,0) [0|1] "bool"  ACM
 SG_ OBJ_Relative_Lat_Velocity_STD_20 : 60|10@1+ (0.05,0) [0|50] "MPS"  ACM
 SG_ OBJ_Rel_Lat_Vel_STD_V_20 : 70|1@1+ (1,0) [0|1] "bool"  ACM
 SG_ OBJ_Long_Distance_20 : 80|14@1+ (0.05,-200) [-200|250] "m"  ACM
 SG_ OBJ_Long_Distance_V_20 : 94|1@1+ (1,0) [0|1] "bool"  ACM
 SG_ OBJ_Long_Distance_STD_20 : 95|13@1+ (0.05,0) [0|250] "m"  ACM
 SG_ OBJ_Long_Distance_STD_V_20 : 108|1@1+ (1,0) [0|1] "bool"  ACM
 SG_ OBJ_Lat_Distance_20 : 112|12@1+ (0.05,-100) [-100|100] "m"  ACM
 SG_ OBJ_Lat_Distance_V_20 : 124|1@1+ (1,0) [0|1] "bool"  ACM
 SG_ OBJ_Lat_Distance_STD_20 : 125|11@1+ (0.05,0) [0|100] "m"  ACM
 SG_ OBJ_Lat_Distance_STD_V_20 : 136|1@1+ (1,0) [0|1] "bool"  ACM
 SG_ OBJ_Absolute_Speed_20 : 144|12@1+ (0.05,-65) [-65|65] "MPS"  ACM
 SG_ OBJ_Absolute_Speed_V_20 : 156|1@1+ (1,0) [0|1] "bool"  ACM
 SG_ OBJ_Absolute_Speed_STD_20 : 157|11@1+ (0.05,-65) [0|65] "MPS"  ACM
 SG_ OBJ_Absolute_Speed_STD_V_20 : 168|1@1+ (1,0) [0|1] "bool"  ACM
 SG_ OBJ_Heading_20 : 176|10@1+ (0.01,-3.14) [-3.14|3.14] "rad"  ACM
 SG_ OBJ_Heading_V_20 : 186|1@1+ (1,0) [0|1] "bool"  ACM
 SG_ OBJ_Heading_STD_20 : 187|9@1+ (0.01,0) [0|3.14] "rad"  ACM
 SG_ OBJ_Heading_STD_V_20 : 196|1@1+ (1,0) [0|1] "bool"  ACM
 SG_ OBJ_Angle_Rate_STD_20 : 197|11@1+ (0.002,0) [0|2.2318] "RPS"  ACM
 SG_ OBJ_Angle_Rate_STD_V_20 : 208|1@1+ (1,0) [0|1] "bool"  ACM
 SG_ OBJ_Angle_Rate_20 : 209|12@1+ (0.002,-2.234) [-2.234|2.2318] "RPS"  ACM
 SG_ OBJ_Angle_Rate_V_20 : 221|1@1+ (1,0) [0|1] "bool"  ACM
 SG_ OBJ_Angle_Right_20 : 222|14@1+ (0.0002,-1.571) [-1.571|1.571] "rad "  ACM
 SG_ OBJ_Angle_Right_V_20 : 236|1@1+ (1,0) [0|1] "bool"  ACM
 SG_ OBJ_Angle_Right_STD_20 : 240|13@1+ (0.0002,0) [0|1.571] "rad "  ACM
 SG_ OBJ_Angle_Right_STD_V_20 : 253|1@1+ (1,0) [0|1] "bool"  ACM
 SG_ OBJ_Angle_Left_20 : 254|14@1+ (0.0002,-1.571) [-1.571|1.571] "rad "  ACM
 SG_ OBJ_Angle_Left_V_20 : 268|1@1+ (1,0) [0|1] "bool"  ACM
 SG_ OBJ_Angle_Left_STD_20 : 272|13@1+ (0.0002,0) [0|1.571] "rad"  ACM
 SG_ OBJ_Angle_Left_STD_V_20 : 285|1@1+ (1,0) [0|1] "bool"  ACM
 SG_ OBJ_Angle_Side_20 : 286|14@1+ (0.0002,-1.571) [-1.571|1.571] "rad"  ACM
 SG_ OBJ_Angle_Side_V_20 : 300|1@1+ (1,0) [0|1] "bool"  ACM
 SG_ OBJ_Angle_Side_STD_20 : 304|13@1+ (0.0002,0) [0|1.571] "rad"  ACM
 SG_ OBJ_Angle_Side_STD_V_20 : 317|1@1+ (1,0) [0|1] "bool"  ACM
 SG_ OBJ_Angle_Mid_V_20 : 318|1@1+ (1,0) [0|1] "bool"  ACM
 SG_ OBJ_Angle_Mid_20 : 319|14@1+ (0.0002,-1.571) [-1.571|1.571] "rad"  ACM
 SG_ OBJ_Angle_Mid_STD_20 : 336|13@1+ (0.0002,0) [0|1.571] "rad"  ACM
 SG_ OBJ_Angle_Mid_STD_V_20 : 349|1@1+ (1,0) [0|1] "bool"  ACM
 SG_ OBJ_Angle_Bottom_V_20 : 350|1@1+ (1,0) [0|1] "bool"  ACM
 SG_ OBJ_Angle_Bottom_20 : 351|14@1+ (0.0002,-1.571) [-1.571|1.571] "rad"  ACM
 SG_ OBJ_Angle_Bottom_STD_20 : 368|13@1+ (0.0002,0) [0|1.571] "rad"  ACM
 SG_ OBJ_Angle_Bottom_STD_V_20 : 381|1@1+ (1,0) [0|1] "bool"  ACM
 SG_ OBJ_Visibility_Side_V_20 : 382|1@1+ (1,0) [0|1] "bool"  ACM
 SG_ OBJ_Visibility_Side_20 : 383|2@1+ (1,0) [0|2] "ENUM"  ACM
 SG_ OBJ_Is_In_Drivable_Area_20 : 385|1@1+ (1,0) [0|1] "bool"  ACM
 SG_ OBJ_Is_In_Drivable_Area_V_20 : 386|1@1+ (1,0) [0|1] "bool"  ACM
 SG_ OBJ_Is_VeryClose_20 : 387|1@1+ (1,0) [0|1] "bool"  ACM
 SG_ OBJ_Is_VeryClose_V_20 : 388|1@1+ (1,0) [0|1] "bool"  ACM
 SG_ OBJ_Buffer_20 : 389|11@1+ (1,0) [0|0] "NA"  ACM

BO_ 185 ICM_Object_Prot20_A: 64 MyECU
 SG_ ICM_Object_Prot20_A_Header : 0|16@1+ (1,0) [0|65535] ""  ACM
 SG_ OBJ_CRC_20 : 16|32@1+ (1,0) [0|4294967295] "NA"  ACM
 SG_ OBJ_ID_20 : 48|8@1+ (1,0) [0|255] "NA"  ACM
 SG_ OBJ_Existence_Probability_20 : 56|8@1+ (0.01,0) [0|1] "NA"  ACM
 SG_ OBJ_Fusion_Source_20 : 64|16@1+ (1,0) [0|65535] "BITWIZE"  ACM
 SG_ OBJ_Triggered_SDM_20 : 80|2@1+ (1,0) [0|2] "ENUM"  ACM
 SG_ OBJ_Motion_Category_20 : 82|4@1+ (1,0) [0|13] "ENUM "  ACM
 SG_ OBJ_Moving_IN_Probability_20 : 86|7@1+ (0.01,0) [0|0] "NA"  ACM
 SG_ OBJ_Object_Age_20 : 93|11@1+ (1,0) [0|2047] "Frame"  ACM
 SG_ OBJ_Measuring_Status_20 : 104|3@1+ (1,0) [0|7] "BITWIZE"  ACM
 SG_ OBJ_Object_Class_20 : 107|4@1+ (1,0) [0|8] "ENUM"  ACM
 SG_ OBJ_Class_Probability_20 : 112|7@1+ (0.01,0) [0|1] "NA"  ACM
 SG_ OBJ_Car_Probability_20 : 119|7@1+ (0.01,0) [0|0] "NA"  ACM
 SG_ OBJ_Truck_Probability_20 : 126|7@1+ (0.01,0) [0|0] "NA"  ACM
 SG_ OBJ_Bike_Probability_20 : 133|7@1+ (0.01,0) [0|0] "NA"  ACM
 SG_ OBJ_Camera_Source_20 : 140|4@1+ (1,0) [0|15] "ENUM"  ACM
 SG_ OBJ_Motion_Status_20 : 144|3@1+ (1,0) [0|5] "ENUM "  ACM
 SG_ OBJ_Motion_Orientation_20 : 147|4@1+ (1,0) [0|13] "ENUM "  ACM
 SG_ OBJ_Has_Cut_Lane_20 : 151|1@1+ (1,0) [0|1] "bool"  ACM
 SG_ OBJ_Has_Cut_Path_20 : 152|1@1+ (1,0) [0|1] "bool"  ACM
 SG_ OBJ_Brake_Light_20 : 153|1@1+ (1,0) [0|1] "bool"  ACM
 SG_ OBJ_Turn_Indicator_Right_20 : 154|1@1+ (1,0) [0|1] "bool"  ACM
 SG_ OBJ_Turn_Indicator_Left_20 : 155|1@1+ (1,0) [0|1] "bool"  ACM
 SG_ OBJ_Light_Indicator_Validity_20 : 156|1@1+ (1,0) [0|1] "bool"  ACM
 SG_ OBJ_Right_Out_Of_Image_20 : 157|1@1+ (1,0) [0|1] "bool"  ACM
 SG_ OBJ_Left_Out_Of_Image_20 : 158|1@1+ (1,0) [0|1] "bool"  ACM
 SG_ OBJ_Right_Out_Of_Image_V_20 : 159|1@1+ (1,0) [0|1] "bool"  ACM
 SG_ OBJ_Left_Out_Of_Image_V_20 : 160|1@1+ (1,0) [0|1] "bool"  ACM
 SG_ OBJ_Top_Out_Of_Image_20 : 161|1@1+ (1,0) [0|1] "bool"  ACM
 SG_ OBJ_Bottom_Out_Of_Image_20 : 162|1@1+ (1,0) [0|1] "bool"  ACM
 SG_ OBJ_Top_Out_Of_Image_V_20 : 163|1@1+ (1,0) [0|1] "bool"  ACM
 SG_ OBJ_Bottom_Out_Of_Image_V_20 : 164|1@1+ (1,0) [0|1] "bool"  ACM
 SG_ OBJ_Lane_Assignment_20 : 165|3@1+ (1,0) [0|5] "ENUM"  ACM
 SG_ OBJ_Lane_Assignment_V_20 : 168|1@1+ (1,0) [0|1] "bool"  ACM
 SG_ OBJ_Age_Seconds_20 : 169|7@1+ (1,0) [0|100] "s"  ACM
 SG_ OBJ_Age_Seconds_V_20 : 176|1@1+ (1,0) [0|1] "bool"  ACM
 SG_ OBJ_Width_20 : 177|9@1+ (0.01,0) [0.4|2.95] "m"  ACM
 SG_ OBJ_Width_V_20 : 186|1@1+ (1,0) [0|1] "bool"  ACM
 SG_ OBJ_Width_STD_20 : 187|8@1+ (0.01,0) [0|2] "m"  ACM
 SG_ OBJ_Width_STD_V_20 : 195|1@1+ (1,0) [0|1] "bool"  ACM
 SG_ OBJ_Length_20 : 196|9@1+ (0.05,0) [1.2|21] "m"  ACM
 SG_ OBJ_Length_V_20 : 205|1@1+ (1,0) [0|1] "bool"  ACM
 SG_ OBJ_Length_STD_20 : 208|8@1+ (0.05,0) [0|10] "m"  ACM
 SG_ OBJ_Length_STD_V_20 : 216|1@1+ (1,0) [0|1] "bool"  ACM
 SG_ OBJ_Height_20 : 217|9@1+ (0.01,0) [0|2.95] "m"  ACM
 SG_ OBJ_Height_V_20 : 226|1@1+ (1,0) [0|1] "bool"  ACM
 SG_ OBJ_Height_STD_20 : 227|8@1+ (0.01,0) [0|2] "m"  ACM
 SG_ OBJ_Height_STD_V_20 : 235|1@1+ (1,0) [0|1] "bool"  ACM
 SG_ OBJ_Abs_Long_Velocity_20 : 240|12@1+ (0.05,-30) [-30|100] "MPS"  ACM
 SG_ OBJ_Abs_Long_Velocity_V_20 : 252|1@1+ (1,0) [0|1] "bool"  ACM
 SG_ OBJ_Abs_Long_Velocity_STD_20 : 253|11@1+ (0.05,0) [0|65] "MPS"  ACM
 SG_ OBJ_Abs_Long_Vel_STD_V_20 : 264|1@1+ (1,0) [0|1] "bool"  ACM
 SG_ OBJ_Abs_Lat_Velocity_20 : 272|11@1+ (0.05,-50) [-50|50] "MPS"  ACM
 SG_ OBJ_Abs_Lat_Velocity_V_20 : 283|1@1+ (1,0) [0|1] "bool"  ACM
 SG_ OBJ_Abs_Lat_Velocity_STD_20 : 284|10@1+ (0.05,0) [0|50] "MPS"  ACM
 SG_ OBJ_Abs_Lat_Vel_STD_V_20 : 294|1@1+ (1,0) [0|1] "bool"  ACM
 SG_ OBJ_Abs_Long_Acc_20 : 295|9@1+ (0.05,-10.3) [-10.3|7.3] "MPS2"  ACM
 SG_ OBJ_Abs_Long_Acc_V_20 : 304|1@1+ (1,0) [0|1] "bool"  ACM
 SG_ OBJ_Abs_Long_Acc_STD_20 : 305|8@1+ (0.05,0) [0|7.3] "MPS2"  ACM
 SG_ OBJ_Abs_Long_Acc_STD_V_20 : 313|1@1+ (1,0) [0|1] "bool"  ACM
 SG_ OBJ_Abs_Lat_Acc_20 : 314|9@1+ (0.05,-10.3) [-10.3|7.3] "MPS2"  ACM
 SG_ OBJ_Abs_Lat_Acc_V_20 : 323|1@1+ (1,0) [0|1] "bool"  ACM
 SG_ OBJ_Abs_Lat_Acc_STD_20 : 324|8@1+ (0.05,0) [0|7.3] "MPS2"  ACM
 SG_ OBJ_Abs_Lat_Acc_STD_V_20 : 332|1@1+ (1,0) [0|1] "bool"  ACM
 SG_ OBJ_Abs_Acceleration_20 : 336|9@1+ (0.05,-10.3) [-10.3|7.3] "MPS2"  ACM
 SG_ OBJ_Abs_Acceleration_V_20 : 345|1@1+ (1,0) [0|1] "bool"  ACM
 SG_ OBJ_Abs_Acc_STD_20 : 346|8@1+ (0.05,0) [0|7.3] "MPS2"  ACM
 SG_ OBJ_Abs_Acc_STD_V_20 : 354|1@1+ (1,0) [0|1] "bool"  ACM
 SG_ OBJ_Inv_TTC_20 : 355|11@1+ (0.01,-8) [-8|8] "INV(s)"  ACM
 SG_ OBJ_Inv_TTC_V_20 : 366|1@1+ (1,0) [0|1] "bool"  ACM
 SG_ OBJ_Inv_TTC_STD_20 : 368|11@1+ (0.01,0) [0|4] "INV(s)"  ACM
 SG_ OBJ_Inv_TTC_STD_V_20 : 379|1@1+ (1,0) [0|1] "bool"  ACM
 SG_ OBJ_Relative_Long_Acc_20 : 380|9@1+ (0.05,-10.3) [-10.3|7.3] "MPS2"  ACM
 SG_ OBJ_Relative_Long_Acc_V_20 : 389|1@1+ (1,0) [0|1] "bool"  ACM
 SG_ OBJ_Relative_Long_Acc_STD_20 : 390|8@1+ (0.05,0) [0|7.3] "MPS2"  ACM
 SG_ OBJ_Rel_Long_Acc_STD_V_20 : 398|1@1+ (1,0) [0|1] "bool"  ACM

BO_ 184 ICM_Object_Prot19_B: 64 MyECU
 SG_ ICM_Object_Prot19_B_Header : 0|16@1+ (1,0) [0|65535] ""  ACM
 SG_ OBJ_Relative_Long_Velocity_19 : 16|13@1+ (0.05,-120) [-120|130] "MPS"  ACM
 SG_ OBJ_Relative_Long_Velocity_V_19 : 29|1@1+ (1,0) [0|1] "bool"  ACM
 SG_ OBJ_Relative_Long_Vel_STD_19 : 30|12@1+ (0.05,0) [0|130] "MPS"  ACM
 SG_ OBJ_Rel_Long_Vel_STD_V_19 : 42|1@1+ (1,0) [0|1] "bool"  ACM
 SG_ OBJ_Relative_Lat_Velocity_19 : 48|11@1+ (0.05,-50) [-50|50] "MPS"  ACM
 SG_ OBJ_Relative_Lat_Velocity_V_19 : 59|1@1+ (1,0) [0|1] "bool"  ACM
 SG_ OBJ_Relative_Lat_Velocity_STD_19 : 60|10@1+ (0.05,0) [0|50] "MPS"  ACM
 SG_ OBJ_Rel_Lat_Vel_STD_V_19 : 70|1@1+ (1,0) [0|1] "bool"  ACM
 SG_ OBJ_Long_Distance_19 : 80|14@1+ (0.05,-200) [-200|250] "m"  ACM
 SG_ OBJ_Long_Distance_V_19 : 94|1@1+ (1,0) [0|1] "bool"  ACM
 SG_ OBJ_Long_Distance_STD_19 : 95|13@1+ (0.05,0) [0|250] "m"  ACM
 SG_ OBJ_Long_Distance_STD_V_19 : 108|1@1+ (1,0) [0|1] "bool"  ACM
 SG_ OBJ_Lat_Distance_19 : 112|12@1+ (0.05,-100) [-100|100] "m"  ACM
 SG_ OBJ_Lat_Distance_V_19 : 124|1@1+ (1,0) [0|1] "bool"  ACM
 SG_ OBJ_Lat_Distance_STD_19 : 125|11@1+ (0.05,0) [0|100] "m"  ACM
 SG_ OBJ_Lat_Distance_STD_V_19 : 136|1@1+ (1,0) [0|1] "bool"  ACM
 SG_ OBJ_Absolute_Speed_19 : 144|12@1+ (0.05,-65) [-65|65] "MPS"  ACM
 SG_ OBJ_Absolute_Speed_V_19 : 156|1@1+ (1,0) [0|1] "bool"  ACM
 SG_ OBJ_Absolute_Speed_STD_19 : 157|11@1+ (0.05,-65) [0|65] "MPS"  ACM
 SG_ OBJ_Absolute_Speed_STD_V_19 : 168|1@1+ (1,0) [0|1] "bool"  ACM
 SG_ OBJ_Heading_19 : 176|10@1+ (0.01,-3.14) [-3.14|3.14] "rad"  ACM
 SG_ OBJ_Heading_V_19 : 186|1@1+ (1,0) [0|1] "bool"  ACM
 SG_ OBJ_Heading_STD_19 : 187|9@1+ (0.01,0) [0|3.14] "rad"  ACM
 SG_ OBJ_Heading_STD_V_19 : 196|1@1+ (1,0) [0|1] "bool"  ACM
 SG_ OBJ_Angle_Rate_STD_19 : 197|11@1+ (0.002,0) [0|2.2318] "RPS"  ACM
 SG_ OBJ_Angle_Rate_STD_V_19 : 208|1@1+ (1,0) [0|1] "bool"  ACM
 SG_ OBJ_Angle_Rate_19 : 209|12@1+ (0.002,-2.234) [-2.234|2.2318] "RPS"  ACM
 SG_ OBJ_Angle_Rate_V_19 : 221|1@1+ (1,0) [0|1] "bool"  ACM
 SG_ OBJ_Angle_Right_19 : 222|14@1+ (0.0002,-1.571) [-1.571|1.571] "rad "  ACM
 SG_ OBJ_Angle_Right_V_19 : 236|1@1+ (1,0) [0|1] "bool"  ACM
 SG_ OBJ_Angle_Right_STD_19 : 240|13@1+ (0.0002,0) [0|1.571] "rad "  ACM
 SG_ OBJ_Angle_Right_STD_V_19 : 253|1@1+ (1,0) [0|1] "bool"  ACM
 SG_ OBJ_Angle_Left_19 : 254|14@1+ (0.0002,-1.571) [-1.571|1.571] "rad "  ACM
 SG_ OBJ_Angle_Left_V_19 : 268|1@1+ (1,0) [0|1] "bool"  ACM
 SG_ OBJ_Angle_Left_STD_19 : 272|13@1+ (0.0002,0) [0|1.571] "rad"  ACM
 SG_ OBJ_Angle_Left_STD_V_19 : 285|1@1+ (1,0) [0|1] "bool"  ACM
 SG_ OBJ_Angle_Side_19 : 286|14@1+ (0.0002,-1.571) [-1.571|1.571] "rad"  ACM
 SG_ OBJ_Angle_Side_V_19 : 300|1@1+ (1,0) [0|1] "bool"  ACM
 SG_ OBJ_Angle_Side_STD_19 : 304|13@1+ (0.0002,0) [0|1.571] "rad"  ACM
 SG_ OBJ_Angle_Side_STD_V_19 : 317|1@1+ (1,0) [0|1] "bool"  ACM
 SG_ OBJ_Angle_Mid_V_19 : 318|1@1+ (1,0) [0|1] "bool"  ACM
 SG_ OBJ_Angle_Mid_19 : 319|14@1+ (0.0002,-1.571) [-1.571|1.571] "rad"  ACM
 SG_ OBJ_Angle_Mid_STD_19 : 336|13@1+ (0.0002,0) [0|1.571] "rad"  ACM
 SG_ OBJ_Angle_Mid_STD_V_19 : 349|1@1+ (1,0) [0|1] "bool"  ACM
 SG_ OBJ_Angle_Bottom_V_19 : 350|1@1+ (1,0) [0|1] "bool"  ACM
 SG_ OBJ_Angle_Bottom_19 : 351|14@1+ (0.0002,-1.571) [-1.571|1.571] "rad"  ACM
 SG_ OBJ_Angle_Bottom_STD_19 : 368|13@1+ (0.0002,0) [0|1.571] "rad"  ACM
 SG_ OBJ_Angle_Bottom_STD_V_19 : 381|1@1+ (1,0) [0|1] "bool"  ACM
 SG_ OBJ_Visibility_Side_V_19 : 382|1@1+ (1,0) [0|1] "bool"  ACM
 SG_ OBJ_Visibility_Side_19 : 383|2@1+ (1,0) [0|2] "ENUM"  ACM
 SG_ OBJ_Is_In_Drivable_Area_19 : 385|1@1+ (1,0) [0|1] "bool"  ACM
 SG_ OBJ_Is_In_Drivable_Area_V_19 : 386|1@1+ (1,0) [0|1] "bool"  ACM
 SG_ OBJ_Is_VeryClose_19 : 387|1@1+ (1,0) [0|1] "bool"  ACM
 SG_ OBJ_Is_VeryClose_V_19 : 388|1@1+ (1,0) [0|1] "bool"  ACM
 SG_ OBJ_Buffer_19 : 389|11@1+ (1,0) [0|0] "NA"  ACM

BO_ 183 ICM_Object_Prot19_A: 64 MyECU
 SG_ ICM_Object_Prot19_A_Header : 0|16@1+ (1,0) [0|65535] ""  ACM
 SG_ OBJ_CRC_19 : 16|32@1+ (1,0) [0|4294967295] "NA"  ACM
 SG_ OBJ_ID_19 : 48|8@1+ (1,0) [0|255] "NA"  ACM
 SG_ OBJ_Existence_Probability_19 : 56|8@1+ (0.01,0) [0|1] "NA"  ACM
 SG_ OBJ_Fusion_Source_19 : 64|16@1+ (1,0) [0|65535] "BITWIZE"  ACM
 SG_ OBJ_Triggered_SDM_19 : 80|2@1+ (1,0) [0|2] "ENUM"  ACM
 SG_ OBJ_Motion_Category_19 : 82|4@1+ (1,0) [0|13] "ENUM "  ACM
 SG_ OBJ_Moving_IN_Probability_19 : 86|7@1+ (0.01,0) [0|0] "NA"  ACM
 SG_ OBJ_Object_Age_19 : 93|11@1+ (1,0) [0|2047] "Frame"  ACM
 SG_ OBJ_Measuring_Status_19 : 104|3@1+ (1,0) [0|7] "BITWIZE"  ACM
 SG_ OBJ_Object_Class_19 : 107|4@1+ (1,0) [0|8] "ENUM"  ACM
 SG_ OBJ_Class_Probability_19 : 112|7@1+ (0.01,0) [0|1] "NA"  ACM
 SG_ OBJ_Car_Probability_19 : 119|7@1+ (0.01,0) [0|0] "NA"  ACM
 SG_ OBJ_Truck_Probability_19 : 126|7@1+ (0.01,0) [0|0] "NA"  ACM
 SG_ OBJ_Bike_Probability_19 : 133|7@1+ (0.01,0) [0|0] "NA"  ACM
 SG_ OBJ_Camera_Source_19 : 140|4@1+ (1,0) [0|15] "ENUM"  ACM
 SG_ OBJ_Motion_Status_19 : 144|3@1+ (1,0) [0|5] "ENUM "  ACM
 SG_ OBJ_Motion_Orientation_19 : 147|4@1+ (1,0) [0|13] "ENUM "  ACM
 SG_ OBJ_Has_Cut_Lane_19 : 151|1@1+ (1,0) [0|1] "bool"  ACM
 SG_ OBJ_Has_Cut_Path_19 : 152|1@1+ (1,0) [0|1] "bool"  ACM
 SG_ OBJ_Brake_Light_19 : 153|1@1+ (1,0) [0|1] "bool"  ACM
 SG_ OBJ_Turn_Indicator_Right_19 : 154|1@1+ (1,0) [0|1] "bool"  ACM
 SG_ OBJ_Turn_Indicator_Left_19 : 155|1@1+ (1,0) [0|1] "bool"  ACM
 SG_ OBJ_Light_Indicator_Validity_19 : 156|1@1+ (1,0) [0|1] "bool"  ACM
 SG_ OBJ_Right_Out_Of_Image_19 : 157|1@1+ (1,0) [0|1] "bool"  ACM
 SG_ OBJ_Left_Out_Of_Image_19 : 158|1@1+ (1,0) [0|1] "bool"  ACM
 SG_ OBJ_Right_Out_Of_Image_V_19 : 159|1@1+ (1,0) [0|1] "bool"  ACM
 SG_ OBJ_Left_Out_Of_Image_V_19 : 160|1@1+ (1,0) [0|1] "bool"  ACM
 SG_ OBJ_Top_Out_Of_Image_19 : 161|1@1+ (1,0) [0|1] "bool"  ACM
 SG_ OBJ_Bottom_Out_Of_Image_19 : 162|1@1+ (1,0) [0|1] "bool"  ACM
 SG_ OBJ_Top_Out_Of_Image_V_19 : 163|1@1+ (1,0) [0|1] "bool"  ACM
 SG_ OBJ_Bottom_Out_Of_Image_V_19 : 164|1@1+ (1,0) [0|1] "bool"  ACM
 SG_ OBJ_Lane_Assignment_19 : 165|3@1+ (1,0) [0|5] "ENUM"  ACM
 SG_ OBJ_Lane_Assignment_V_19 : 168|1@1+ (1,0) [0|1] "bool"  ACM
 SG_ OBJ_Age_Seconds_19 : 169|7@1+ (1,0) [0|100] "s"  ACM
 SG_ OBJ_Age_Seconds_V_19 : 176|1@1+ (1,0) [0|1] "bool"  ACM
 SG_ OBJ_Width_19 : 177|9@1+ (0.01,0) [0.4|2.95] "m"  ACM
 SG_ OBJ_Width_V_19 : 186|1@1+ (1,0) [0|1] "bool"  ACM
 SG_ OBJ_Width_STD_19 : 187|8@1+ (0.01,0) [0|2] "m"  ACM
 SG_ OBJ_Width_STD_V_19 : 195|1@1+ (1,0) [0|1] "bool"  ACM
 SG_ OBJ_Length_19 : 196|9@1+ (0.05,0) [1.2|21] "m"  ACM
 SG_ OBJ_Length_V_19 : 205|1@1+ (1,0) [0|1] "bool"  ACM
 SG_ OBJ_Length_STD_19 : 208|8@1+ (0.05,0) [0|10] "m"  ACM
 SG_ OBJ_Length_STD_V_19 : 216|1@1+ (1,0) [0|1] "bool"  ACM
 SG_ OBJ_Height_19 : 217|9@1+ (0.01,0) [0|2.95] "m"  ACM
 SG_ OBJ_Height_V_19 : 226|1@1+ (1,0) [0|1] "bool"  ACM
 SG_ OBJ_Height_STD_19 : 227|8@1+ (0.01,0) [0|2] "m"  ACM
 SG_ OBJ_Height_STD_V_19 : 235|1@1+ (1,0) [0|1] "bool"  ACM
 SG_ OBJ_Abs_Long_Velocity_19 : 240|12@1+ (0.05,-30) [-30|100] "MPS"  ACM
 SG_ OBJ_Abs_Long_Velocity_V_19 : 252|1@1+ (1,0) [0|1] "bool"  ACM
 SG_ OBJ_Abs_Long_Velocity_STD_19 : 253|11@1+ (0.05,0) [0|65] "MPS"  ACM
 SG_ OBJ_Abs_Long_Vel_STD_V_19 : 264|1@1+ (1,0) [0|1] "bool"  ACM
 SG_ OBJ_Abs_Lat_Velocity_19 : 272|11@1+ (0.05,-50) [-50|50] "MPS"  ACM
 SG_ OBJ_Abs_Lat_Velocity_V_19 : 283|1@1+ (1,0) [0|1] "bool"  ACM
 SG_ OBJ_Abs_Lat_Velocity_STD_19 : 284|10@1+ (0.05,0) [0|50] "MPS"  ACM
 SG_ OBJ_Abs_Lat_Vel_STD_V_19 : 294|1@1+ (1,0) [0|1] "bool"  ACM
 SG_ OBJ_Abs_Long_Acc_19 : 295|9@1+ (0.05,-10.3) [-10.3|7.3] "MPS2"  ACM
 SG_ OBJ_Abs_Long_Acc_V_19 : 304|1@1+ (1,0) [0|1] "bool"  ACM
 SG_ OBJ_Abs_Long_Acc_STD_19 : 305|8@1+ (0.05,0) [0|7.3] "MPS2"  ACM
 SG_ OBJ_Abs_Long_Acc_STD_V_19 : 313|1@1+ (1,0) [0|1] "bool"  ACM
 SG_ OBJ_Abs_Lat_Acc_19 : 314|9@1+ (0.05,-10.3) [-10.3|7.3] "MPS2"  ACM
 SG_ OBJ_Abs_Lat_Acc_V_19 : 323|1@1+ (1,0) [0|1] "bool"  ACM
 SG_ OBJ_Abs_Lat_Acc_STD_19 : 324|8@1+ (0.05,0) [0|7.3] "MPS2"  ACM
 SG_ OBJ_Abs_Lat_Acc_STD_V_19 : 332|1@1+ (1,0) [0|1] "bool"  ACM
 SG_ OBJ_Abs_Acceleration_19 : 336|9@1+ (0.05,-10.3) [-10.3|7.3] "MPS2"  ACM
 SG_ OBJ_Abs_Acceleration_V_19 : 345|1@1+ (1,0) [0|1] "bool"  ACM
 SG_ OBJ_Abs_Acc_STD_19 : 346|8@1+ (0.05,0) [0|7.3] "MPS2"  ACM
 SG_ OBJ_Abs_Acc_STD_V_19 : 354|1@1+ (1,0) [0|1] "bool"  ACM
 SG_ OBJ_Inv_TTC_19 : 355|11@1+ (0.01,-8) [-8|8] "INV(s)"  ACM
 SG_ OBJ_Inv_TTC_V_19 : 366|1@1+ (1,0) [0|1] "bool"  ACM
 SG_ OBJ_Inv_TTC_STD_19 : 368|11@1+ (0.01,0) [0|4] "INV(s)"  ACM
 SG_ OBJ_Inv_TTC_STD_V_19 : 379|1@1+ (1,0) [0|1] "bool"  ACM
 SG_ OBJ_Relative_Long_Acc_19 : 380|9@1+ (0.05,-10.3) [-10.3|7.3] "MPS2"  ACM
 SG_ OBJ_Relative_Long_Acc_V_19 : 389|1@1+ (1,0) [0|1] "bool"  ACM
 SG_ OBJ_Relative_Long_Acc_STD_19 : 390|8@1+ (0.05,0) [0|7.3] "MPS2"  ACM
 SG_ OBJ_Rel_Long_Acc_STD_V_19 : 398|1@1+ (1,0) [0|1] "bool"  ACM

BO_ 182 ICM_Object_Prot18_B: 64 MyECU
 SG_ ICM_Object_Prot18_B_Header : 0|16@1+ (1,0) [0|65535] ""  ACM
 SG_ OBJ_Relative_Long_Velocity_18 : 16|13@1+ (0.05,-120) [-120|130] "MPS"  ACM
 SG_ OBJ_Relative_Long_Velocity_V_18 : 29|1@1+ (1,0) [0|1] "bool"  ACM
 SG_ OBJ_Relative_Long_Vel_STD_18 : 30|12@1+ (0.05,0) [0|130] "MPS"  ACM
 SG_ OBJ_Rel_Long_Vel_STD_V_18 : 42|1@1+ (1,0) [0|1] "bool"  ACM
 SG_ OBJ_Relative_Lat_Velocity_18 : 48|11@1+ (0.05,-50) [-50|50] "MPS"  ACM
 SG_ OBJ_Relative_Lat_Velocity_V_18 : 59|1@1+ (1,0) [0|1] "bool"  ACM
 SG_ OBJ_Relative_Lat_Velocity_STD_18 : 60|10@1+ (0.05,0) [0|50] "MPS"  ACM
 SG_ OBJ_Rel_Lat_Vel_STD_V_18 : 70|1@1+ (1,0) [0|1] "bool"  ACM
 SG_ OBJ_Long_Distance_18 : 80|14@1+ (0.05,-200) [-200|250] "m"  ACM
 SG_ OBJ_Long_Distance_V_18 : 94|1@1+ (1,0) [0|1] "bool"  ACM
 SG_ OBJ_Long_Distance_STD_18 : 95|13@1+ (0.05,0) [0|250] "m"  ACM
 SG_ OBJ_Long_Distance_STD_V_18 : 108|1@1+ (1,0) [0|1] "bool"  ACM
 SG_ OBJ_Lat_Distance_18 : 112|12@1+ (0.05,-100) [-100|100] "m"  ACM
 SG_ OBJ_Lat_Distance_V_18 : 124|1@1+ (1,0) [0|1] "bool"  ACM
 SG_ OBJ_Lat_Distance_STD_18 : 125|11@1+ (0.05,0) [0|100] "m"  ACM
 SG_ OBJ_Lat_Distance_STD_V_18 : 136|1@1+ (1,0) [0|1] "bool"  ACM
 SG_ OBJ_Absolute_Speed_18 : 144|12@1+ (0.05,-65) [-65|65] "MPS"  ACM
 SG_ OBJ_Absolute_Speed_V_18 : 156|1@1+ (1,0) [0|1] "bool"  ACM
 SG_ OBJ_Absolute_Speed_STD_18 : 157|11@1+ (0.05,-65) [0|65] "MPS"  ACM
 SG_ OBJ_Absolute_Speed_STD_V_18 : 168|1@1+ (1,0) [0|1] "bool"  ACM
 SG_ OBJ_Heading_18 : 176|10@1+ (0.01,-3.14) [-3.14|3.14] "rad"  ACM
 SG_ OBJ_Heading_V_18 : 186|1@1+ (1,0) [0|1] "bool"  ACM
 SG_ OBJ_Heading_STD_18 : 187|9@1+ (0.01,0) [0|3.14] "rad"  ACM
 SG_ OBJ_Heading_STD_V_18 : 196|1@1+ (1,0) [0|1] "bool"  ACM
 SG_ OBJ_Angle_Rate_STD_18 : 197|11@1+ (0.002,0) [0|2.2318] "RPS"  ACM
 SG_ OBJ_Angle_Rate_STD_V_18 : 208|1@1+ (1,0) [0|1] "bool"  ACM
 SG_ OBJ_Angle_Rate_18 : 209|12@1+ (0.002,-2.234) [-2.234|2.2318] "RPS"  ACM
 SG_ OBJ_Angle_Rate_V_18 : 221|1@1+ (1,0) [0|1] "bool"  ACM
 SG_ OBJ_Angle_Right_18 : 222|14@1+ (0.0002,-1.571) [-1.571|1.571] "rad "  ACM
 SG_ OBJ_Angle_Right_V_18 : 236|1@1+ (1,0) [0|1] "bool"  ACM
 SG_ OBJ_Angle_Right_STD_18 : 240|13@1+ (0.0002,0) [0|1.571] "rad "  ACM
 SG_ OBJ_Angle_Right_STD_V_18 : 253|1@1+ (1,0) [0|1] "bool"  ACM
 SG_ OBJ_Angle_Left_18 : 254|14@1+ (0.0002,-1.571) [-1.571|1.571] "rad "  ACM
 SG_ OBJ_Angle_Left_V_18 : 268|1@1+ (1,0) [0|1] "bool"  ACM
 SG_ OBJ_Angle_Left_STD_18 : 272|13@1+ (0.0002,0) [0|1.571] "rad"  ACM
 SG_ OBJ_Angle_Left_STD_V_18 : 285|1@1+ (1,0) [0|1] "bool"  ACM
 SG_ OBJ_Angle_Side_18 : 286|14@1+ (0.0002,-1.571) [-1.571|1.571] "rad"  ACM
 SG_ OBJ_Angle_Side_V_18 : 300|1@1+ (1,0) [0|1] "bool"  ACM
 SG_ OBJ_Angle_Side_STD_18 : 304|13@1+ (0.0002,0) [0|1.571] "rad"  ACM
 SG_ OBJ_Angle_Side_STD_V_18 : 317|1@1+ (1,0) [0|1] "bool"  ACM
 SG_ OBJ_Angle_Mid_V_18 : 318|1@1+ (1,0) [0|1] "bool"  ACM
 SG_ OBJ_Angle_Mid_18 : 319|14@1+ (0.0002,-1.571) [-1.571|1.571] "rad"  ACM
 SG_ OBJ_Angle_Mid_STD_18 : 336|13@1+ (0.0002,0) [0|1.571] "rad"  ACM
 SG_ OBJ_Angle_Mid_STD_V_18 : 349|1@1+ (1,0) [0|1] "bool"  ACM
 SG_ OBJ_Angle_Bottom_V_18 : 350|1@1+ (1,0) [0|1] "bool"  ACM
 SG_ OBJ_Angle_Bottom_18 : 351|14@1+ (0.0002,-1.571) [-1.571|1.571] "rad"  ACM
 SG_ OBJ_Angle_Bottom_STD_18 : 368|13@1+ (0.0002,0) [0|1.571] "rad"  ACM
 SG_ OBJ_Angle_Bottom_STD_V_18 : 381|1@1+ (1,0) [0|1] "bool"  ACM
 SG_ OBJ_Visibility_Side_V_18 : 382|1@1+ (1,0) [0|1] "bool"  ACM
 SG_ OBJ_Visibility_Side_18 : 383|2@1+ (1,0) [0|2] "ENUM"  ACM
 SG_ OBJ_Is_In_Drivable_Area_18 : 385|1@1+ (1,0) [0|1] "bool"  ACM
 SG_ OBJ_Is_In_Drivable_Area_V_18 : 386|1@1+ (1,0) [0|1] "bool"  ACM
 SG_ OBJ_Is_VeryClose_18 : 387|1@1+ (1,0) [0|1] "bool"  ACM
 SG_ OBJ_Is_VeryClose_V_18 : 388|1@1+ (1,0) [0|1] "bool"  ACM
 SG_ OBJ_Buffer_18 : 389|11@1+ (1,0) [0|0] "NA"  ACM

BO_ 181 ICM_Object_Prot18_A: 64 MyECU
 SG_ ICM_Object_Prot18_A_Header : 0|16@1+ (1,0) [0|65535] ""  ACM
 SG_ OBJ_CRC_18 : 16|32@1+ (1,0) [0|4294967295] "NA"  ACM
 SG_ OBJ_ID_18 : 48|8@1+ (1,0) [0|255] "NA"  ACM
 SG_ OBJ_Existence_Probability_18 : 56|8@1+ (0.01,0) [0|1] "NA"  ACM
 SG_ OBJ_Fusion_Source_18 : 64|16@1+ (1,0) [0|65535] "BITWIZE"  ACM
 SG_ OBJ_Triggered_SDM_18 : 80|2@1+ (1,0) [0|2] "ENUM"  ACM
 SG_ OBJ_Motion_Category_18 : 82|4@1+ (1,0) [0|13] "ENUM "  ACM
 SG_ OBJ_Moving_IN_Probability_18 : 86|7@1+ (0.01,0) [0|0] "NA"  ACM
 SG_ OBJ_Object_Age_18 : 93|11@1+ (1,0) [0|2047] "Frame"  ACM
 SG_ OBJ_Measuring_Status_18 : 104|3@1+ (1,0) [0|7] "BITWIZE"  ACM
 SG_ OBJ_Object_Class_18 : 107|4@1+ (1,0) [0|8] "ENUM"  ACM
 SG_ OBJ_Class_Probability_18 : 112|7@1+ (0.01,0) [0|1] "NA"  ACM
 SG_ OBJ_Car_Probability_18 : 119|7@1+ (0.01,0) [0|0] "NA"  ACM
 SG_ OBJ_Truck_Probability_18 : 126|7@1+ (0.01,0) [0|0] "NA"  ACM
 SG_ OBJ_Bike_Probability_18 : 133|7@1+ (0.01,0) [0|0] "NA"  ACM
 SG_ OBJ_Camera_Source_18 : 140|4@1+ (1,0) [0|15] "ENUM"  ACM
 SG_ OBJ_Motion_Status_18 : 144|3@1+ (1,0) [0|5] "ENUM "  ACM
 SG_ OBJ_Motion_Orientation_18 : 147|4@1+ (1,0) [0|13] "ENUM "  ACM
 SG_ OBJ_Has_Cut_Lane_18 : 151|1@1+ (1,0) [0|1] "bool"  ACM
 SG_ OBJ_Has_Cut_Path_18 : 152|1@1+ (1,0) [0|1] "bool"  ACM
 SG_ OBJ_Brake_Light_18 : 153|1@1+ (1,0) [0|1] "bool"  ACM
 SG_ OBJ_Turn_Indicator_Right_18 : 154|1@1+ (1,0) [0|1] "bool"  ACM
 SG_ OBJ_Turn_Indicator_Left_18 : 155|1@1+ (1,0) [0|1] "bool"  ACM
 SG_ OBJ_Light_Indicator_Validity_18 : 156|1@1+ (1,0) [0|1] "bool"  ACM
 SG_ OBJ_Right_Out_Of_Image_18 : 157|1@1+ (1,0) [0|1] "bool"  ACM
 SG_ OBJ_Left_Out_Of_Image_18 : 158|1@1+ (1,0) [0|1] "bool"  ACM
 SG_ OBJ_Right_Out_Of_Image_V_18 : 159|1@1+ (1,0) [0|1] "bool"  ACM
 SG_ OBJ_Left_Out_Of_Image_V_18 : 160|1@1+ (1,0) [0|1] "bool"  ACM
 SG_ OBJ_Top_Out_Of_Image_18 : 161|1@1+ (1,0) [0|1] "bool"  ACM
 SG_ OBJ_Bottom_Out_Of_Image_18 : 162|1@1+ (1,0) [0|1] "bool"  ACM
 SG_ OBJ_Top_Out_Of_Image_V_18 : 163|1@1+ (1,0) [0|1] "bool"  ACM
 SG_ OBJ_Bottom_Out_Of_Image_V_18 : 164|1@1+ (1,0) [0|1] "bool"  ACM
 SG_ OBJ_Lane_Assignment_18 : 165|3@1+ (1,0) [0|5] "ENUM"  ACM
 SG_ OBJ_Lane_Assignment_V_18 : 168|1@1+ (1,0) [0|1] "bool"  ACM
 SG_ OBJ_Age_Seconds_18 : 169|7@1+ (1,0) [0|100] "s"  ACM
 SG_ OBJ_Age_Seconds_V_18 : 176|1@1+ (1,0) [0|1] "bool"  ACM
 SG_ OBJ_Width_18 : 177|9@1+ (0.01,0) [0.4|2.95] "m"  ACM
 SG_ OBJ_Width_V_18 : 186|1@1+ (1,0) [0|1] "bool"  ACM
 SG_ OBJ_Width_STD_18 : 187|8@1+ (0.01,0) [0|2] "m"  ACM
 SG_ OBJ_Width_STD_V_18 : 195|1@1+ (1,0) [0|1] "bool"  ACM
 SG_ OBJ_Length_18 : 196|9@1+ (0.05,0) [1.2|21] "m"  ACM
 SG_ OBJ_Length_V_18 : 205|1@1+ (1,0) [0|1] "bool"  ACM
 SG_ OBJ_Length_STD_18 : 208|8@1+ (0.05,0) [0|10] "m"  ACM
 SG_ OBJ_Length_STD_V_18 : 216|1@1+ (1,0) [0|1] "bool"  ACM
 SG_ OBJ_Height_18 : 217|9@1+ (0.01,0) [0|2.95] "m"  ACM
 SG_ OBJ_Height_V_18 : 226|1@1+ (1,0) [0|1] "bool"  ACM
 SG_ OBJ_Height_STD_18 : 227|8@1+ (0.01,0) [0|2] "m"  ACM
 SG_ OBJ_Height_STD_V_18 : 235|1@1+ (1,0) [0|1] "bool"  ACM
 SG_ OBJ_Abs_Long_Velocity_18 : 240|12@1+ (0.05,-30) [-30|100] "MPS"  ACM
 SG_ OBJ_Abs_Long_Velocity_V_18 : 252|1@1+ (1,0) [0|1] "bool"  ACM
 SG_ OBJ_Abs_Long_Velocity_STD_18 : 253|11@1+ (0.05,0) [0|65] "MPS"  ACM
 SG_ OBJ_Abs_Long_Vel_STD_V_18 : 264|1@1+ (1,0) [0|1] "bool"  ACM
 SG_ OBJ_Abs_Lat_Velocity_18 : 272|11@1+ (0.05,-50) [-50|50] "MPS"  ACM
 SG_ OBJ_Abs_Lat_Velocity_V_18 : 283|1@1+ (1,0) [0|1] "bool"  ACM
 SG_ OBJ_Abs_Lat_Velocity_STD_18 : 284|10@1+ (0.05,0) [0|50] "MPS"  ACM
 SG_ OBJ_Abs_Lat_Vel_STD_V_18 : 294|1@1+ (1,0) [0|1] "bool"  ACM
 SG_ OBJ_Abs_Long_Acc_18 : 295|9@1+ (0.05,-10.3) [-10.3|7.3] "MPS2"  ACM
 SG_ OBJ_Abs_Long_Acc_V_18 : 304|1@1+ (1,0) [0|1] "bool"  ACM
 SG_ OBJ_Abs_Long_Acc_STD_18 : 305|8@1+ (0.05,0) [0|7.3] "MPS2"  ACM
 SG_ OBJ_Abs_Long_Acc_STD_V_18 : 313|1@1+ (1,0) [0|1] "bool"  ACM
 SG_ OBJ_Abs_Lat_Acc_18 : 314|9@1+ (0.05,-10.3) [-10.3|7.3] "MPS2"  ACM
 SG_ OBJ_Abs_Lat_Acc_V_18 : 323|1@1+ (1,0) [0|1] "bool"  ACM
 SG_ OBJ_Abs_Lat_Acc_STD_18 : 324|8@1+ (0.05,0) [0|7.3] "MPS2"  ACM
 SG_ OBJ_Abs_Lat_Acc_STD_V_18 : 332|1@1+ (1,0) [0|1] "bool"  ACM
 SG_ OBJ_Abs_Acceleration_18 : 336|9@1+ (0.05,-10.3) [-10.3|7.3] "MPS2"  ACM
 SG_ OBJ_Abs_Acceleration_V_18 : 345|1@1+ (1,0) [0|1] "bool"  ACM
 SG_ OBJ_Abs_Acc_STD_18 : 346|8@1+ (0.05,0) [0|7.3] "MPS2"  ACM
 SG_ OBJ_Abs_Acc_STD_V_18 : 354|1@1+ (1,0) [0|1] "bool"  ACM
 SG_ OBJ_Inv_TTC_18 : 355|11@1+ (0.01,-8) [-8|8] "INV(s)"  ACM
 SG_ OBJ_Inv_TTC_V_18 : 366|1@1+ (1,0) [0|1] "bool"  ACM
 SG_ OBJ_Inv_TTC_STD_18 : 368|11@1+ (0.01,0) [0|4] "INV(s)"  ACM
 SG_ OBJ_Inv_TTC_STD_V_18 : 379|1@1+ (1,0) [0|1] "bool"  ACM
 SG_ OBJ_Relative_Long_Acc_18 : 380|9@1+ (0.05,-10.3) [-10.3|7.3] "MPS2"  ACM
 SG_ OBJ_Relative_Long_Acc_V_18 : 389|1@1+ (1,0) [0|1] "bool"  ACM
 SG_ OBJ_Relative_Long_Acc_STD_18 : 390|8@1+ (0.05,0) [0|7.3] "MPS2"  ACM
 SG_ OBJ_Rel_Long_Acc_STD_V_18 : 398|1@1+ (1,0) [0|1] "bool"  ACM

BO_ 180 ICM_Object_Prot17_B: 64 MyECU
 SG_ ICM_Object_Prot17_B_Header : 0|16@1+ (1,0) [0|65535] ""  ACM
 SG_ OBJ_Relative_Long_Velocity_17 : 16|13@1+ (0.05,-120) [-120|130] "MPS"  ACM
 SG_ OBJ_Relative_Long_Velocity_V_17 : 29|1@1+ (1,0) [0|1] "bool"  ACM
 SG_ OBJ_Relative_Long_Vel_STD_17 : 30|12@1+ (0.05,0) [0|130] "MPS"  ACM
 SG_ OBJ_Rel_Long_Vel_STD_V_17 : 42|1@1+ (1,0) [0|1] "bool"  ACM
 SG_ OBJ_Relative_Lat_Velocity_17 : 48|11@1+ (0.05,-50) [-50|50] "MPS"  ACM
 SG_ OBJ_Relative_Lat_Velocity_V_17 : 59|1@1+ (1,0) [0|1] "bool"  ACM
 SG_ OBJ_Relative_Lat_Velocity_STD_17 : 60|10@1+ (0.05,0) [0|50] "MPS"  ACM
 SG_ OBJ_Rel_Lat_Vel_STD_V_17 : 70|1@1+ (1,0) [0|1] "bool"  ACM
 SG_ OBJ_Long_Distance_17 : 80|14@1+ (0.05,-200) [-200|250] "m"  ACM
 SG_ OBJ_Long_Distance_V_17 : 94|1@1+ (1,0) [0|1] "bool"  ACM
 SG_ OBJ_Long_Distance_STD_17 : 95|13@1+ (0.05,0) [0|250] "m"  ACM
 SG_ OBJ_Long_Distance_STD_V_17 : 108|1@1+ (1,0) [0|1] "bool"  ACM
 SG_ OBJ_Lat_Distance_17 : 112|12@1+ (0.05,-100) [-100|100] "m"  ACM
 SG_ OBJ_Lat_Distance_V_17 : 124|1@1+ (1,0) [0|1] "bool"  ACM
 SG_ OBJ_Lat_Distance_STD_17 : 125|11@1+ (0.05,0) [0|100] "m"  ACM
 SG_ OBJ_Lat_Distance_STD_V_17 : 136|1@1+ (1,0) [0|1] "bool"  ACM
 SG_ OBJ_Absolute_Speed_17 : 144|12@1+ (0.05,-65) [-65|65] "MPS"  ACM
 SG_ OBJ_Absolute_Speed_V_17 : 156|1@1+ (1,0) [0|1] "bool"  ACM
 SG_ OBJ_Absolute_Speed_STD_17 : 157|11@1+ (0.05,-65) [0|65] "MPS"  ACM
 SG_ OBJ_Absolute_Speed_STD_V_17 : 168|1@1+ (1,0) [0|1] "bool"  ACM
 SG_ OBJ_Heading_17 : 176|10@1+ (0.01,-3.14) [-3.14|3.14] "rad"  ACM
 SG_ OBJ_Heading_V_17 : 186|1@1+ (1,0) [0|1] "bool"  ACM
 SG_ OBJ_Heading_STD_17 : 187|9@1+ (0.01,0) [0|3.14] "rad"  ACM
 SG_ OBJ_Heading_STD_V_17 : 196|1@1+ (1,0) [0|1] "bool"  ACM
 SG_ OBJ_Angle_Rate_STD_17 : 197|11@1+ (0.002,0) [0|2.2318] "RPS"  ACM
 SG_ OBJ_Angle_Rate_STD_V_17 : 208|1@1+ (1,0) [0|1] "bool"  ACM
 SG_ OBJ_Angle_Rate_17 : 209|12@1+ (0.002,-2.234) [-2.234|2.2318] "RPS"  ACM
 SG_ OBJ_Angle_Rate_V_17 : 221|1@1+ (1,0) [0|1] "bool"  ACM
 SG_ OBJ_Angle_Right_17 : 222|14@1+ (0.0002,-1.571) [-1.571|1.571] "rad "  ACM
 SG_ OBJ_Angle_Right_V_17 : 236|1@1+ (1,0) [0|1] "bool"  ACM
 SG_ OBJ_Angle_Right_STD_17 : 240|13@1+ (0.0002,0) [0|1.571] "rad "  ACM
 SG_ OBJ_Angle_Right_STD_V_17 : 253|1@1+ (1,0) [0|1] "bool"  ACM
 SG_ OBJ_Angle_Left_17 : 254|14@1+ (0.0002,-1.571) [-1.571|1.571] "rad "  ACM
 SG_ OBJ_Angle_Left_V_17 : 268|1@1+ (1,0) [0|1] "bool"  ACM
 SG_ OBJ_Angle_Left_STD_17 : 272|13@1+ (0.0002,0) [0|1.571] "rad"  ACM
 SG_ OBJ_Angle_Left_STD_V_17 : 285|1@1+ (1,0) [0|1] "bool"  ACM
 SG_ OBJ_Angle_Side_17 : 286|14@1+ (0.0002,-1.571) [-1.571|1.571] "rad"  ACM
 SG_ OBJ_Angle_Side_V_17 : 300|1@1+ (1,0) [0|1] "bool"  ACM
 SG_ OBJ_Angle_Side_STD_17 : 304|13@1+ (0.0002,0) [0|1.571] "rad"  ACM
 SG_ OBJ_Angle_Side_STD_V_17 : 317|1@1+ (1,0) [0|1] "bool"  ACM
 SG_ OBJ_Angle_Mid_V_17 : 318|1@1+ (1,0) [0|1] "bool"  ACM
 SG_ OBJ_Angle_Mid_17 : 319|14@1+ (0.0002,-1.571) [-1.571|1.571] "rad"  ACM
 SG_ OBJ_Angle_Mid_STD_17 : 336|13@1+ (0.0002,0) [0|1.571] "rad"  ACM
 SG_ OBJ_Angle_Mid_STD_V_17 : 349|1@1+ (1,0) [0|1] "bool"  ACM
 SG_ OBJ_Angle_Bottom_V_17 : 350|1@1+ (1,0) [0|1] "bool"  ACM
 SG_ OBJ_Angle_Bottom_17 : 351|14@1+ (0.0002,-1.571) [-1.571|1.571] "rad"  ACM
 SG_ OBJ_Angle_Bottom_STD_17 : 368|13@1+ (0.0002,0) [0|1.571] "rad"  ACM
 SG_ OBJ_Angle_Bottom_STD_V_17 : 381|1@1+ (1,0) [0|1] "bool"  ACM
 SG_ OBJ_Visibility_Side_V_17 : 382|1@1+ (1,0) [0|1] "bool"  ACM
 SG_ OBJ_Visibility_Side_17 : 383|2@1+ (1,0) [0|2] "ENUM"  ACM
 SG_ OBJ_Is_In_Drivable_Area_17 : 385|1@1+ (1,0) [0|1] "bool"  ACM
 SG_ OBJ_Is_In_Drivable_Area_V_17 : 386|1@1+ (1,0) [0|1] "bool"  ACM
 SG_ OBJ_Is_VeryClose_17 : 387|1@1+ (1,0) [0|1] "bool"  ACM
 SG_ OBJ_Is_VeryClose_V_17 : 388|1@1+ (1,0) [0|1] "bool"  ACM
 SG_ OBJ_Buffer_17 : 389|11@1+ (1,0) [0|0] "NA"  ACM

BO_ 179 ICM_Object_Prot17_A: 64 MyECU
 SG_ ICM_Object_Prot17_A_Header : 0|16@1+ (1,0) [0|65535] ""  ACM
 SG_ OBJ_CRC_17 : 16|32@1+ (1,0) [0|4294967295] "NA"  ACM
 SG_ OBJ_ID_17 : 48|8@1+ (1,0) [0|255] "NA"  ACM
 SG_ OBJ_Existence_Probability_17 : 56|8@1+ (0.01,0) [0|1] "NA"  ACM
 SG_ OBJ_Fusion_Source_17 : 64|16@1+ (1,0) [0|65535] "BITWIZE"  ACM
 SG_ OBJ_Triggered_SDM_17 : 80|2@1+ (1,0) [0|2] "ENUM"  ACM
 SG_ OBJ_Motion_Category_17 : 82|4@1+ (1,0) [0|13] "ENUM "  ACM
 SG_ OBJ_Moving_IN_Probability_17 : 86|7@1+ (0.01,0) [0|0] "NA"  ACM
 SG_ OBJ_Object_Age_17 : 93|11@1+ (1,0) [0|2047] "Frame"  ACM
 SG_ OBJ_Measuring_Status_17 : 104|3@1+ (1,0) [0|7] "BITWIZE"  ACM
 SG_ OBJ_Object_Class_17 : 107|4@1+ (1,0) [0|8] "ENUM"  ACM
 SG_ OBJ_Class_Probability_17 : 112|7@1+ (0.01,0) [0|1] "NA"  ACM
 SG_ OBJ_Car_Probability_17 : 119|7@1+ (0.01,0) [0|0] "NA"  ACM
 SG_ OBJ_Truck_Probability_17 : 126|7@1+ (0.01,0) [0|0] "NA"  ACM
 SG_ OBJ_Bike_Probability_17 : 133|7@1+ (0.01,0) [0|0] "NA"  ACM
 SG_ OBJ_Camera_Source_17 : 140|4@1+ (1,0) [0|15] "ENUM"  ACM
 SG_ OBJ_Motion_Status_17 : 144|3@1+ (1,0) [0|5] "ENUM "  ACM
 SG_ OBJ_Motion_Orientation_17 : 147|4@1+ (1,0) [0|13] "ENUM "  ACM
 SG_ OBJ_Has_Cut_Lane_17 : 151|1@1+ (1,0) [0|1] "bool"  ACM
 SG_ OBJ_Has_Cut_Path_17 : 152|1@1+ (1,0) [0|1] "bool"  ACM
 SG_ OBJ_Brake_Light_17 : 153|1@1+ (1,0) [0|1] "bool"  ACM
 SG_ OBJ_Turn_Indicator_Right_17 : 154|1@1+ (1,0) [0|1] "bool"  ACM
 SG_ OBJ_Turn_Indicator_Left_17 : 155|1@1+ (1,0) [0|1] "bool"  ACM
 SG_ OBJ_Light_Indicator_Validity_17 : 156|1@1+ (1,0) [0|1] "bool"  ACM
 SG_ OBJ_Right_Out_Of_Image_17 : 157|1@1+ (1,0) [0|1] "bool"  ACM
 SG_ OBJ_Left_Out_Of_Image_17 : 158|1@1+ (1,0) [0|1] "bool"  ACM
 SG_ OBJ_Right_Out_Of_Image_V_17 : 159|1@1+ (1,0) [0|1] "bool"  ACM
 SG_ OBJ_Left_Out_Of_Image_V_17 : 160|1@1+ (1,0) [0|1] "bool"  ACM
 SG_ OBJ_Top_Out_Of_Image_17 : 161|1@1+ (1,0) [0|1] "bool"  ACM
 SG_ OBJ_Bottom_Out_Of_Image_17 : 162|1@1+ (1,0) [0|1] "bool"  ACM
 SG_ OBJ_Top_Out_Of_Image_V_17 : 163|1@1+ (1,0) [0|1] "bool"  ACM
 SG_ OBJ_Bottom_Out_Of_Image_V_17 : 164|1@1+ (1,0) [0|1] "bool"  ACM
 SG_ OBJ_Lane_Assignment_17 : 165|3@1+ (1,0) [0|5] "ENUM"  ACM
 SG_ OBJ_Lane_Assignment_V_17 : 168|1@1+ (1,0) [0|1] "bool"  ACM
 SG_ OBJ_Age_Seconds_17 : 169|7@1+ (1,0) [0|100] "s"  ACM
 SG_ OBJ_Age_Seconds_V_17 : 176|1@1+ (1,0) [0|1] "bool"  ACM
 SG_ OBJ_Width_17 : 177|9@1+ (0.01,0) [0.4|2.95] "m"  ACM
 SG_ OBJ_Width_V_17 : 186|1@1+ (1,0) [0|1] "bool"  ACM
 SG_ OBJ_Width_STD_17 : 187|8@1+ (0.01,0) [0|2] "m"  ACM
 SG_ OBJ_Width_STD_V_17 : 195|1@1+ (1,0) [0|1] "bool"  ACM
 SG_ OBJ_Length_17 : 196|9@1+ (0.05,0) [1.2|21] "m"  ACM
 SG_ OBJ_Length_V_17 : 205|1@1+ (1,0) [0|1] "bool"  ACM
 SG_ OBJ_Length_STD_17 : 208|8@1+ (0.05,0) [0|10] "m"  ACM
 SG_ OBJ_Length_STD_V_17 : 216|1@1+ (1,0) [0|1] "bool"  ACM
 SG_ OBJ_Height_17 : 217|9@1+ (0.01,0) [0|2.95] "m"  ACM
 SG_ OBJ_Height_V_17 : 226|1@1+ (1,0) [0|1] "bool"  ACM
 SG_ OBJ_Height_STD_17 : 227|8@1+ (0.01,0) [0|2] "m"  ACM
 SG_ OBJ_Height_STD_V_17 : 235|1@1+ (1,0) [0|1] "bool"  ACM
 SG_ OBJ_Abs_Long_Velocity_17 : 240|12@1+ (0.05,-30) [-30|100] "MPS"  ACM
 SG_ OBJ_Abs_Long_Velocity_V_17 : 252|1@1+ (1,0) [0|1] "bool"  ACM
 SG_ OBJ_Abs_Long_Velocity_STD_17 : 253|11@1+ (0.05,0) [0|65] "MPS"  ACM
 SG_ OBJ_Abs_Long_Vel_STD_V_17 : 264|1@1+ (1,0) [0|1] "bool"  ACM
 SG_ OBJ_Abs_Lat_Velocity_17 : 272|11@1+ (0.05,-50) [-50|50] "MPS"  ACM
 SG_ OBJ_Abs_Lat_Velocity_V_17 : 283|1@1+ (1,0) [0|1] "bool"  ACM
 SG_ OBJ_Abs_Lat_Velocity_STD_17 : 284|10@1+ (0.05,0) [0|50] "MPS"  ACM
 SG_ OBJ_Abs_Lat_Vel_STD_V_17 : 294|1@1+ (1,0) [0|1] "bool"  ACM
 SG_ OBJ_Abs_Long_Acc_17 : 295|9@1+ (0.05,-10.3) [-10.3|7.3] "MPS2"  ACM
 SG_ OBJ_Abs_Long_Acc_V_17 : 304|1@1+ (1,0) [0|1] "bool"  ACM
 SG_ OBJ_Abs_Long_Acc_STD_17 : 305|8@1+ (0.05,0) [0|7.3] "MPS2"  ACM
 SG_ OBJ_Abs_Long_Acc_STD_V_17 : 313|1@1+ (1,0) [0|1] "bool"  ACM
 SG_ OBJ_Abs_Lat_Acc_17 : 314|9@1+ (0.05,-10.3) [-10.3|7.3] "MPS2"  ACM
 SG_ OBJ_Abs_Lat_Acc_V_17 : 323|1@1+ (1,0) [0|1] "bool"  ACM
 SG_ OBJ_Abs_Lat_Acc_STD_17 : 324|8@1+ (0.05,0) [0|7.3] "MPS2"  ACM
 SG_ OBJ_Abs_Lat_Acc_STD_V_17 : 332|1@1+ (1,0) [0|1] "bool"  ACM
 SG_ OBJ_Abs_Acceleration_17 : 336|9@1+ (0.05,-10.3) [-10.3|7.3] "MPS2"  ACM
 SG_ OBJ_Abs_Acceleration_V_17 : 345|1@1+ (1,0) [0|1] "bool"  ACM
 SG_ OBJ_Abs_Acc_STD_17 : 346|8@1+ (0.05,0) [0|7.3] "MPS2"  ACM
 SG_ OBJ_Abs_Acc_STD_V_17 : 354|1@1+ (1,0) [0|1] "bool"  ACM
 SG_ OBJ_Inv_TTC_17 : 355|11@1+ (0.01,-8) [-8|8] "INV(s)"  ACM
 SG_ OBJ_Inv_TTC_V_17 : 366|1@1+ (1,0) [0|1] "bool"  ACM
 SG_ OBJ_Inv_TTC_STD_17 : 368|11@1+ (0.01,0) [0|4] "INV(s)"  ACM
 SG_ OBJ_Inv_TTC_STD_V_17 : 379|1@1+ (1,0) [0|1] "bool"  ACM
 SG_ OBJ_Relative_Long_Acc_17 : 380|9@1+ (0.05,-10.3) [-10.3|7.3] "MPS2"  ACM
 SG_ OBJ_Relative_Long_Acc_V_17 : 389|1@1+ (1,0) [0|1] "bool"  ACM
 SG_ OBJ_Relative_Long_Acc_STD_17 : 390|8@1+ (0.05,0) [0|7.3] "MPS2"  ACM
 SG_ OBJ_Rel_Long_Acc_STD_V_17 : 398|1@1+ (1,0) [0|1] "bool"  ACM

BO_ 178 ICM_Object_Prot16_B: 64 MyECU
 SG_ ICM_Object_Prot16_B_Header : 0|16@1+ (1,0) [0|65535] ""  ACM
 SG_ OBJ_Relative_Long_Velocity_16 : 16|13@1+ (0.05,-120) [-120|130] "MPS"  ACM
 SG_ OBJ_Relative_Long_Velocity_V_16 : 29|1@1+ (1,0) [0|1] "bool"  ACM
 SG_ OBJ_Relative_Long_Vel_STD_16 : 30|12@1+ (0.05,0) [0|130] "MPS"  ACM
 SG_ OBJ_Rel_Long_Vel_STD_V_16 : 42|1@1+ (1,0) [0|1] "bool"  ACM
 SG_ OBJ_Relative_Lat_Velocity_16 : 48|11@1+ (0.05,-50) [-50|50] "MPS"  ACM
 SG_ OBJ_Relative_Lat_Velocity_V_16 : 59|1@1+ (1,0) [0|1] "bool"  ACM
 SG_ OBJ_Relative_Lat_Velocity_STD_16 : 60|10@1+ (0.05,0) [0|50] "MPS"  ACM
 SG_ OBJ_Rel_Lat_Vel_STD_V_16 : 70|1@1+ (1,0) [0|1] "bool"  ACM
 SG_ OBJ_Long_Distance_16 : 80|14@1+ (0.05,-200) [-200|250] "m"  ACM
 SG_ OBJ_Long_Distance_V_16 : 94|1@1+ (1,0) [0|1] "bool"  ACM
 SG_ OBJ_Long_Distance_STD_16 : 95|13@1+ (0.05,0) [0|250] "m"  ACM
 SG_ OBJ_Long_Distance_STD_V_16 : 108|1@1+ (1,0) [0|1] "bool"  ACM
 SG_ OBJ_Lat_Distance_16 : 112|12@1+ (0.05,-100) [-100|100] "m"  ACM
 SG_ OBJ_Lat_Distance_V_16 : 124|1@1+ (1,0) [0|1] "bool"  ACM
 SG_ OBJ_Lat_Distance_STD_16 : 125|11@1+ (0.05,0) [0|100] "m"  ACM
 SG_ OBJ_Lat_Distance_STD_V_16 : 136|1@1+ (1,0) [0|1] "bool"  ACM
 SG_ OBJ_Absolute_Speed_16 : 144|12@1+ (0.05,-65) [-65|65] "MPS"  ACM
 SG_ OBJ_Absolute_Speed_V_16 : 156|1@1+ (1,0) [0|1] "bool"  ACM
 SG_ OBJ_Absolute_Speed_STD_16 : 157|11@1+ (0.05,-65) [0|65] "MPS"  ACM
 SG_ OBJ_Absolute_Speed_STD_V_16 : 168|1@1+ (1,0) [0|1] "bool"  ACM
 SG_ OBJ_Heading_16 : 176|10@1+ (0.01,-3.14) [-3.14|3.14] "rad"  ACM
 SG_ OBJ_Heading_V_16 : 186|1@1+ (1,0) [0|1] "bool"  ACM
 SG_ OBJ_Heading_STD_16 : 187|9@1+ (0.01,0) [0|3.14] "rad"  ACM
 SG_ OBJ_Heading_STD_V_16 : 196|1@1+ (1,0) [0|1] "bool"  ACM
 SG_ OBJ_Angle_Rate_STD_16 : 197|11@1+ (0.002,0) [0|2.2318] "RPS"  ACM
 SG_ OBJ_Angle_Rate_STD_V_16 : 208|1@1+ (1,0) [0|1] "bool"  ACM
 SG_ OBJ_Angle_Rate_16 : 209|12@1+ (0.002,-2.234) [-2.234|2.2318] "RPS"  ACM
 SG_ OBJ_Angle_Rate_V_16 : 221|1@1+ (1,0) [0|1] "bool"  ACM
 SG_ OBJ_Angle_Right_16 : 222|14@1+ (0.0002,-1.571) [-1.571|1.571] "rad "  ACM
 SG_ OBJ_Angle_Right_V_16 : 236|1@1+ (1,0) [0|1] "bool"  ACM
 SG_ OBJ_Angle_Right_STD_16 : 240|13@1+ (0.0002,0) [0|1.571] "rad "  ACM
 SG_ OBJ_Angle_Right_STD_V_16 : 253|1@1+ (1,0) [0|1] "bool"  ACM
 SG_ OBJ_Angle_Left_16 : 254|14@1+ (0.0002,-1.571) [-1.571|1.571] "rad "  ACM
 SG_ OBJ_Angle_Left_V_16 : 268|1@1+ (1,0) [0|1] "bool"  ACM
 SG_ OBJ_Angle_Left_STD_16 : 272|13@1+ (0.0002,0) [0|1.571] "rad"  ACM
 SG_ OBJ_Angle_Left_STD_V_16 : 285|1@1+ (1,0) [0|1] "bool"  ACM
 SG_ OBJ_Angle_Side_16 : 286|14@1+ (0.0002,-1.571) [-1.571|1.571] "rad"  ACM
 SG_ OBJ_Angle_Side_V_16 : 300|1@1+ (1,0) [0|1] "bool"  ACM
 SG_ OBJ_Angle_Side_STD_16 : 304|13@1+ (0.0002,0) [0|1.571] "rad"  ACM
 SG_ OBJ_Angle_Side_STD_V_16 : 317|1@1+ (1,0) [0|1] "bool"  ACM
 SG_ OBJ_Angle_Mid_V_16 : 318|1@1+ (1,0) [0|1] "bool"  ACM
 SG_ OBJ_Angle_Mid_16 : 319|14@1+ (0.0002,-1.571) [-1.571|1.571] "rad"  ACM
 SG_ OBJ_Angle_Mid_STD_16 : 336|13@1+ (0.0002,0) [0|1.571] "rad"  ACM
 SG_ OBJ_Angle_Mid_STD_V_16 : 349|1@1+ (1,0) [0|1] "bool"  ACM
 SG_ OBJ_Angle_Bottom_V_16 : 350|1@1+ (1,0) [0|1] "bool"  ACM
 SG_ OBJ_Angle_Bottom_16 : 351|14@1+ (0.0002,-1.571) [-1.571|1.571] "rad"  ACM
 SG_ OBJ_Angle_Bottom_STD_16 : 368|13@1+ (0.0002,0) [0|1.571] "rad"  ACM
 SG_ OBJ_Angle_Bottom_STD_V_16 : 381|1@1+ (1,0) [0|1] "bool"  ACM
 SG_ OBJ_Visibility_Side_V_16 : 382|1@1+ (1,0) [0|1] "bool"  ACM
 SG_ OBJ_Visibility_Side_16 : 383|2@1+ (1,0) [0|2] "ENUM"  ACM
 SG_ OBJ_Is_In_Drivable_Area_16 : 385|1@1+ (1,0) [0|1] "bool"  ACM
 SG_ OBJ_Is_In_Drivable_Area_V_16 : 386|1@1+ (1,0) [0|1] "bool"  ACM
 SG_ OBJ_Is_VeryClose_16 : 387|1@1+ (1,0) [0|1] "bool"  ACM
 SG_ OBJ_Is_VeryClose_V_16 : 388|1@1+ (1,0) [0|1] "bool"  ACM
 SG_ OBJ_Buffer_16 : 389|11@1+ (1,0) [0|0] "NA"  ACM

BO_ 177 ICM_Object_Prot16_A: 64 MyECU
 SG_ ICM_Object_Prot16_A_Header : 0|16@1+ (1,0) [0|65535] ""  ACM
 SG_ OBJ_CRC_16 : 16|32@1+ (1,0) [0|4294967295] "NA"  ACM
 SG_ OBJ_ID_16 : 48|8@1+ (1,0) [0|255] "NA"  ACM
 SG_ OBJ_Existence_Probability_16 : 56|8@1+ (0.01,0) [0|1] "NA"  ACM
 SG_ OBJ_Fusion_Source_16 : 64|16@1+ (1,0) [0|65535] "BITWIZE"  ACM
 SG_ OBJ_Triggered_SDM_16 : 80|2@1+ (1,0) [0|2] "ENUM"  ACM
 SG_ OBJ_Motion_Category_16 : 82|4@1+ (1,0) [0|13] "ENUM "  ACM
 SG_ OBJ_Moving_IN_Probability_16 : 86|7@1+ (0.01,0) [0|0] "NA"  ACM
 SG_ OBJ_Object_Age_16 : 93|11@1+ (1,0) [0|2047] "Frame"  ACM
 SG_ OBJ_Measuring_Status_16 : 104|3@1+ (1,0) [0|7] "BITWIZE"  ACM
 SG_ OBJ_Object_Class_16 : 107|4@1+ (1,0) [0|8] "ENUM"  ACM
 SG_ OBJ_Class_Probability_16 : 112|7@1+ (0.01,0) [0|1] "NA"  ACM
 SG_ OBJ_Car_Probability_16 : 119|7@1+ (0.01,0) [0|0] "NA"  ACM
 SG_ OBJ_Truck_Probability_16 : 126|7@1+ (0.01,0) [0|0] "NA"  ACM
 SG_ OBJ_Bike_Probability_16 : 133|7@1+ (0.01,0) [0|0] "NA"  ACM
 SG_ OBJ_Camera_Source_16 : 140|4@1+ (1,0) [0|15] "ENUM"  ACM
 SG_ OBJ_Motion_Status_16 : 144|3@1+ (1,0) [0|5] "ENUM "  ACM
 SG_ OBJ_Motion_Orientation_16 : 147|4@1+ (1,0) [0|13] "ENUM "  ACM
 SG_ OBJ_Has_Cut_Lane_16 : 151|1@1+ (1,0) [0|1] "bool"  ACM
 SG_ OBJ_Has_Cut_Path_16 : 152|1@1+ (1,0) [0|1] "bool"  ACM
 SG_ OBJ_Brake_Light_16 : 153|1@1+ (1,0) [0|1] "bool"  ACM
 SG_ OBJ_Turn_Indicator_Right_16 : 154|1@1+ (1,0) [0|1] "bool"  ACM
 SG_ OBJ_Turn_Indicator_Left_16 : 155|1@1+ (1,0) [0|1] "bool"  ACM
 SG_ OBJ_Light_Indicator_Validity_16 : 156|1@1+ (1,0) [0|1] "bool"  ACM
 SG_ OBJ_Right_Out_Of_Image_16 : 157|1@1+ (1,0) [0|1] "bool"  ACM
 SG_ OBJ_Left_Out_Of_Image_16 : 158|1@1+ (1,0) [0|1] "bool"  ACM
 SG_ OBJ_Right_Out_Of_Image_V_16 : 159|1@1+ (1,0) [0|1] "bool"  ACM
 SG_ OBJ_Left_Out_Of_Image_V_16 : 160|1@1+ (1,0) [0|1] "bool"  ACM
 SG_ OBJ_Top_Out_Of_Image_16 : 161|1@1+ (1,0) [0|1] "bool"  ACM
 SG_ OBJ_Bottom_Out_Of_Image_16 : 162|1@1+ (1,0) [0|1] "bool"  ACM
 SG_ OBJ_Top_Out_Of_Image_V_16 : 163|1@1+ (1,0) [0|1] "bool"  ACM
 SG_ OBJ_Bottom_Out_Of_Image_V_16 : 164|1@1+ (1,0) [0|1] "bool"  ACM
 SG_ OBJ_Lane_Assignment_16 : 165|3@1+ (1,0) [0|5] "ENUM"  ACM
 SG_ OBJ_Lane_Assignment_V_16 : 168|1@1+ (1,0) [0|1] "bool"  ACM
 SG_ OBJ_Age_Seconds_16 : 169|7@1+ (1,0) [0|100] "s"  ACM
 SG_ OBJ_Age_Seconds_V_16 : 176|1@1+ (1,0) [0|1] "bool"  ACM
 SG_ OBJ_Width_16 : 177|9@1+ (0.01,0) [0.4|2.95] "m"  ACM
 SG_ OBJ_Width_V_16 : 186|1@1+ (1,0) [0|1] "bool"  ACM
 SG_ OBJ_Width_STD_16 : 187|8@1+ (0.01,0) [0|2] "m"  ACM
 SG_ OBJ_Width_STD_V_16 : 195|1@1+ (1,0) [0|1] "bool"  ACM
 SG_ OBJ_Length_16 : 196|9@1+ (0.05,0) [1.2|21] "m"  ACM
 SG_ OBJ_Length_V_16 : 205|1@1+ (1,0) [0|1] "bool"  ACM
 SG_ OBJ_Length_STD_16 : 208|8@1+ (0.05,0) [0|10] "m"  ACM
 SG_ OBJ_Length_STD_V_16 : 216|1@1+ (1,0) [0|1] "bool"  ACM
 SG_ OBJ_Height_16 : 217|9@1+ (0.01,0) [0|2.95] "m"  ACM
 SG_ OBJ_Height_V_16 : 226|1@1+ (1,0) [0|1] "bool"  ACM
 SG_ OBJ_Height_STD_16 : 227|8@1+ (0.01,0) [0|2] "m"  ACM
 SG_ OBJ_Height_STD_V_16 : 235|1@1+ (1,0) [0|1] "bool"  ACM
 SG_ OBJ_Abs_Long_Velocity_16 : 240|12@1+ (0.05,-30) [-30|100] "MPS"  ACM
 SG_ OBJ_Abs_Long_Velocity_V_16 : 252|1@1+ (1,0) [0|1] "bool"  ACM
 SG_ OBJ_Abs_Long_Velocity_STD_16 : 253|11@1+ (0.05,0) [0|65] "MPS"  ACM
 SG_ OBJ_Abs_Long_Vel_STD_V_16 : 264|1@1+ (1,0) [0|1] "bool"  ACM
 SG_ OBJ_Abs_Lat_Velocity_16 : 272|11@1+ (0.05,-50) [-50|50] "MPS"  ACM
 SG_ OBJ_Abs_Lat_Velocity_V_16 : 283|1@1+ (1,0) [0|1] "bool"  ACM
 SG_ OBJ_Abs_Lat_Velocity_STD_16 : 284|10@1+ (0.05,0) [0|50] "MPS"  ACM
 SG_ OBJ_Abs_Lat_Vel_STD_V_16 : 294|1@1+ (1,0) [0|1] "bool"  ACM
 SG_ OBJ_Abs_Long_Acc_16 : 295|9@1+ (0.05,-10.3) [-10.3|7.3] "MPS2"  ACM
 SG_ OBJ_Abs_Long_Acc_V_16 : 304|1@1+ (1,0) [0|1] "bool"  ACM
 SG_ OBJ_Abs_Long_Acc_STD_16 : 305|8@1+ (0.05,0) [0|7.3] "MPS2"  ACM
 SG_ OBJ_Abs_Long_Acc_STD_V_16 : 313|1@1+ (1,0) [0|1] "bool"  ACM
 SG_ OBJ_Abs_Lat_Acc_16 : 314|9@1+ (0.05,-10.3) [-10.3|7.3] "MPS2"  ACM
 SG_ OBJ_Abs_Lat_Acc_V_16 : 323|1@1+ (1,0) [0|1] "bool"  ACM
 SG_ OBJ_Abs_Lat_Acc_STD_16 : 324|8@1+ (0.05,0) [0|7.3] "MPS2"  ACM
 SG_ OBJ_Abs_Lat_Acc_STD_V_16 : 332|1@1+ (1,0) [0|1] "bool"  ACM
 SG_ OBJ_Abs_Acceleration_16 : 336|9@1+ (0.05,-10.3) [-10.3|7.3] "MPS2"  ACM
 SG_ OBJ_Abs_Acceleration_V_16 : 345|1@1+ (1,0) [0|1] "bool"  ACM
 SG_ OBJ_Abs_Acc_STD_16 : 346|8@1+ (0.05,0) [0|7.3] "MPS2"  ACM
 SG_ OBJ_Abs_Acc_STD_V_16 : 354|1@1+ (1,0) [0|1] "bool"  ACM
 SG_ OBJ_Inv_TTC_16 : 355|11@1+ (0.01,-8) [-8|8] "INV(s)"  ACM
 SG_ OBJ_Inv_TTC_V_16 : 366|1@1+ (1,0) [0|1] "bool"  ACM
 SG_ OBJ_Inv_TTC_STD_16 : 368|11@1+ (0.01,0) [0|4] "INV(s)"  ACM
 SG_ OBJ_Inv_TTC_STD_V_16 : 379|1@1+ (1,0) [0|1] "bool"  ACM
 SG_ OBJ_Relative_Long_Acc_16 : 380|9@1+ (0.05,-10.3) [-10.3|7.3] "MPS2"  ACM
 SG_ OBJ_Relative_Long_Acc_V_16 : 389|1@1+ (1,0) [0|1] "bool"  ACM
 SG_ OBJ_Relative_Long_Acc_STD_16 : 390|8@1+ (0.05,0) [0|7.3] "MPS2"  ACM
 SG_ OBJ_Rel_Long_Acc_STD_V_16 : 398|1@1+ (1,0) [0|1] "bool"  ACM

BA_DEF_ BO_  "VFrameFormat" ENUM  "StandardCAN","ExtendedCAN","reserved","reserved","reserved","reserved","reserved","reserved","reserved","reserved","reserved","reserved","reserved","reserved","StandardCAN_FD","ExtendedCAN_FD";
BA_DEF_ BO_  "GenMsgSendType" ENUM  "Cyclic","NotUsed","NotUsed","NotUsed","NotUsed","NotUsed","NotUsed","NotUsed","NoMsgSendType";
BA_DEF_ SG_  "GenSigSendType" ENUM  "NotUsed","OnWrite","OnWriteWithRepetition","OnChange","OnChangeWithRepetition","IfActive","IfActiveWithRepeition","NoSigSendType";
BA_DEF_ BO_  "GenMsgCycleTime" INT 0 0;
BA_DEF_ BO_  "GenMsgILSupport" ENUM  "no","yes";
BA_DEF_ SG_  "GenSigStartValue" INT 0 0;
BA_DEF_DEF_  "VFrameFormat" "ExtendedCAN_FD";
BA_DEF_DEF_  "GenMsgSendType" "NoMsgSendType";
BA_DEF_DEF_  "GenSigSendType" "OnWrite";
BA_DEF_DEF_  "GenMsgCycleTime" 0;
BA_DEF_DEF_  "GenMsgILSupport" "yes";
BA_DEF_DEF_  "GenSigStartValue" 0;
BA_ "VFrameFormat" BO_ 196 14;
BA_ "VFrameFormat" BO_ 195 14;
BA_ "VFrameFormat" BO_ 194 14;
BA_ "VFrameFormat" BO_ 193 14;
BA_ "VFrameFormat" BO_ 192 14;
BA_ "VFrameFormat" BO_ 191 14;
BA_ "VFrameFormat" BO_ 190 14;
BA_ "VFrameFormat" BO_ 189 14;
BA_ "VFrameFormat" BO_ 188 14;
BA_ "VFrameFormat" BO_ 187 14;
BA_ "VFrameFormat" BO_ 186 14;
BA_ "VFrameFormat" BO_ 185 14;
BA_ "VFrameFormat" BO_ 184 14;
BA_ "VFrameFormat" BO_ 183 14;
BA_ "VFrameFormat" BO_ 182 14;
BA_ "VFrameFormat" BO_ 181 14;
BA_ "VFrameFormat" BO_ 180 14;
BA_ "VFrameFormat" BO_ 179 14;
BA_ "VFrameFormat" BO_ 178 14;
BA_ "VFrameFormat" BO_ 177 14;
BA_ "GenSigStartValue" SG_ 196 OBJ_Absolute_Speed_STD_25 1300;
BA_ "GenSigStartValue" SG_ 195 OBJ_Width_25 40;
BA_ "GenSigStartValue" SG_ 195 OBJ_Length_25 24;
BA_ "GenSigStartValue" SG_ 194 OBJ_Absolute_Speed_STD_24 1300;
BA_ "GenSigStartValue" SG_ 193 OBJ_Width_24 40;
BA_ "GenSigStartValue" SG_ 193 OBJ_Length_24 24;
BA_ "GenSigStartValue" SG_ 192 OBJ_Absolute_Speed_STD_23 1300;
BA_ "GenSigStartValue" SG_ 191 OBJ_Width_23 40;
BA_ "GenSigStartValue" SG_ 191 OBJ_Length_23 24;
BA_ "GenSigStartValue" SG_ 190 OBJ_Absolute_Speed_STD_22 1300;
BA_ "GenSigStartValue" SG_ 189 OBJ_Width_22 40;
BA_ "GenSigStartValue" SG_ 189 OBJ_Length_22 24;
BA_ "GenSigStartValue" SG_ 188 OBJ_Absolute_Speed_STD_21 1300;
BA_ "GenSigStartValue" SG_ 187 OBJ_Width_21 40;
BA_ "GenSigStartValue" SG_ 187 OBJ_Length_21 24;
BA_ "GenSigStartValue" SG_ 186 OBJ_Absolute_Speed_STD_20 1300;
BA_ "GenSigStartValue" SG_ 185 OBJ_Width_20 40;
BA_ "GenSigStartValue" SG_ 185 OBJ_Length_20 24;
BA_ "GenSigStartValue" SG_ 184 OBJ_Absolute_Speed_STD_19 1300;
BA_ "GenSigStartValue" SG_ 183 OBJ_Width_19 40;
BA_ "GenSigStartValue" SG_ 183 OBJ_Length_19 24;
BA_ "GenSigStartValue" SG_ 182 OBJ_Absolute_Speed_STD_18 1300;
BA_ "GenSigStartValue" SG_ 181 OBJ_Width_18 40;
BA_ "GenSigStartValue" SG_ 181 OBJ_Length_18 24;
BA_ "GenSigStartValue" SG_ 180 OBJ_Absolute_Speed_STD_17 1300;
BA_ "GenSigStartValue" SG_ 179 OBJ_Width_17 40;
BA_ "GenSigStartValue" SG_ 179 OBJ_Length_17 24;
BA_ "GenSigStartValue" SG_ 178 OBJ_Absolute_Speed_STD_16 1300;
BA_ "GenSigStartValue" SG_ 177 OBJ_Width_16 40;
BA_ "GenSigStartValue" SG_ 177 OBJ_Length_16 24;
VAL_ 196 OBJ_Relative_Long_Velocity_V_25 1 "VALID" 0 "INVALID" ;
VAL_ 196 OBJ_Rel_Long_Vel_STD_V_25 1 "VALID" 0 "INVALID" ;
VAL_ 196 OBJ_Relative_Lat_Velocity_V_25 1 "VALID" 0 "INVALID" ;
VAL_ 196 OBJ_Rel_Lat_Vel_STD_V_25 1 "VALID" 0 "INVALID" ;
VAL_ 196 OBJ_Long_Distance_V_25 1 "VALID" 0 "INVALID" ;
VAL_ 196 OBJ_Long_Distance_STD_V_25 1 "VALID" 0 "INVALID" ;
VAL_ 196 OBJ_Lat_Distance_V_25 1 "VALID" 0 "INVALID" ;
VAL_ 196 OBJ_Lat_Distance_STD_V_25 1 "VALID" 0 "INVALID" ;
VAL_ 196 OBJ_Absolute_Speed_V_25 1 "VALID" 0 "INVALID" ;
VAL_ 196 OBJ_Absolute_Speed_STD_V_25 1 "VALID" 0 "INVALID" ;
VAL_ 196 OBJ_Heading_V_25 1 "VALID" 0 "INVALID" ;
VAL_ 196 OBJ_Heading_STD_V_25 1 "VALID" 0 "INVALID" ;
VAL_ 196 OBJ_Angle_Rate_STD_V_25 1 "VALID" 0 "INVALID" ;
VAL_ 196 OBJ_Angle_Rate_V_25 1 "VALID" 0 "INVALID" ;
VAL_ 196 OBJ_Angle_Right_V_25 1 "VALID" 0 "INVALID" ;
VAL_ 196 OBJ_Angle_Right_STD_V_25 1 "VALID" 0 "INVALID" ;
VAL_ 196 OBJ_Angle_Left_V_25 1 "VALID" 0 "INVALID" ;
VAL_ 196 OBJ_Angle_Left_STD_V_25 1 "VALID" 0 "INVALID" ;
VAL_ 196 OBJ_Angle_Side_V_25 1 "VALID" 0 "INVALID" ;
VAL_ 196 OBJ_Angle_Side_STD_V_25 1 "VALID" 0 "INVALID" ;
VAL_ 196 OBJ_Angle_Mid_V_25 1 "VALID" 0 "INVALID" ;
VAL_ 196 OBJ_Angle_Mid_STD_V_25 1 "VALID" 0 "INVALID" ;
VAL_ 196 OBJ_Angle_Bottom_V_25 1 "VALID" 0 "INVALID" ;
VAL_ 196 OBJ_Angle_Bottom_STD_V_25 1 "VALID" 0 "INVALID" ;
VAL_ 196 OBJ_Visibility_Side_V_25 1 "VALID" 0 "INVALID" ;
VAL_ 196 OBJ_Visibility_Side_25 2 "REAR" 1 "FRONT" 0 "NOT_VISIBLE" ;
VAL_ 196 OBJ_Is_In_Drivable_Area_25 1 "TRUE" 0 "FALSE" ;
VAL_ 196 OBJ_Is_In_Drivable_Area_V_25 1 "VALID" 0 "INVALID" ;
VAL_ 196 OBJ_Is_VeryClose_25 1 "TRUE" 0 "FALSE" ;
VAL_ 196 OBJ_Is_VeryClose_V_25 1 "VALID" 0 "INVALID" ;
VAL_ 195 OBJ_Triggered_SDM_25 2 "NOT_TRIGGERED" 1 "TRIGGERED" 0 "NOT_AVAILABLE" ;
VAL_ 195 OBJ_Motion_Category_25 13 "ONCOMING" 12 "PRECEEDING" 11 "MOVING" 10 "RTAP" 9 "LTAP" 8 "CROSSING" 7 "MOVING_OUT" 6 "MOVING_IN" 5 "CLOSE_CUT_IN" 4 "PASSING_OUT" 3 "PASSING_IN" 2 "PASSING" 1 "UNDEFINED" 0 "INVALID" ;
VAL_ 195 OBJ_Measuring_Status_25 2 "(BIT_2)NOT_VALID_OR_VALID" 1 "(BIT_1)PREDICTED_OR_MEASURED" 0 "(BIT_0)OLD_OR_NEW" ;
VAL_ 195 OBJ_Object_Class_25 8 "UNCERTAIN_VCL" 7 "ANIMAL" 6 "GENERAL_OBJECT" 5 "PEDESTRIAN" 4 "BICYCLE" 3 "MOTOR_BIKE" 2 "TRUCK" 1 "CAR" 0 "INVALID" ;
VAL_ 195 OBJ_Camera_Source_25 11 "PARKING_RIGHT" 10 "PARKING_LEFT" 9 "PARKING_REAR" 8 "PARKING_FRONT" 7 "FRONT_CORNER_RIGHT" 6 "FRONT_CORNER_LEFT" 5 "REAR_CORNER_RIGHT" 4 "REAR_CORNER_LEFT" 3 "REAR" 2 "FRONT_FISHEYE" 1 "FRONT_NARROW" 0 "FRONT_MAIN" ;
VAL_ 195 OBJ_Motion_Status_25 5 "MOVING_SLOWLY" 4 "STOPPED" 3 "STATIONARY" 2 "MOVING" 1 "UNKNOWN" 0 "INVALID" ;
VAL_ 195 OBJ_Motion_Orientation_25 13 "UNKNOWN" 12 "PRECEEDING" 11 "DRIFTING_LEFT" 9 "CROSSING_LEFT" 7 "OC_DRIFTING_LEFT" 6 "ONCOMING" 5 "OC_DRIFTING_RIGHT" 3 "CROSSING_RIGHT" 1 "DRIFTING_RIGHT" 0 "INVALID" ;
VAL_ 195 OBJ_Has_Cut_Lane_25 1 "TRUE" 0 "FALSE" ;
VAL_ 195 OBJ_Has_Cut_Path_25 1 "TRUE" 0 "FALSE" ;
VAL_ 195 OBJ_Brake_Light_25 1 "TRUE" 0 "FALSE" ;
VAL_ 195 OBJ_Turn_Indicator_Right_25 1 "TRUE" 0 "FALSE" ;
VAL_ 195 OBJ_Turn_Indicator_Left_25 1 "TRUE" 0 "FALSE" ;
VAL_ 195 OBJ_Light_Indicator_Validity_25 1 "TRUE" 0 "FALSE" ;
VAL_ 195 OBJ_Right_Out_Of_Image_25 1 "TRUE" 0 "FALSE" ;
VAL_ 195 OBJ_Left_Out_Of_Image_25 1 "TRUE" 0 "FALSE" ;
VAL_ 195 OBJ_Right_Out_Of_Image_V_25 1 "TRUE" 0 "FALSE" ;
VAL_ 195 OBJ_Left_Out_Of_Image_V_25 1 "TRUE" 0 "FALSE" ;
VAL_ 195 OBJ_Top_Out_Of_Image_25 1 "TRUE" 0 "FALSE" ;
VAL_ 195 OBJ_Bottom_Out_Of_Image_25 1 "TRUE" 0 "FALSE" ;
VAL_ 195 OBJ_Top_Out_Of_Image_V_25 1 "VALID" 0 "INVALID" ;
VAL_ 195 OBJ_Bottom_Out_Of_Image_V_25 1 "VALID" 0 "INVALID" ;
VAL_ 195 OBJ_Lane_Assignment_25 5 "RIGHT_RIGHT" 4 "RIGHT" 3 "HOST" 2 "LEFT" 1 "LEFT_LEFT" 0 "UNKNOWN" ;
VAL_ 195 OBJ_Lane_Assignment_V_25 1 "VALID" 0 "INVALID" ;
VAL_ 195 OBJ_Age_Seconds_V_25 1 "VALID" 0 "INVALID" ;
VAL_ 195 OBJ_Width_V_25 1 "VALID" 0 "INVALID" ;
VAL_ 195 OBJ_Width_STD_V_25 1 "VALID" 0 "INVALID" ;
VAL_ 195 OBJ_Length_V_25 1 "VALID" 0 "INVALID" ;
VAL_ 195 OBJ_Length_STD_V_25 1 "VALID" 0 "INVALID" ;
VAL_ 195 OBJ_Height_V_25 1 "VALID" 0 "INVALID" ;
VAL_ 195 OBJ_Height_STD_V_25 1 "VALID" 0 "INVALID" ;
VAL_ 195 OBJ_Abs_Long_Velocity_V_25 1 "VALID" 0 "INVALID" ;
VAL_ 195 OBJ_Abs_Long_Vel_STD_V_25 1 "VALID" 0 "INVALID" ;
VAL_ 195 OBJ_Abs_Lat_Velocity_V_25 1 "VALID" 0 "INVALID" ;
VAL_ 195 OBJ_Abs_Lat_Vel_STD_V_25 1 "VALID" 0 "INVALID" ;
VAL_ 195 OBJ_Abs_Long_Acc_V_25 1 "VALID" 0 "INVALID" ;
VAL_ 195 OBJ_Abs_Long_Acc_STD_V_25 1 "VALID" 0 "INVALID" ;
VAL_ 195 OBJ_Abs_Lat_Acc_V_25 1 "VALID" 0 "INVALID" ;
VAL_ 195 OBJ_Abs_Lat_Acc_STD_V_25 1 "VALID" 0 "INVALID" ;
VAL_ 195 OBJ_Abs_Acceleration_V_25 1 "VALID" 0 "INVALID" ;
VAL_ 195 OBJ_Abs_Acc_STD_V_25 1 "VALID" 0 "INVALID" ;
VAL_ 195 OBJ_Inv_TTC_V_25 1 "VALID" 0 "INVALID" ;
VAL_ 195 OBJ_Inv_TTC_STD_V_25 1 "VALID" 0 "INVALID" ;
VAL_ 195 OBJ_Relative_Long_Acc_V_25 1 "VALID" 0 "INVALID" ;
VAL_ 195 OBJ_Rel_Long_Acc_STD_V_25 1 "VALID" 0 "INVALID" ;
VAL_ 194 OBJ_Relative_Long_Velocity_V_24 1 "VALID" 0 "INVALID" ;
VAL_ 194 OBJ_Rel_Long_Vel_STD_V_24 1 "VALID" 0 "INVALID" ;
VAL_ 194 OBJ_Relative_Lat_Velocity_V_24 1 "VALID" 0 "INVALID" ;
VAL_ 194 OBJ_Rel_Lat_Vel_STD_V_24 1 "VALID" 0 "INVALID" ;
VAL_ 194 OBJ_Long_Distance_V_24 1 "VALID" 0 "INVALID" ;
VAL_ 194 OBJ_Long_Distance_STD_V_24 1 "VALID" 0 "INVALID" ;
VAL_ 194 OBJ_Lat_Distance_V_24 1 "VALID" 0 "INVALID" ;
VAL_ 194 OBJ_Lat_Distance_STD_V_24 1 "VALID" 0 "INVALID" ;
VAL_ 194 OBJ_Absolute_Speed_V_24 1 "VALID" 0 "INVALID" ;
VAL_ 194 OBJ_Absolute_Speed_STD_V_24 1 "VALID" 0 "INVALID" ;
VAL_ 194 OBJ_Heading_V_24 1 "VALID" 0 "INVALID" ;
VAL_ 194 OBJ_Heading_STD_V_24 1 "VALID" 0 "INVALID" ;
VAL_ 194 OBJ_Angle_Rate_STD_V_24 1 "VALID" 0 "INVALID" ;
VAL_ 194 OBJ_Angle_Rate_V_24 1 "VALID" 0 "INVALID" ;
VAL_ 194 OBJ_Angle_Right_V_24 1 "VALID" 0 "INVALID" ;
VAL_ 194 OBJ_Angle_Right_STD_V_24 1 "VALID" 0 "INVALID" ;
VAL_ 194 OBJ_Angle_Left_V_24 1 "VALID" 0 "INVALID" ;
VAL_ 194 OBJ_Angle_Left_STD_V_24 1 "VALID" 0 "INVALID" ;
VAL_ 194 OBJ_Angle_Side_V_24 1 "VALID" 0 "INVALID" ;
VAL_ 194 OBJ_Angle_Side_STD_V_24 1 "VALID" 0 "INVALID" ;
VAL_ 194 OBJ_Angle_Mid_V_24 1 "VALID" 0 "INVALID" ;
VAL_ 194 OBJ_Angle_Mid_STD_V_24 1 "VALID" 0 "INVALID" ;
VAL_ 194 OBJ_Angle_Bottom_V_24 1 "VALID" 0 "INVALID" ;
VAL_ 194 OBJ_Angle_Bottom_STD_V_24 1 "VALID" 0 "INVALID" ;
VAL_ 194 OBJ_Visibility_Side_V_24 1 "VALID" 0 "INVALID" ;
VAL_ 194 OBJ_Visibility_Side_24 2 "REAR" 1 "FRONT" 0 "NOT_VISIBLE" ;
VAL_ 194 OBJ_Is_In_Drivable_Area_24 1 "TRUE" 0 "FALSE" ;
VAL_ 194 OBJ_Is_In_Drivable_Area_V_24 1 "VALID" 0 "INVALID" ;
VAL_ 194 OBJ_Is_VeryClose_24 1 "TRUE" 0 "FALSE" ;
VAL_ 194 OBJ_Is_VeryClose_V_24 1 "VALID" 0 "INVALID" ;
VAL_ 193 OBJ_Triggered_SDM_24 2 "NOT_TRIGGERED" 1 "TRIGGERED" 0 "NOT_AVAILABLE" ;
VAL_ 193 OBJ_Motion_Category_24 13 "ONCOMING" 12 "PRECEEDING" 11 "MOVING" 10 "RTAP" 9 "LTAP" 8 "CROSSING" 7 "MOVING_OUT" 6 "MOVING_IN" 5 "CLOSE_CUT_IN" 4 "PASSING_OUT" 3 "PASSING_IN" 2 "PASSING" 1 "UNDEFINED" 0 "INVALID" ;
VAL_ 193 OBJ_Measuring_Status_24 2 "(BIT_2)NOT_VALID_OR_VALID" 1 "(BIT_1)PREDICTED_OR_MEASURED" 0 "(BIT_0)OLD_OR_NEW" ;
VAL_ 193 OBJ_Object_Class_24 8 "UNCERTAIN_VCL" 7 "ANIMAL" 6 "GENERAL_OBJECT" 5 "PEDESTRIAN" 4 "BICYCLE" 3 "MOTOR_BIKE" 2 "TRUCK" 1 "CAR" 0 "INVALID" ;
VAL_ 193 OBJ_Camera_Source_24 11 "PARKING_RIGHT" 10 "PARKING_LEFT" 9 "PARKING_REAR" 8 "PARKING_FRONT" 7 "FRONT_CORNER_RIGHT" 6 "FRONT_CORNER_LEFT" 5 "REAR_CORNER_RIGHT" 4 "REAR_CORNER_LEFT" 3 "REAR" 2 "FRONT_FISHEYE" 1 "FRONT_NARROW" 0 "FRONT_MAIN" ;
VAL_ 193 OBJ_Motion_Status_24 5 "MOVING_SLOWLY" 4 "STOPPED" 3 "STATIONARY" 2 "MOVING" 1 "UNKNOWN" 0 "INVALID" ;
VAL_ 193 OBJ_Motion_Orientation_24 13 "UNKNOWN" 12 "PRECEEDING" 11 "DRIFTING_LEFT" 9 "CROSSING_LEFT" 7 "OC_DRIFTING_LEFT" 6 "ONCOMING" 5 "OC_DRIFTING_RIGHT" 3 "CROSSING_RIGHT" 1 "DRIFTING_RIGHT" 0 "INVALID" ;
VAL_ 193 OBJ_Has_Cut_Lane_24 1 "TRUE" 0 "FALSE" ;
VAL_ 193 OBJ_Has_Cut_Path_24 1 "TRUE" 0 "FALSE" ;
VAL_ 193 OBJ_Brake_Light_24 1 "TRUE" 0 "FALSE" ;
VAL_ 193 OBJ_Turn_Indicator_Right_24 1 "TRUE" 0 "FALSE" ;
VAL_ 193 OBJ_Turn_Indicator_Left_24 1 "TRUE" 0 "FALSE" ;
VAL_ 193 OBJ_Light_Indicator_Validity_24 1 "TRUE" 0 "FALSE" ;
VAL_ 193 OBJ_Right_Out_Of_Image_24 1 "TRUE" 0 "FALSE" ;
VAL_ 193 OBJ_Left_Out_Of_Image_24 1 "TRUE" 0 "FALSE" ;
VAL_ 193 OBJ_Right_Out_Of_Image_V_24 1 "TRUE" 0 "FALSE" ;
VAL_ 193 OBJ_Left_Out_Of_Image_V_24 1 "TRUE" 0 "FALSE" ;
VAL_ 193 OBJ_Top_Out_Of_Image_24 1 "TRUE" 0 "FALSE" ;
VAL_ 193 OBJ_Bottom_Out_Of_Image_24 1 "TRUE" 0 "FALSE" ;
VAL_ 193 OBJ_Top_Out_Of_Image_V_24 1 "VALID" 0 "INVALID" ;
VAL_ 193 OBJ_Bottom_Out_Of_Image_V_24 1 "VALID" 0 "INVALID" ;
VAL_ 193 OBJ_Lane_Assignment_24 5 "RIGHT_RIGHT" 4 "RIGHT" 3 "HOST" 2 "LEFT" 1 "LEFT_LEFT" 0 "UNKNOWN" ;
VAL_ 193 OBJ_Lane_Assignment_V_24 1 "VALID" 0 "INVALID" ;
VAL_ 193 OBJ_Age_Seconds_V_24 1 "VALID" 0 "INVALID" ;
VAL_ 193 OBJ_Width_V_24 1 "VALID" 0 "INVALID" ;
VAL_ 193 OBJ_Width_STD_V_24 1 "VALID" 0 "INVALID" ;
VAL_ 193 OBJ_Length_V_24 1 "VALID" 0 "INVALID" ;
VAL_ 193 OBJ_Length_STD_V_24 1 "VALID" 0 "INVALID" ;
VAL_ 193 OBJ_Height_V_24 1 "VALID" 0 "INVALID" ;
VAL_ 193 OBJ_Height_STD_V_24 1 "VALID" 0 "INVALID" ;
VAL_ 193 OBJ_Abs_Long_Velocity_V_24 1 "VALID" 0 "INVALID" ;
VAL_ 193 OBJ_Abs_Long_Vel_STD_V_24 1 "VALID" 0 "INVALID" ;
VAL_ 193 OBJ_Abs_Lat_Velocity_V_24 1 "VALID" 0 "INVALID" ;
VAL_ 193 OBJ_Abs_Lat_Vel_STD_V_24 1 "VALID" 0 "INVALID" ;
VAL_ 193 OBJ_Abs_Long_Acc_V_24 1 "VALID" 0 "INVALID" ;
VAL_ 193 OBJ_Abs_Long_Acc_STD_V_24 1 "VALID" 0 "INVALID" ;
VAL_ 193 OBJ_Abs_Lat_Acc_V_24 1 "VALID" 0 "INVALID" ;
VAL_ 193 OBJ_Abs_Lat_Acc_STD_V_24 1 "VALID" 0 "INVALID" ;
VAL_ 193 OBJ_Abs_Acceleration_V_24 1 "VALID" 0 "INVALID" ;
VAL_ 193 OBJ_Abs_Acc_STD_V_24 1 "VALID" 0 "INVALID" ;
VAL_ 193 OBJ_Inv_TTC_V_24 1 "VALID" 0 "INVALID" ;
VAL_ 193 OBJ_Inv_TTC_STD_V_24 1 "VALID" 0 "INVALID" ;
VAL_ 193 OBJ_Relative_Long_Acc_V_24 1 "VALID" 0 "INVALID" ;
VAL_ 193 OBJ_Rel_Long_Acc_STD_V_24 1 "VALID" 0 "INVALID" ;
VAL_ 192 OBJ_Relative_Long_Velocity_V_23 1 "VALID" 0 "INVALID" ;
VAL_ 192 OBJ_Rel_Long_Vel_STD_V_23 1 "VALID" 0 "INVALID" ;
VAL_ 192 OBJ_Relative_Lat_Velocity_V_23 1 "VALID" 0 "INVALID" ;
VAL_ 192 OBJ_Rel_Lat_Vel_STD_V_23 1 "VALID" 0 "INVALID" ;
VAL_ 192 OBJ_Long_Distance_V_23 1 "VALID" 0 "INVALID" ;
VAL_ 192 OBJ_Long_Distance_STD_V_23 1 "VALID" 0 "INVALID" ;
VAL_ 192 OBJ_Lat_Distance_V_23 1 "VALID" 0 "INVALID" ;
VAL_ 192 OBJ_Lat_Distance_STD_V_23 1 "VALID" 0 "INVALID" ;
VAL_ 192 OBJ_Absolute_Speed_V_23 1 "VALID" 0 "INVALID" ;
VAL_ 192 OBJ_Absolute_Speed_STD_V_23 1 "VALID" 0 "INVALID" ;
VAL_ 192 OBJ_Heading_V_23 1 "VALID" 0 "INVALID" ;
VAL_ 192 OBJ_Heading_STD_V_23 1 "VALID" 0 "INVALID" ;
VAL_ 192 OBJ_Angle_Rate_STD_V_23 1 "VALID" 0 "INVALID" ;
VAL_ 192 OBJ_Angle_Rate_V_23 1 "VALID" 0 "INVALID" ;
VAL_ 192 OBJ_Angle_Right_V_23 1 "VALID" 0 "INVALID" ;
VAL_ 192 OBJ_Angle_Right_STD_V_23 1 "VALID" 0 "INVALID" ;
VAL_ 192 OBJ_Angle_Left_V_23 1 "VALID" 0 "INVALID" ;
VAL_ 192 OBJ_Angle_Left_STD_V_23 1 "VALID" 0 "INVALID" ;
VAL_ 192 OBJ_Angle_Side_V_23 1 "VALID" 0 "INVALID" ;
VAL_ 192 OBJ_Angle_Side_STD_V_23 1 "VALID" 0 "INVALID" ;
VAL_ 192 OBJ_Angle_Mid_V_23 1 "VALID" 0 "INVALID" ;
VAL_ 192 OBJ_Angle_Mid_STD_V_23 1 "VALID" 0 "INVALID" ;
VAL_ 192 OBJ_Angle_Bottom_V_23 1 "VALID" 0 "INVALID" ;
VAL_ 192 OBJ_Angle_Bottom_STD_V_23 1 "VALID" 0 "INVALID" ;
VAL_ 192 OBJ_Visibility_Side_V_23 1 "VALID" 0 "INVALID" ;
VAL_ 192 OBJ_Visibility_Side_23 2 "REAR" 1 "FRONT" 0 "NOT_VISIBLE" ;
VAL_ 192 OBJ_Is_In_Drivable_Area_23 1 "TRUE" 0 "FALSE" ;
VAL_ 192 OBJ_Is_In_Drivable_Area_V_23 1 "VALID" 0 "INVALID" ;
VAL_ 192 OBJ_Is_VeryClose_23 1 "TRUE" 0 "FALSE" ;
VAL_ 192 OBJ_Is_VeryClose_V_23 1 "VALID" 0 "INVALID" ;
VAL_ 191 OBJ_Triggered_SDM_23 2 "NOT_TRIGGERED" 1 "TRIGGERED" 0 "NOT_AVAILABLE" ;
VAL_ 191 OBJ_Motion_Category_23 13 "ONCOMING" 12 "PRECEEDING" 11 "MOVING" 10 "RTAP" 9 "LTAP" 8 "CROSSING" 7 "MOVING_OUT" 6 "MOVING_IN" 5 "CLOSE_CUT_IN" 4 "PASSING_OUT" 3 "PASSING_IN" 2 "PASSING" 1 "UNDEFINED" 0 "INVALID" ;
VAL_ 191 OBJ_Measuring_Status_23 2 "(BIT_2)NOT_VALID_OR_VALID" 1 "(BIT_1)PREDICTED_OR_MEASURED" 0 "(BIT_0)OLD_OR_NEW" ;
VAL_ 191 OBJ_Object_Class_23 8 "UNCERTAIN_VCL" 7 "ANIMAL" 6 "GENERAL_OBJECT" 5 "PEDESTRIAN" 4 "BICYCLE" 3 "MOTOR_BIKE" 2 "TRUCK" 1 "CAR" 0 "INVALID" ;
VAL_ 191 OBJ_Camera_Source_23 11 "PARKING_RIGHT" 10 "PARKING_LEFT" 9 "PARKING_REAR" 8 "PARKING_FRONT" 7 "FRONT_CORNER_RIGHT" 6 "FRONT_CORNER_LEFT" 5 "REAR_CORNER_RIGHT" 4 "REAR_CORNER_LEFT" 3 "REAR" 2 "FRONT_FISHEYE" 1 "FRONT_NARROW" 0 "FRONT_MAIN" ;
VAL_ 191 OBJ_Motion_Status_23 5 "MOVING_SLOWLY" 4 "STOPPED" 3 "STATIONARY" 2 "MOVING" 1 "UNKNOWN" 0 "INVALID" ;
VAL_ 191 OBJ_Motion_Orientation_23 13 "UNKNOWN" 12 "PRECEEDING" 11 "DRIFTING_LEFT" 9 "CROSSING_LEFT" 7 "OC_DRIFTING_LEFT" 6 "ONCOMING" 5 "OC_DRIFTING_RIGHT" 3 "CROSSING_RIGHT" 1 "DRIFTING_RIGHT" 0 "INVALID" ;
VAL_ 191 OBJ_Has_Cut_Lane_23 1 "TRUE" 0 "FALSE" ;
VAL_ 191 OBJ_Has_Cut_Path_23 1 "TRUE" 0 "FALSE" ;
VAL_ 191 OBJ_Brake_Light_23 1 "TRUE" 0 "FALSE" ;
VAL_ 191 OBJ_Turn_Indicator_Right_23 1 "TRUE" 0 "FALSE" ;
VAL_ 191 OBJ_Turn_Indicator_Left_23 1 "TRUE" 0 "FALSE" ;
VAL_ 191 OBJ_Light_Indicator_Validity_23 1 "TRUE" 0 "FALSE" ;
VAL_ 191 OBJ_Right_Out_Of_Image_23 1 "TRUE" 0 "FALSE" ;
VAL_ 191 OBJ_Left_Out_Of_Image_23 1 "TRUE" 0 "FALSE" ;
VAL_ 191 OBJ_Right_Out_Of_Image_V_23 1 "TRUE" 0 "FALSE" ;
VAL_ 191 OBJ_Left_Out_Of_Image_V_23 1 "TRUE" 0 "FALSE" ;
VAL_ 191 OBJ_Top_Out_Of_Image_23 1 "TRUE" 0 "FALSE" ;
VAL_ 191 OBJ_Bottom_Out_Of_Image_23 1 "TRUE" 0 "FALSE" ;
VAL_ 191 OBJ_Top_Out_Of_Image_V_23 1 "VALID" 0 "INVALID" ;
VAL_ 191 OBJ_Bottom_Out_Of_Image_V_23 1 "VALID" 0 "INVALID" ;
VAL_ 191 OBJ_Lane_Assignment_23 5 "RIGHT_RIGHT" 4 "RIGHT" 3 "HOST" 2 "LEFT" 1 "LEFT_LEFT" 0 "UNKNOWN" ;
VAL_ 191 OBJ_Lane_Assignment_V_23 1 "VALID" 0 "INVALID" ;
VAL_ 191 OBJ_Age_Seconds_V_23 1 "VALID" 0 "INVALID" ;
VAL_ 191 OBJ_Width_V_23 1 "VALID" 0 "INVALID" ;
VAL_ 191 OBJ_Width_STD_V_23 1 "VALID" 0 "INVALID" ;
VAL_ 191 OBJ_Length_V_23 1 "VALID" 0 "INVALID" ;
VAL_ 191 OBJ_Length_STD_V_23 1 "VALID" 0 "INVALID" ;
VAL_ 191 OBJ_Height_V_23 1 "VALID" 0 "INVALID" ;
VAL_ 191 OBJ_Height_STD_V_23 1 "VALID" 0 "INVALID" ;
VAL_ 191 OBJ_Abs_Long_Velocity_V_23 1 "VALID" 0 "INVALID" ;
VAL_ 191 OBJ_Abs_Long_Vel_STD_V_23 1 "VALID" 0 "INVALID" ;
VAL_ 191 OBJ_Abs_Lat_Velocity_V_23 1 "VALID" 0 "INVALID" ;
VAL_ 191 OBJ_Abs_Lat_Vel_STD_V_23 1 "VALID" 0 "INVALID" ;
VAL_ 191 OBJ_Abs_Long_Acc_V_23 1 "VALID" 0 "INVALID" ;
VAL_ 191 OBJ_Abs_Long_Acc_STD_V_23 1 "VALID" 0 "INVALID" ;
VAL_ 191 OBJ_Abs_Lat_Acc_V_23 1 "VALID" 0 "INVALID" ;
VAL_ 191 OBJ_Abs_Lat_Acc_STD_V_23 1 "VALID" 0 "INVALID" ;
VAL_ 191 OBJ_Abs_Acceleration_V_23 1 "VALID" 0 "INVALID" ;
VAL_ 191 OBJ_Abs_Acc_STD_V_23 1 "VALID" 0 "INVALID" ;
VAL_ 191 OBJ_Inv_TTC_V_23 1 "VALID" 0 "INVALID" ;
VAL_ 191 OBJ_Inv_TTC_STD_V_23 1 "VALID" 0 "INVALID" ;
VAL_ 191 OBJ_Relative_Long_Acc_V_23 1 "VALID" 0 "INVALID" ;
VAL_ 191 OBJ_Rel_Long_Acc_STD_V_23 1 "VALID" 0 "INVALID" ;
VAL_ 190 OBJ_Relative_Long_Velocity_V_22 1 "VALID" 0 "INVALID" ;
VAL_ 190 OBJ_Rel_Long_Vel_STD_V_22 1 "VALID" 0 "INVALID" ;
VAL_ 190 OBJ_Relative_Lat_Velocity_V_22 1 "VALID" 0 "INVALID" ;
VAL_ 190 OBJ_Rel_Lat_Vel_STD_V_22 1 "VALID" 0 "INVALID" ;
VAL_ 190 OBJ_Long_Distance_V_22 1 "VALID" 0 "INVALID" ;
VAL_ 190 OBJ_Long_Distance_STD_V_22 1 "VALID" 0 "INVALID" ;
VAL_ 190 OBJ_Lat_Distance_V_22 1 "VALID" 0 "INVALID" ;
VAL_ 190 OBJ_Lat_Distance_STD_V_22 1 "VALID" 0 "INVALID" ;
VAL_ 190 OBJ_Absolute_Speed_V_22 1 "VALID" 0 "INVALID" ;
VAL_ 190 OBJ_Absolute_Speed_STD_V_22 1 "VALID" 0 "INVALID" ;
VAL_ 190 OBJ_Heading_V_22 1 "VALID" 0 "INVALID" ;
VAL_ 190 OBJ_Heading_STD_V_22 1 "VALID" 0 "INVALID" ;
VAL_ 190 OBJ_Angle_Rate_STD_V_22 1 "VALID" 0 "INVALID" ;
VAL_ 190 OBJ_Angle_Rate_V_22 1 "VALID" 0 "INVALID" ;
VAL_ 190 OBJ_Angle_Right_V_22 1 "VALID" 0 "INVALID" ;
VAL_ 190 OBJ_Angle_Right_STD_V_22 1 "VALID" 0 "INVALID" ;
VAL_ 190 OBJ_Angle_Left_V_22 1 "VALID" 0 "INVALID" ;
VAL_ 190 OBJ_Angle_Left_STD_V_22 1 "VALID" 0 "INVALID" ;
VAL_ 190 OBJ_Angle_Side_V_22 1 "VALID" 0 "INVALID" ;
VAL_ 190 OBJ_Angle_Side_STD_V_22 1 "VALID" 0 "INVALID" ;
VAL_ 190 OBJ_Angle_Mid_V_22 1 "VALID" 0 "INVALID" ;
VAL_ 190 OBJ_Angle_Mid_STD_V_22 1 "VALID" 0 "INVALID" ;
VAL_ 190 OBJ_Angle_Bottom_V_22 1 "VALID" 0 "INVALID" ;
VAL_ 190 OBJ_Angle_Bottom_STD_V_22 1 "VALID" 0 "INVALID" ;
VAL_ 190 OBJ_Visibility_Side_V_22 1 "VALID" 0 "INVALID" ;
VAL_ 190 OBJ_Visibility_Side_22 2 "REAR" 1 "FRONT" 0 "NOT_VISIBLE" ;
VAL_ 190 OBJ_Is_In_Drivable_Area_22 1 "TRUE" 0 "FALSE" ;
VAL_ 190 OBJ_Is_In_Drivable_Area_V_22 1 "VALID" 0 "INVALID" ;
VAL_ 190 OBJ_Is_VeryClose_22 1 "TRUE" 0 "FALSE" ;
VAL_ 190 OBJ_Is_VeryClose_V_22 1 "VALID" 0 "INVALID" ;
VAL_ 189 OBJ_Triggered_SDM_22 2 "NOT_TRIGGERED" 1 "TRIGGERED" 0 "NOT_AVAILABLE" ;
VAL_ 189 OBJ_Motion_Category_22 13 "ONCOMING" 12 "PRECEEDING" 11 "MOVING" 10 "RTAP" 9 "LTAP" 8 "CROSSING" 7 "MOVING_OUT" 6 "MOVING_IN" 5 "CLOSE_CUT_IN" 4 "PASSING_OUT" 3 "PASSING_IN" 2 "PASSING" 1 "UNDEFINED" 0 "INVALID" ;
VAL_ 189 OBJ_Measuring_Status_22 2 "(BIT_2)NOT_VALID_OR_VALID" 1 "(BIT_1)PREDICTED_OR_MEASURED" 0 "(BIT_0)OLD_OR_NEW" ;
VAL_ 189 OBJ_Object_Class_22 8 "UNCERTAIN_VCL" 7 "ANIMAL" 6 "GENERAL_OBJECT" 5 "PEDESTRIAN" 4 "BICYCLE" 3 "MOTOR_BIKE" 2 "TRUCK" 1 "CAR" 0 "INVALID" ;
VAL_ 189 OBJ_Camera_Source_22 11 "PARKING_RIGHT" 10 "PARKING_LEFT" 9 "PARKING_REAR" 8 "PARKING_FRONT" 7 "FRONT_CORNER_RIGHT" 6 "FRONT_CORNER_LEFT" 5 "REAR_CORNER_RIGHT" 4 "REAR_CORNER_LEFT" 3 "REAR" 2 "FRONT_FISHEYE" 1 "FRONT_NARROW" 0 "FRONT_MAIN" ;
VAL_ 189 OBJ_Motion_Status_22 5 "MOVING_SLOWLY" 4 "STOPPED" 3 "STATIONARY" 2 "MOVING" 1 "UNKNOWN" 0 "INVALID" ;
VAL_ 189 OBJ_Motion_Orientation_22 13 "UNKNOWN" 12 "PRECEEDING" 11 "DRIFTING_LEFT" 9 "CROSSING_LEFT" 7 "OC_DRIFTING_LEFT" 6 "ONCOMING" 5 "OC_DRIFTING_RIGHT" 3 "CROSSING_RIGHT" 1 "DRIFTING_RIGHT" 0 "INVALID" ;
VAL_ 189 OBJ_Has_Cut_Lane_22 1 "TRUE" 0 "FALSE" ;
VAL_ 189 OBJ_Has_Cut_Path_22 1 "TRUE" 0 "FALSE" ;
VAL_ 189 OBJ_Brake_Light_22 1 "TRUE" 0 "FALSE" ;
VAL_ 189 OBJ_Turn_Indicator_Right_22 1 "TRUE" 0 "FALSE" ;
VAL_ 189 OBJ_Turn_Indicator_Left_22 1 "TRUE" 0 "FALSE" ;
VAL_ 189 OBJ_Light_Indicator_Validity_22 1 "TRUE" 0 "FALSE" ;
VAL_ 189 OBJ_Right_Out_Of_Image_22 1 "TRUE" 0 "FALSE" ;
VAL_ 189 OBJ_Left_Out_Of_Image_22 1 "TRUE" 0 "FALSE" ;
VAL_ 189 OBJ_Right_Out_Of_Image_V_22 1 "TRUE" 0 "FALSE" ;
VAL_ 189 OBJ_Left_Out_Of_Image_V_22 1 "TRUE" 0 "FALSE" ;
VAL_ 189 OBJ_Top_Out_Of_Image_22 1 "TRUE" 0 "FALSE" ;
VAL_ 189 OBJ_Bottom_Out_Of_Image_22 1 "TRUE" 0 "FALSE" ;
VAL_ 189 OBJ_Top_Out_Of_Image_V_22 1 "VALID" 0 "INVALID" ;
VAL_ 189 OBJ_Bottom_Out_Of_Image_V_22 1 "VALID" 0 "INVALID" ;
VAL_ 189 OBJ_Lane_Assignment_22 5 "RIGHT_RIGHT" 4 "RIGHT" 3 "HOST" 2 "LEFT" 1 "LEFT_LEFT" 0 "UNKNOWN" ;
VAL_ 189 OBJ_Lane_Assignment_V_22 1 "VALID" 0 "INVALID" ;
VAL_ 189 OBJ_Age_Seconds_V_22 1 "VALID" 0 "INVALID" ;
VAL_ 189 OBJ_Width_V_22 1 "VALID" 0 "INVALID" ;
VAL_ 189 OBJ_Width_STD_V_22 1 "VALID" 0 "INVALID" ;
VAL_ 189 OBJ_Length_V_22 1 "VALID" 0 "INVALID" ;
VAL_ 189 OBJ_Length_STD_V_22 1 "VALID" 0 "INVALID" ;
VAL_ 189 OBJ_Height_V_22 1 "VALID" 0 "INVALID" ;
VAL_ 189 OBJ_Height_STD_V_22 1 "VALID" 0 "INVALID" ;
VAL_ 189 OBJ_Abs_Long_Velocity_V_22 1 "VALID" 0 "INVALID" ;
VAL_ 189 OBJ_Abs_Long_Vel_STD_V_22 1 "VALID" 0 "INVALID" ;
VAL_ 189 OBJ_Abs_Lat_Velocity_V_22 1 "VALID" 0 "INVALID" ;
VAL_ 189 OBJ_Abs_Lat_Vel_STD_V_22 1 "VALID" 0 "INVALID" ;
VAL_ 189 OBJ_Abs_Long_Acc_V_22 1 "VALID" 0 "INVALID" ;
VAL_ 189 OBJ_Abs_Long_Acc_STD_V_22 1 "VALID" 0 "INVALID" ;
VAL_ 189 OBJ_Abs_Lat_Acc_V_22 1 "VALID" 0 "INVALID" ;
VAL_ 189 OBJ_Abs_Lat_Acc_STD_V_22 1 "VALID" 0 "INVALID" ;
VAL_ 189 OBJ_Abs_Acceleration_V_22 1 "VALID" 0 "INVALID" ;
VAL_ 189 OBJ_Abs_Acc_STD_V_22 1 "VALID" 0 "INVALID" ;
VAL_ 189 OBJ_Inv_TTC_V_22 1 "VALID" 0 "INVALID" ;
VAL_ 189 OBJ_Inv_TTC_STD_V_22 1 "VALID" 0 "INVALID" ;
VAL_ 189 OBJ_Relative_Long_Acc_V_22 1 "VALID" 0 "INVALID" ;
VAL_ 189 OBJ_Rel_Long_Acc_STD_V_22 1 "VALID" 0 "INVALID" ;
VAL_ 188 OBJ_Relative_Long_Velocity_V_21 1 "VALID" 0 "INVALID" ;
VAL_ 188 OBJ_Rel_Long_Vel_STD_V_21 1 "VALID" 0 "INVALID" ;
VAL_ 188 OBJ_Relative_Lat_Velocity_V_21 1 "VALID" 0 "INVALID" ;
VAL_ 188 OBJ_Rel_Lat_Vel_STD_V_21 1 "VALID" 0 "INVALID" ;
VAL_ 188 OBJ_Long_Distance_V_21 1 "VALID" 0 "INVALID" ;
VAL_ 188 OBJ_Long_Distance_STD_V_21 1 "VALID" 0 "INVALID" ;
VAL_ 188 OBJ_Lat_Distance_V_21 1 "VALID" 0 "INVALID" ;
VAL_ 188 OBJ_Lat_Distance_STD_V_21 1 "VALID" 0 "INVALID" ;
VAL_ 188 OBJ_Absolute_Speed_V_21 1 "VALID" 0 "INVALID" ;
VAL_ 188 OBJ_Absolute_Speed_STD_V_21 1 "VALID" 0 "INVALID" ;
VAL_ 188 OBJ_Heading_V_21 1 "VALID" 0 "INVALID" ;
VAL_ 188 OBJ_Heading_STD_V_21 1 "VALID" 0 "INVALID" ;
VAL_ 188 OBJ_Angle_Rate_STD_V_21 1 "VALID" 0 "INVALID" ;
VAL_ 188 OBJ_Angle_Rate_V_21 1 "VALID" 0 "INVALID" ;
VAL_ 188 OBJ_Angle_Right_V_21 1 "VALID" 0 "INVALID" ;
VAL_ 188 OBJ_Angle_Right_STD_V_21 1 "VALID" 0 "INVALID" ;
VAL_ 188 OBJ_Angle_Left_V_21 1 "VALID" 0 "INVALID" ;
VAL_ 188 OBJ_Angle_Left_STD_V_21 1 "VALID" 0 "INVALID" ;
VAL_ 188 OBJ_Angle_Side_V_21 1 "VALID" 0 "INVALID" ;
VAL_ 188 OBJ_Angle_Side_STD_V_21 1 "VALID" 0 "INVALID" ;
VAL_ 188 OBJ_Angle_Mid_V_21 1 "VALID" 0 "INVALID" ;
VAL_ 188 OBJ_Angle_Mid_STD_V_21 1 "VALID" 0 "INVALID" ;
VAL_ 188 OBJ_Angle_Bottom_V_21 1 "VALID" 0 "INVALID" ;
VAL_ 188 OBJ_Angle_Bottom_STD_V_21 1 "VALID" 0 "INVALID" ;
VAL_ 188 OBJ_Visibility_Side_V_21 1 "VALID" 0 "INVALID" ;
VAL_ 188 OBJ_Visibility_Side_21 2 "REAR" 1 "FRONT" 0 "NOT_VISIBLE" ;
VAL_ 188 OBJ_Is_In_Drivable_Area_21 1 "TRUE" 0 "FALSE" ;
VAL_ 188 OBJ_Is_In_Drivable_Area_V_21 1 "VALID" 0 "INVALID" ;
VAL_ 188 OBJ_Is_VeryClose_21 1 "TRUE" 0 "FALSE" ;
VAL_ 188 OBJ_Is_VeryClose_V_21 1 "VALID" 0 "INVALID" ;
VAL_ 187 OBJ_Triggered_SDM_21 2 "NOT_TRIGGERED" 1 "TRIGGERED" 0 "NOT_AVAILABLE" ;
VAL_ 187 OBJ_Motion_Category_21 13 "ONCOMING" 12 "PRECEEDING" 11 "MOVING" 10 "RTAP" 9 "LTAP" 8 "CROSSING" 7 "MOVING_OUT" 6 "MOVING_IN" 5 "CLOSE_CUT_IN" 4 "PASSING_OUT" 3 "PASSING_IN" 2 "PASSING" 1 "UNDEFINED" 0 "INVALID" ;
VAL_ 187 OBJ_Measuring_Status_21 2 "(BIT_2)NOT_VALID_OR_VALID" 1 "(BIT_1)PREDICTED_OR_MEASURED" 0 "(BIT_0)OLD_OR_NEW" ;
VAL_ 187 OBJ_Object_Class_21 8 "UNCERTAIN_VCL" 7 "ANIMAL" 6 "GENERAL_OBJECT" 5 "PEDESTRIAN" 4 "BICYCLE" 3 "MOTOR_BIKE" 2 "TRUCK" 1 "CAR" 0 "INVALID" ;
VAL_ 187 OBJ_Camera_Source_21 11 "PARKING_RIGHT" 10 "PARKING_LEFT" 9 "PARKING_REAR" 8 "PARKING_FRONT" 7 "FRONT_CORNER_RIGHT" 6 "FRONT_CORNER_LEFT" 5 "REAR_CORNER_RIGHT" 4 "REAR_CORNER_LEFT" 3 "REAR" 2 "FRONT_FISHEYE" 1 "FRONT_NARROW" 0 "FRONT_MAIN" ;
VAL_ 187 OBJ_Motion_Status_21 5 "MOVING_SLOWLY" 4 "STOPPED" 3 "STATIONARY" 2 "MOVING" 1 "UNKNOWN" 0 "INVALID" ;
VAL_ 187 OBJ_Motion_Orientation_21 13 "UNKNOWN" 12 "PRECEEDING" 11 "DRIFTING_LEFT" 9 "CROSSING_LEFT" 7 "OC_DRIFTING_LEFT" 6 "ONCOMING" 5 "OC_DRIFTING_RIGHT" 3 "CROSSING_RIGHT" 1 "DRIFTING_RIGHT" 0 "INVALID" ;
VAL_ 187 OBJ_Has_Cut_Lane_21 1 "TRUE" 0 "FALSE" ;
VAL_ 187 OBJ_Has_Cut_Path_21 1 "TRUE" 0 "FALSE" ;
VAL_ 187 OBJ_Brake_Light_21 1 "TRUE" 0 "FALSE" ;
VAL_ 187 OBJ_Turn_Indicator_Right_21 1 "TRUE" 0 "FALSE" ;
VAL_ 187 OBJ_Turn_Indicator_Left_21 1 "TRUE" 0 "FALSE" ;
VAL_ 187 OBJ_Light_Indicator_Validity_21 1 "TRUE" 0 "FALSE" ;
VAL_ 187 OBJ_Right_Out_Of_Image_21 1 "TRUE" 0 "FALSE" ;
VAL_ 187 OBJ_Left_Out_Of_Image_21 1 "TRUE" 0 "FALSE" ;
VAL_ 187 OBJ_Right_Out_Of_Image_V_21 1 "TRUE" 0 "FALSE" ;
VAL_ 187 OBJ_Left_Out_Of_Image_V_21 1 "TRUE" 0 "FALSE" ;
VAL_ 187 OBJ_Top_Out_Of_Image_21 1 "TRUE" 0 "FALSE" ;
VAL_ 187 OBJ_Bottom_Out_Of_Image_21 1 "TRUE" 0 "FALSE" ;
VAL_ 187 OBJ_Top_Out_Of_Image_V_21 1 "VALID" 0 "INVALID" ;
VAL_ 187 OBJ_Bottom_Out_Of_Image_V_21 1 "VALID" 0 "INVALID" ;
VAL_ 187 OBJ_Lane_Assignment_21 5 "RIGHT_RIGHT" 4 "RIGHT" 3 "HOST" 2 "LEFT" 1 "LEFT_LEFT" 0 "UNKNOWN" ;
VAL_ 187 OBJ_Lane_Assignment_V_21 1 "VALID" 0 "INVALID" ;
VAL_ 187 OBJ_Age_Seconds_V_21 1 "VALID" 0 "INVALID" ;
VAL_ 187 OBJ_Width_V_21 1 "VALID" 0 "INVALID" ;
VAL_ 187 OBJ_Width_STD_V_21 1 "VALID" 0 "INVALID" ;
VAL_ 187 OBJ_Length_V_21 1 "VALID" 0 "INVALID" ;
VAL_ 187 OBJ_Length_STD_V_21 1 "VALID" 0 "INVALID" ;
VAL_ 187 OBJ_Height_V_21 1 "VALID" 0 "INVALID" ;
VAL_ 187 OBJ_Height_STD_V_21 1 "VALID" 0 "INVALID" ;
VAL_ 187 OBJ_Abs_Long_Velocity_V_21 1 "VALID" 0 "INVALID" ;
VAL_ 187 OBJ_Abs_Long_Vel_STD_V_21 1 "VALID" 0 "INVALID" ;
VAL_ 187 OBJ_Abs_Lat_Velocity_V_21 1 "VALID" 0 "INVALID" ;
VAL_ 187 OBJ_Abs_Lat_Vel_STD_V_21 1 "VALID" 0 "INVALID" ;
VAL_ 187 OBJ_Abs_Long_Acc_V_21 1 "VALID" 0 "INVALID" ;
VAL_ 187 OBJ_Abs_Long_Acc_STD_V_21 1 "VALID" 0 "INVALID" ;
VAL_ 187 OBJ_Abs_Lat_Acc_V_21 1 "VALID" 0 "INVALID" ;
VAL_ 187 OBJ_Abs_Lat_Acc_STD_V_21 1 "VALID" 0 "INVALID" ;
VAL_ 187 OBJ_Abs_Acceleration_V_21 1 "VALID" 0 "INVALID" ;
VAL_ 187 OBJ_Abs_Acc_STD_V_21 1 "VALID" 0 "INVALID" ;
VAL_ 187 OBJ_Inv_TTC_V_21 1 "VALID" 0 "INVALID" ;
VAL_ 187 OBJ_Inv_TTC_STD_V_21 1 "VALID" 0 "INVALID" ;
VAL_ 187 OBJ_Relative_Long_Acc_V_21 1 "VALID" 0 "INVALID" ;
VAL_ 187 OBJ_Rel_Long_Acc_STD_V_21 1 "VALID" 0 "INVALID" ;
VAL_ 186 OBJ_Relative_Long_Velocity_V_20 1 "VALID" 0 "INVALID" ;
VAL_ 186 OBJ_Rel_Long_Vel_STD_V_20 1 "VALID" 0 "INVALID" ;
VAL_ 186 OBJ_Relative_Lat_Velocity_V_20 1 "VALID" 0 "INVALID" ;
VAL_ 186 OBJ_Rel_Lat_Vel_STD_V_20 1 "VALID" 0 "INVALID" ;
VAL_ 186 OBJ_Long_Distance_V_20 1 "VALID" 0 "INVALID" ;
VAL_ 186 OBJ_Long_Distance_STD_V_20 1 "VALID" 0 "INVALID" ;
VAL_ 186 OBJ_Lat_Distance_V_20 1 "VALID" 0 "INVALID" ;
VAL_ 186 OBJ_Lat_Distance_STD_V_20 1 "VALID" 0 "INVALID" ;
VAL_ 186 OBJ_Absolute_Speed_V_20 1 "VALID" 0 "INVALID" ;
VAL_ 186 OBJ_Absolute_Speed_STD_V_20 1 "VALID" 0 "INVALID" ;
VAL_ 186 OBJ_Heading_V_20 1 "VALID" 0 "INVALID" ;
VAL_ 186 OBJ_Heading_STD_V_20 1 "VALID" 0 "INVALID" ;
VAL_ 186 OBJ_Angle_Rate_STD_V_20 1 "VALID" 0 "INVALID" ;
VAL_ 186 OBJ_Angle_Rate_V_20 1 "VALID" 0 "INVALID" ;
VAL_ 186 OBJ_Angle_Right_V_20 1 "VALID" 0 "INVALID" ;
VAL_ 186 OBJ_Angle_Right_STD_V_20 1 "VALID" 0 "INVALID" ;
VAL_ 186 OBJ_Angle_Left_V_20 1 "VALID" 0 "INVALID" ;
VAL_ 186 OBJ_Angle_Left_STD_V_20 1 "VALID" 0 "INVALID" ;
VAL_ 186 OBJ_Angle_Side_V_20 1 "VALID" 0 "INVALID" ;
VAL_ 186 OBJ_Angle_Side_STD_V_20 1 "VALID" 0 "INVALID" ;
VAL_ 186 OBJ_Angle_Mid_V_20 1 "VALID" 0 "INVALID" ;
VAL_ 186 OBJ_Angle_Mid_STD_V_20 1 "VALID" 0 "INVALID" ;
VAL_ 186 OBJ_Angle_Bottom_V_20 1 "VALID" 0 "INVALID" ;
VAL_ 186 OBJ_Angle_Bottom_STD_V_20 1 "VALID" 0 "INVALID" ;
VAL_ 186 OBJ_Visibility_Side_V_20 1 "VALID" 0 "INVALID" ;
VAL_ 186 OBJ_Visibility_Side_20 2 "REAR" 1 "FRONT" 0 "NOT_VISIBLE" ;
VAL_ 186 OBJ_Is_In_Drivable_Area_20 1 "TRUE" 0 "FALSE" ;
VAL_ 186 OBJ_Is_In_Drivable_Area_V_20 1 "VALID" 0 "INVALID" ;
VAL_ 186 OBJ_Is_VeryClose_20 1 "TRUE" 0 "FALSE" ;
VAL_ 186 OBJ_Is_VeryClose_V_20 1 "VALID" 0 "INVALID" ;
VAL_ 185 OBJ_Triggered_SDM_20 2 "NOT_TRIGGERED" 1 "TRIGGERED" 0 "NOT_AVAILABLE" ;
VAL_ 185 OBJ_Motion_Category_20 13 "ONCOMING" 12 "PRECEEDING" 11 "MOVING" 10 "RTAP" 9 "LTAP" 8 "CROSSING" 7 "MOVING_OUT" 6 "MOVING_IN" 5 "CLOSE_CUT_IN" 4 "PASSING_OUT" 3 "PASSING_IN" 2 "PASSING" 1 "UNDEFINED" 0 "INVALID" ;
VAL_ 185 OBJ_Measuring_Status_20 2 "(BIT_2)NOT_VALID_OR_VALID" 1 "(BIT_1)PREDICTED_OR_MEASURED" 0 "(BIT_0)OLD_OR_NEW" ;
VAL_ 185 OBJ_Object_Class_20 8 "UNCERTAIN_VCL" 7 "ANIMAL" 6 "GENERAL_OBJECT" 5 "PEDESTRIAN" 4 "BICYCLE" 3 "MOTOR_BIKE" 2 "TRUCK" 1 "CAR" 0 "INVALID" ;
VAL_ 185 OBJ_Camera_Source_20 11 "PARKING_RIGHT" 10 "PARKING_LEFT" 9 "PARKING_REAR" 8 "PARKING_FRONT" 7 "FRONT_CORNER_RIGHT" 6 "FRONT_CORNER_LEFT" 5 "REAR_CORNER_RIGHT" 4 "REAR_CORNER_LEFT" 3 "REAR" 2 "FRONT_FISHEYE" 1 "FRONT_NARROW" 0 "FRONT_MAIN" ;
VAL_ 185 OBJ_Motion_Status_20 5 "MOVING_SLOWLY" 4 "STOPPED" 3 "STATIONARY" 2 "MOVING" 1 "UNKNOWN" 0 "INVALID" ;
VAL_ 185 OBJ_Motion_Orientation_20 13 "UNKNOWN" 12 "PRECEEDING" 11 "DRIFTING_LEFT" 9 "CROSSING_LEFT" 7 "OC_DRIFTING_LEFT" 6 "ONCOMING" 5 "OC_DRIFTING_RIGHT" 3 "CROSSING_RIGHT" 1 "DRIFTING_RIGHT" 0 "INVALID" ;
VAL_ 185 OBJ_Has_Cut_Lane_20 1 "TRUE" 0 "FALSE" ;
VAL_ 185 OBJ_Has_Cut_Path_20 1 "TRUE" 0 "FALSE" ;
VAL_ 185 OBJ_Brake_Light_20 1 "TRUE" 0 "FALSE" ;
VAL_ 185 OBJ_Turn_Indicator_Right_20 1 "TRUE" 0 "FALSE" ;
VAL_ 185 OBJ_Turn_Indicator_Left_20 1 "TRUE" 0 "FALSE" ;
VAL_ 185 OBJ_Light_Indicator_Validity_20 1 "TRUE" 0 "FALSE" ;
VAL_ 185 OBJ_Right_Out_Of_Image_20 1 "TRUE" 0 "FALSE" ;
VAL_ 185 OBJ_Left_Out_Of_Image_20 1 "TRUE" 0 "FALSE" ;
VAL_ 185 OBJ_Right_Out_Of_Image_V_20 1 "TRUE" 0 "FALSE" ;
VAL_ 185 OBJ_Left_Out_Of_Image_V_20 1 "TRUE" 0 "FALSE" ;
VAL_ 185 OBJ_Top_Out_Of_Image_20 1 "TRUE" 0 "FALSE" ;
VAL_ 185 OBJ_Bottom_Out_Of_Image_20 1 "TRUE" 0 "FALSE" ;
VAL_ 185 OBJ_Top_Out_Of_Image_V_20 1 "VALID" 0 "INVALID" ;
VAL_ 185 OBJ_Bottom_Out_Of_Image_V_20 1 "VALID" 0 "INVALID" ;
VAL_ 185 OBJ_Lane_Assignment_20 5 "RIGHT_RIGHT" 4 "RIGHT" 3 "HOST" 2 "LEFT" 1 "LEFT_LEFT" 0 "UNKNOWN" ;
VAL_ 185 OBJ_Lane_Assignment_V_20 1 "VALID" 0 "INVALID" ;
VAL_ 185 OBJ_Age_Seconds_V_20 1 "VALID" 0 "INVALID" ;
VAL_ 185 OBJ_Width_V_20 1 "VALID" 0 "INVALID" ;
VAL_ 185 OBJ_Width_STD_V_20 1 "VALID" 0 "INVALID" ;
VAL_ 185 OBJ_Length_V_20 1 "VALID" 0 "INVALID" ;
VAL_ 185 OBJ_Length_STD_V_20 1 "VALID" 0 "INVALID" ;
VAL_ 185 OBJ_Height_V_20 1 "VALID" 0 "INVALID" ;
VAL_ 185 OBJ_Height_STD_V_20 1 "VALID" 0 "INVALID" ;
VAL_ 185 OBJ_Abs_Long_Velocity_V_20 1 "VALID" 0 "INVALID" ;
VAL_ 185 OBJ_Abs_Long_Vel_STD_V_20 1 "VALID" 0 "INVALID" ;
VAL_ 185 OBJ_Abs_Lat_Velocity_V_20 1 "VALID" 0 "INVALID" ;
VAL_ 185 OBJ_Abs_Lat_Vel_STD_V_20 1 "VALID" 0 "INVALID" ;
VAL_ 185 OBJ_Abs_Long_Acc_V_20 1 "VALID" 0 "INVALID" ;
VAL_ 185 OBJ_Abs_Long_Acc_STD_V_20 1 "VALID" 0 "INVALID" ;
VAL_ 185 OBJ_Abs_Lat_Acc_V_20 1 "VALID" 0 "INVALID" ;
VAL_ 185 OBJ_Abs_Lat_Acc_STD_V_20 1 "VALID" 0 "INVALID" ;
VAL_ 185 OBJ_Abs_Acceleration_V_20 1 "VALID" 0 "INVALID" ;
VAL_ 185 OBJ_Abs_Acc_STD_V_20 1 "VALID" 0 "INVALID" ;
VAL_ 185 OBJ_Inv_TTC_V_20 1 "VALID" 0 "INVALID" ;
VAL_ 185 OBJ_Inv_TTC_STD_V_20 1 "VALID" 0 "INVALID" ;
VAL_ 185 OBJ_Relative_Long_Acc_V_20 1 "VALID" 0 "INVALID" ;
VAL_ 185 OBJ_Rel_Long_Acc_STD_V_20 1 "VALID" 0 "INVALID" ;
VAL_ 184 OBJ_Relative_Long_Velocity_V_19 1 "VALID" 0 "INVALID" ;
VAL_ 184 OBJ_Rel_Long_Vel_STD_V_19 1 "VALID" 0 "INVALID" ;
VAL_ 184 OBJ_Relative_Lat_Velocity_V_19 1 "VALID" 0 "INVALID" ;
VAL_ 184 OBJ_Rel_Lat_Vel_STD_V_19 1 "VALID" 0 "INVALID" ;
VAL_ 184 OBJ_Long_Distance_V_19 1 "VALID" 0 "INVALID" ;
VAL_ 184 OBJ_Long_Distance_STD_V_19 1 "VALID" 0 "INVALID" ;
VAL_ 184 OBJ_Lat_Distance_V_19 1 "VALID" 0 "INVALID" ;
VAL_ 184 OBJ_Lat_Distance_STD_V_19 1 "VALID" 0 "INVALID" ;
VAL_ 184 OBJ_Absolute_Speed_V_19 1 "VALID" 0 "INVALID" ;
VAL_ 184 OBJ_Absolute_Speed_STD_V_19 1 "VALID" 0 "INVALID" ;
VAL_ 184 OBJ_Heading_V_19 1 "VALID" 0 "INVALID" ;
VAL_ 184 OBJ_Heading_STD_V_19 1 "VALID" 0 "INVALID" ;
VAL_ 184 OBJ_Angle_Rate_STD_V_19 1 "VALID" 0 "INVALID" ;
VAL_ 184 OBJ_Angle_Rate_V_19 1 "VALID" 0 "INVALID" ;
VAL_ 184 OBJ_Angle_Right_V_19 1 "VALID" 0 "INVALID" ;
VAL_ 184 OBJ_Angle_Right_STD_V_19 1 "VALID" 0 "INVALID" ;
VAL_ 184 OBJ_Angle_Left_V_19 1 "VALID" 0 "INVALID" ;
VAL_ 184 OBJ_Angle_Left_STD_V_19 1 "VALID" 0 "INVALID" ;
VAL_ 184 OBJ_Angle_Side_V_19 1 "VALID" 0 "INVALID" ;
VAL_ 184 OBJ_Angle_Side_STD_V_19 1 "VALID" 0 "INVALID" ;
VAL_ 184 OBJ_Angle_Mid_V_19 1 "VALID" 0 "INVALID" ;
VAL_ 184 OBJ_Angle_Mid_STD_V_19 1 "VALID" 0 "INVALID" ;
VAL_ 184 OBJ_Angle_Bottom_V_19 1 "VALID" 0 "INVALID" ;
VAL_ 184 OBJ_Angle_Bottom_STD_V_19 1 "VALID" 0 "INVALID" ;
VAL_ 184 OBJ_Visibility_Side_V_19 1 "VALID" 0 "INVALID" ;
VAL_ 184 OBJ_Visibility_Side_19 2 "REAR" 1 "FRONT" 0 "NOT_VISIBLE" ;
VAL_ 184 OBJ_Is_In_Drivable_Area_19 1 "TRUE" 0 "FALSE" ;
VAL_ 184 OBJ_Is_In_Drivable_Area_V_19 1 "VALID" 0 "INVALID" ;
VAL_ 184 OBJ_Is_VeryClose_19 1 "TRUE" 0 "FALSE" ;
VAL_ 184 OBJ_Is_VeryClose_V_19 1 "VALID" 0 "INVALID" ;
VAL_ 183 OBJ_Triggered_SDM_19 2 "NOT_TRIGGERED" 1 "TRIGGERED" 0 "NOT_AVAILABLE" ;
VAL_ 183 OBJ_Motion_Category_19 13 "ONCOMING" 12 "PRECEEDING" 11 "MOVING" 10 "RTAP" 9 "LTAP" 8 "CROSSING" 7 "MOVING_OUT" 6 "MOVING_IN" 5 "CLOSE_CUT_IN" 4 "PASSING_OUT" 3 "PASSING_IN" 2 "PASSING" 1 "UNDEFINED" 0 "INVALID" ;
VAL_ 183 OBJ_Measuring_Status_19 2 "(BIT_2)NOT_VALID_OR_VALID" 1 "(BIT_1)PREDICTED_OR_MEASURED" 0 "(BIT_0)OLD_OR_NEW" ;
VAL_ 183 OBJ_Object_Class_19 8 "UNCERTAIN_VCL" 7 "ANIMAL" 6 "GENERAL_OBJECT" 5 "PEDESTRIAN" 4 "BICYCLE" 3 "MOTOR_BIKE" 2 "TRUCK" 1 "CAR" 0 "INVALID" ;
VAL_ 183 OBJ_Camera_Source_19 11 "PARKING_RIGHT" 10 "PARKING_LEFT" 9 "PARKING_REAR" 8 "PARKING_FRONT" 7 "FRONT_CORNER_RIGHT" 6 "FRONT_CORNER_LEFT" 5 "REAR_CORNER_RIGHT" 4 "REAR_CORNER_LEFT" 3 "REAR" 2 "FRONT_FISHEYE" 1 "FRONT_NARROW" 0 "FRONT_MAIN" ;
VAL_ 183 OBJ_Motion_Status_19 5 "MOVING_SLOWLY" 4 "STOPPED" 3 "STATIONARY" 2 "MOVING" 1 "UNKNOWN" 0 "INVALID" ;
VAL_ 183 OBJ_Motion_Orientation_19 13 "UNKNOWN" 12 "PRECEEDING" 11 "DRIFTING_LEFT" 9 "CROSSING_LEFT" 7 "OC_DRIFTING_LEFT" 6 "ONCOMING" 5 "OC_DRIFTING_RIGHT" 3 "CROSSING_RIGHT" 1 "DRIFTING_RIGHT" 0 "INVALID" ;
VAL_ 183 OBJ_Has_Cut_Lane_19 1 "TRUE" 0 "FALSE" ;
VAL_ 183 OBJ_Has_Cut_Path_19 1 "TRUE" 0 "FALSE" ;
VAL_ 183 OBJ_Brake_Light_19 1 "TRUE" 0 "FALSE" ;
VAL_ 183 OBJ_Turn_Indicator_Right_19 1 "TRUE" 0 "FALSE" ;
VAL_ 183 OBJ_Turn_Indicator_Left_19 1 "TRUE" 0 "FALSE" ;
VAL_ 183 OBJ_Light_Indicator_Validity_19 1 "TRUE" 0 "FALSE" ;
VAL_ 183 OBJ_Right_Out_Of_Image_19 1 "TRUE" 0 "FALSE" ;
VAL_ 183 OBJ_Left_Out_Of_Image_19 1 "TRUE" 0 "FALSE" ;
VAL_ 183 OBJ_Right_Out_Of_Image_V_19 1 "TRUE" 0 "FALSE" ;
VAL_ 183 OBJ_Left_Out_Of_Image_V_19 1 "TRUE" 0 "FALSE" ;
VAL_ 183 OBJ_Top_Out_Of_Image_19 1 "TRUE" 0 "FALSE" ;
VAL_ 183 OBJ_Bottom_Out_Of_Image_19 1 "TRUE" 0 "FALSE" ;
VAL_ 183 OBJ_Top_Out_Of_Image_V_19 1 "VALID" 0 "INVALID" ;
VAL_ 183 OBJ_Bottom_Out_Of_Image_V_19 1 "VALID" 0 "INVALID" ;
VAL_ 183 OBJ_Lane_Assignment_19 5 "RIGHT_RIGHT" 4 "RIGHT" 3 "HOST" 2 "LEFT" 1 "LEFT_LEFT" 0 "UNKNOWN" ;
VAL_ 183 OBJ_Lane_Assignment_V_19 1 "VALID" 0 "INVALID" ;
VAL_ 183 OBJ_Age_Seconds_V_19 1 "VALID" 0 "INVALID" ;
VAL_ 183 OBJ_Width_V_19 1 "VALID" 0 "INVALID" ;
VAL_ 183 OBJ_Width_STD_V_19 1 "VALID" 0 "INVALID" ;
VAL_ 183 OBJ_Length_V_19 1 "VALID" 0 "INVALID" ;
VAL_ 183 OBJ_Length_STD_V_19 1 "VALID" 0 "INVALID" ;
VAL_ 183 OBJ_Height_V_19 1 "VALID" 0 "INVALID" ;
VAL_ 183 OBJ_Height_STD_V_19 1 "VALID" 0 "INVALID" ;
VAL_ 183 OBJ_Abs_Long_Velocity_V_19 1 "VALID" 0 "INVALID" ;
VAL_ 183 OBJ_Abs_Long_Vel_STD_V_19 1 "VALID" 0 "INVALID" ;
VAL_ 183 OBJ_Abs_Lat_Velocity_V_19 1 "VALID" 0 "INVALID" ;
VAL_ 183 OBJ_Abs_Lat_Vel_STD_V_19 1 "VALID" 0 "INVALID" ;
VAL_ 183 OBJ_Abs_Long_Acc_V_19 1 "VALID" 0 "INVALID" ;
VAL_ 183 OBJ_Abs_Long_Acc_STD_V_19 1 "VALID" 0 "INVALID" ;
VAL_ 183 OBJ_Abs_Lat_Acc_V_19 1 "VALID" 0 "INVALID" ;
VAL_ 183 OBJ_Abs_Lat_Acc_STD_V_19 1 "VALID" 0 "INVALID" ;
VAL_ 183 OBJ_Abs_Acceleration_V_19 1 "VALID" 0 "INVALID" ;
VAL_ 183 OBJ_Abs_Acc_STD_V_19 1 "VALID" 0 "INVALID" ;
VAL_ 183 OBJ_Inv_TTC_V_19 1 "VALID" 0 "INVALID" ;
VAL_ 183 OBJ_Inv_TTC_STD_V_19 1 "VALID" 0 "INVALID" ;
VAL_ 183 OBJ_Relative_Long_Acc_V_19 1 "VALID" 0 "INVALID" ;
VAL_ 183 OBJ_Rel_Long_Acc_STD_V_19 1 "VALID" 0 "INVALID" ;
VAL_ 182 OBJ_Relative_Long_Velocity_V_18 1 "VALID" 0 "INVALID" ;
VAL_ 182 OBJ_Rel_Long_Vel_STD_V_18 1 "VALID" 0 "INVALID" ;
VAL_ 182 OBJ_Relative_Lat_Velocity_V_18 1 "VALID" 0 "INVALID" ;
VAL_ 182 OBJ_Rel_Lat_Vel_STD_V_18 1 "VALID" 0 "INVALID" ;
VAL_ 182 OBJ_Long_Distance_V_18 1 "VALID" 0 "INVALID" ;
VAL_ 182 OBJ_Long_Distance_STD_V_18 1 "VALID" 0 "INVALID" ;
VAL_ 182 OBJ_Lat_Distance_V_18 1 "VALID" 0 "INVALID" ;
VAL_ 182 OBJ_Lat_Distance_STD_V_18 1 "VALID" 0 "INVALID" ;
VAL_ 182 OBJ_Absolute_Speed_V_18 1 "VALID" 0 "INVALID" ;
VAL_ 182 OBJ_Absolute_Speed_STD_V_18 1 "VALID" 0 "INVALID" ;
VAL_ 182 OBJ_Heading_V_18 1 "VALID" 0 "INVALID" ;
VAL_ 182 OBJ_Heading_STD_V_18 1 "VALID" 0 "INVALID" ;
VAL_ 182 OBJ_Angle_Rate_STD_V_18 1 "VALID" 0 "INVALID" ;
VAL_ 182 OBJ_Angle_Rate_V_18 1 "VALID" 0 "INVALID" ;
VAL_ 182 OBJ_Angle_Right_V_18 1 "VALID" 0 "INVALID" ;
VAL_ 182 OBJ_Angle_Right_STD_V_18 1 "VALID" 0 "INVALID" ;
VAL_ 182 OBJ_Angle_Left_V_18 1 "VALID" 0 "INVALID" ;
VAL_ 182 OBJ_Angle_Left_STD_V_18 1 "VALID" 0 "INVALID" ;
VAL_ 182 OBJ_Angle_Side_V_18 1 "VALID" 0 "INVALID" ;
VAL_ 182 OBJ_Angle_Side_STD_V_18 1 "VALID" 0 "INVALID" ;
VAL_ 182 OBJ_Angle_Mid_V_18 1 "VALID" 0 "INVALID" ;
VAL_ 182 OBJ_Angle_Mid_STD_V_18 1 "VALID" 0 "INVALID" ;
VAL_ 182 OBJ_Angle_Bottom_V_18 1 "VALID" 0 "INVALID" ;
VAL_ 182 OBJ_Angle_Bottom_STD_V_18 1 "VALID" 0 "INVALID" ;
VAL_ 182 OBJ_Visibility_Side_V_18 1 "VALID" 0 "INVALID" ;
VAL_ 182 OBJ_Visibility_Side_18 2 "REAR" 1 "FRONT" 0 "NOT_VISIBLE" ;
VAL_ 182 OBJ_Is_In_Drivable_Area_18 1 "TRUE" 0 "FALSE" ;
VAL_ 182 OBJ_Is_In_Drivable_Area_V_18 1 "VALID" 0 "INVALID" ;
VAL_ 182 OBJ_Is_VeryClose_18 1 "TRUE" 0 "FALSE" ;
VAL_ 182 OBJ_Is_VeryClose_V_18 1 "VALID" 0 "INVALID" ;
VAL_ 181 OBJ_Triggered_SDM_18 2 "NOT_TRIGGERED" 1 "TRIGGERED" 0 "NOT_AVAILABLE" ;
VAL_ 181 OBJ_Motion_Category_18 13 "ONCOMING" 12 "PRECEEDING" 11 "MOVING" 10 "RTAP" 9 "LTAP" 8 "CROSSING" 7 "MOVING_OUT" 6 "MOVING_IN" 5 "CLOSE_CUT_IN" 4 "PASSING_OUT" 3 "PASSING_IN" 2 "PASSING" 1 "UNDEFINED" 0 "INVALID" ;
VAL_ 181 OBJ_Measuring_Status_18 2 "(BIT_2)NOT_VALID_OR_VALID" 1 "(BIT_1)PREDICTED_OR_MEASURED" 0 "(BIT_0)OLD_OR_NEW" ;
VAL_ 181 OBJ_Object_Class_18 8 "UNCERTAIN_VCL" 7 "ANIMAL" 6 "GENERAL_OBJECT" 5 "PEDESTRIAN" 4 "BICYCLE" 3 "MOTOR_BIKE" 2 "TRUCK" 1 "CAR" 0 "INVALID" ;
VAL_ 181 OBJ_Camera_Source_18 11 "PARKING_RIGHT" 10 "PARKING_LEFT" 9 "PARKING_REAR" 8 "PARKING_FRONT" 7 "FRONT_CORNER_RIGHT" 6 "FRONT_CORNER_LEFT" 5 "REAR_CORNER_RIGHT" 4 "REAR_CORNER_LEFT" 3 "REAR" 2 "FRONT_FISHEYE" 1 "FRONT_NARROW" 0 "FRONT_MAIN" ;
VAL_ 181 OBJ_Motion_Status_18 5 "MOVING_SLOWLY" 4 "STOPPED" 3 "STATIONARY" 2 "MOVING" 1 "UNKNOWN" 0 "INVALID" ;
VAL_ 181 OBJ_Motion_Orientation_18 13 "UNKNOWN" 12 "PRECEEDING" 11 "DRIFTING_LEFT" 9 "CROSSING_LEFT" 7 "OC_DRIFTING_LEFT" 6 "ONCOMING" 5 "OC_DRIFTING_RIGHT" 3 "CROSSING_RIGHT" 1 "DRIFTING_RIGHT" 0 "INVALID" ;
VAL_ 181 OBJ_Has_Cut_Lane_18 1 "TRUE" 0 "FALSE" ;
VAL_ 181 OBJ_Has_Cut_Path_18 1 "TRUE" 0 "FALSE" ;
VAL_ 181 OBJ_Brake_Light_18 1 "TRUE" 0 "FALSE" ;
VAL_ 181 OBJ_Turn_Indicator_Right_18 1 "TRUE" 0 "FALSE" ;
VAL_ 181 OBJ_Turn_Indicator_Left_18 1 "TRUE" 0 "FALSE" ;
VAL_ 181 OBJ_Light_Indicator_Validity_18 1 "TRUE" 0 "FALSE" ;
VAL_ 181 OBJ_Right_Out_Of_Image_18 1 "TRUE" 0 "FALSE" ;
VAL_ 181 OBJ_Left_Out_Of_Image_18 1 "TRUE" 0 "FALSE" ;
VAL_ 181 OBJ_Right_Out_Of_Image_V_18 1 "TRUE" 0 "FALSE" ;
VAL_ 181 OBJ_Left_Out_Of_Image_V_18 1 "TRUE" 0 "FALSE" ;
VAL_ 181 OBJ_Top_Out_Of_Image_18 1 "TRUE" 0 "FALSE" ;
VAL_ 181 OBJ_Bottom_Out_Of_Image_18 1 "TRUE" 0 "FALSE" ;
VAL_ 181 OBJ_Top_Out_Of_Image_V_18 1 "VALID" 0 "INVALID" ;
VAL_ 181 OBJ_Bottom_Out_Of_Image_V_18 1 "VALID" 0 "INVALID" ;
VAL_ 181 OBJ_Lane_Assignment_18 5 "RIGHT_RIGHT" 4 "RIGHT" 3 "HOST" 2 "LEFT" 1 "LEFT_LEFT" 0 "UNKNOWN" ;
VAL_ 181 OBJ_Lane_Assignment_V_18 1 "VALID" 0 "INVALID" ;
VAL_ 181 OBJ_Age_Seconds_V_18 1 "VALID" 0 "INVALID" ;
VAL_ 181 OBJ_Width_V_18 1 "VALID" 0 "INVALID" ;
VAL_ 181 OBJ_Width_STD_V_18 1 "VALID" 0 "INVALID" ;
VAL_ 181 OBJ_Length_V_18 1 "VALID" 0 "INVALID" ;
VAL_ 181 OBJ_Length_STD_V_18 1 "VALID" 0 "INVALID" ;
VAL_ 181 OBJ_Height_V_18 1 "VALID" 0 "INVALID" ;
VAL_ 181 OBJ_Height_STD_V_18 1 "VALID" 0 "INVALID" ;
VAL_ 181 OBJ_Abs_Long_Velocity_V_18 1 "VALID" 0 "INVALID" ;
VAL_ 181 OBJ_Abs_Long_Vel_STD_V_18 1 "VALID" 0 "INVALID" ;
VAL_ 181 OBJ_Abs_Lat_Velocity_V_18 1 "VALID" 0 "INVALID" ;
VAL_ 181 OBJ_Abs_Lat_Vel_STD_V_18 1 "VALID" 0 "INVALID" ;
VAL_ 181 OBJ_Abs_Long_Acc_V_18 1 "VALID" 0 "INVALID" ;
VAL_ 181 OBJ_Abs_Long_Acc_STD_V_18 1 "VALID" 0 "INVALID" ;
VAL_ 181 OBJ_Abs_Lat_Acc_V_18 1 "VALID" 0 "INVALID" ;
VAL_ 181 OBJ_Abs_Lat_Acc_STD_V_18 1 "VALID" 0 "INVALID" ;
VAL_ 181 OBJ_Abs_Acceleration_V_18 1 "VALID" 0 "INVALID" ;
VAL_ 181 OBJ_Abs_Acc_STD_V_18 1 "VALID" 0 "INVALID" ;
VAL_ 181 OBJ_Inv_TTC_V_18 1 "VALID" 0 "INVALID" ;
VAL_ 181 OBJ_Inv_TTC_STD_V_18 1 "VALID" 0 "INVALID" ;
VAL_ 181 OBJ_Relative_Long_Acc_V_18 1 "VALID" 0 "INVALID" ;
VAL_ 181 OBJ_Rel_Long_Acc_STD_V_18 1 "VALID" 0 "INVALID" ;
VAL_ 180 OBJ_Relative_Long_Velocity_V_17 1 "VALID" 0 "INVALID" ;
VAL_ 180 OBJ_Rel_Long_Vel_STD_V_17 1 "VALID" 0 "INVALID" ;
VAL_ 180 OBJ_Relative_Lat_Velocity_V_17 1 "VALID" 0 "INVALID" ;
VAL_ 180 OBJ_Rel_Lat_Vel_STD_V_17 1 "VALID" 0 "INVALID" ;
VAL_ 180 OBJ_Long_Distance_V_17 1 "VALID" 0 "INVALID" ;
VAL_ 180 OBJ_Long_Distance_STD_V_17 1 "VALID" 0 "INVALID" ;
VAL_ 180 OBJ_Lat_Distance_V_17 1 "VALID" 0 "INVALID" ;
VAL_ 180 OBJ_Lat_Distance_STD_V_17 1 "VALID" 0 "INVALID" ;
VAL_ 180 OBJ_Absolute_Speed_V_17 1 "VALID" 0 "INVALID" ;
VAL_ 180 OBJ_Absolute_Speed_STD_V_17 1 "VALID" 0 "INVALID" ;
VAL_ 180 OBJ_Heading_V_17 1 "VALID" 0 "INVALID" ;
VAL_ 180 OBJ_Heading_STD_V_17 1 "VALID" 0 "INVALID" ;
VAL_ 180 OBJ_Angle_Rate_STD_V_17 1 "VALID" 0 "INVALID" ;
VAL_ 180 OBJ_Angle_Rate_V_17 1 "VALID" 0 "INVALID" ;
VAL_ 180 OBJ_Angle_Right_V_17 1 "VALID" 0 "INVALID" ;
VAL_ 180 OBJ_Angle_Right_STD_V_17 1 "VALID" 0 "INVALID" ;
VAL_ 180 OBJ_Angle_Left_V_17 1 "VALID" 0 "INVALID" ;
VAL_ 180 OBJ_Angle_Left_STD_V_17 1 "VALID" 0 "INVALID" ;
VAL_ 180 OBJ_Angle_Side_V_17 1 "VALID" 0 "INVALID" ;
VAL_ 180 OBJ_Angle_Side_STD_V_17 1 "VALID" 0 "INVALID" ;
VAL_ 180 OBJ_Angle_Mid_V_17 1 "VALID" 0 "INVALID" ;
VAL_ 180 OBJ_Angle_Mid_STD_V_17 1 "VALID" 0 "INVALID" ;
VAL_ 180 OBJ_Angle_Bottom_V_17 1 "VALID" 0 "INVALID" ;
VAL_ 180 OBJ_Angle_Bottom_STD_V_17 1 "VALID" 0 "INVALID" ;
VAL_ 180 OBJ_Visibility_Side_V_17 1 "VALID" 0 "INVALID" ;
VAL_ 180 OBJ_Visibility_Side_17 2 "REAR" 1 "FRONT" 0 "NOT_VISIBLE" ;
VAL_ 180 OBJ_Is_In_Drivable_Area_17 1 "TRUE" 0 "FALSE" ;
VAL_ 180 OBJ_Is_In_Drivable_Area_V_17 1 "VALID" 0 "INVALID" ;
VAL_ 180 OBJ_Is_VeryClose_17 1 "TRUE" 0 "FALSE" ;
VAL_ 180 OBJ_Is_VeryClose_V_17 1 "VALID" 0 "INVALID" ;
VAL_ 179 OBJ_Triggered_SDM_17 2 "NOT_TRIGGERED" 1 "TRIGGERED" 0 "NOT_AVAILABLE" ;
VAL_ 179 OBJ_Motion_Category_17 13 "ONCOMING" 12 "PRECEEDING" 11 "MOVING" 10 "RTAP" 9 "LTAP" 8 "CROSSING" 7 "MOVING_OUT" 6 "MOVING_IN" 5 "CLOSE_CUT_IN" 4 "PASSING_OUT" 3 "PASSING_IN" 2 "PASSING" 1 "UNDEFINED" 0 "INVALID" ;
VAL_ 179 OBJ_Measuring_Status_17 2 "(BIT_2)NOT_VALID_OR_VALID" 1 "(BIT_1)PREDICTED_OR_MEASURED" 0 "(BIT_0)OLD_OR_NEW" ;
VAL_ 179 OBJ_Object_Class_17 8 "UNCERTAIN_VCL" 7 "ANIMAL" 6 "GENERAL_OBJECT" 5 "PEDESTRIAN" 4 "BICYCLE" 3 "MOTOR_BIKE" 2 "TRUCK" 1 "CAR" 0 "INVALID" ;
VAL_ 179 OBJ_Camera_Source_17 11 "PARKING_RIGHT" 10 "PARKING_LEFT" 9 "PARKING_REAR" 8 "PARKING_FRONT" 7 "FRONT_CORNER_RIGHT" 6 "FRONT_CORNER_LEFT" 5 "REAR_CORNER_RIGHT" 4 "REAR_CORNER_LEFT" 3 "REAR" 2 "FRONT_FISHEYE" 1 "FRONT_NARROW" 0 "FRONT_MAIN" ;
VAL_ 179 OBJ_Motion_Status_17 5 "MOVING_SLOWLY" 4 "STOPPED" 3 "STATIONARY" 2 "MOVING" 1 "UNKNOWN" 0 "INVALID" ;
VAL_ 179 OBJ_Motion_Orientation_17 13 "UNKNOWN" 12 "PRECEEDING" 11 "DRIFTING_LEFT" 9 "CROSSING_LEFT" 7 "OC_DRIFTING_LEFT" 6 "ONCOMING" 5 "OC_DRIFTING_RIGHT" 3 "CROSSING_RIGHT" 1 "DRIFTING_RIGHT" 0 "INVALID" ;
VAL_ 179 OBJ_Has_Cut_Lane_17 1 "TRUE" 0 "FALSE" ;
VAL_ 179 OBJ_Has_Cut_Path_17 1 "TRUE" 0 "FALSE" ;
VAL_ 179 OBJ_Brake_Light_17 1 "TRUE" 0 "FALSE" ;
VAL_ 179 OBJ_Turn_Indicator_Right_17 1 "TRUE" 0 "FALSE" ;
VAL_ 179 OBJ_Turn_Indicator_Left_17 1 "TRUE" 0 "FALSE" ;
VAL_ 179 OBJ_Light_Indicator_Validity_17 1 "TRUE" 0 "FALSE" ;
VAL_ 179 OBJ_Right_Out_Of_Image_17 1 "TRUE" 0 "FALSE" ;
VAL_ 179 OBJ_Left_Out_Of_Image_17 1 "TRUE" 0 "FALSE" ;
VAL_ 179 OBJ_Right_Out_Of_Image_V_17 1 "TRUE" 0 "FALSE" ;
VAL_ 179 OBJ_Left_Out_Of_Image_V_17 1 "TRUE" 0 "FALSE" ;
VAL_ 179 OBJ_Top_Out_Of_Image_17 1 "TRUE" 0 "FALSE" ;
VAL_ 179 OBJ_Bottom_Out_Of_Image_17 1 "TRUE" 0 "FALSE" ;
VAL_ 179 OBJ_Top_Out_Of_Image_V_17 1 "VALID" 0 "INVALID" ;
VAL_ 179 OBJ_Bottom_Out_Of_Image_V_17 1 "VALID" 0 "INVALID" ;
VAL_ 179 OBJ_Lane_Assignment_17 5 "RIGHT_RIGHT" 4 "RIGHT" 3 "HOST" 2 "LEFT" 1 "LEFT_LEFT" 0 "UNKNOWN" ;
VAL_ 179 OBJ_Lane_Assignment_V_17 1 "VALID" 0 "INVALID" ;
VAL_ 179 OBJ_Age_Seconds_V_17 1 "VALID" 0 "INVALID" ;
VAL_ 179 OBJ_Width_V_17 1 "VALID" 0 "INVALID" ;
VAL_ 179 OBJ_Width_STD_V_17 1 "VALID" 0 "INVALID" ;
VAL_ 179 OBJ_Length_V_17 1 "VALID" 0 "INVALID" ;
VAL_ 179 OBJ_Length_STD_V_17 1 "VALID" 0 "INVALID" ;
VAL_ 179 OBJ_Height_V_17 1 "VALID" 0 "INVALID" ;
VAL_ 179 OBJ_Height_STD_V_17 1 "VALID" 0 "INVALID" ;
VAL_ 179 OBJ_Abs_Long_Velocity_V_17 1 "VALID" 0 "INVALID" ;
VAL_ 179 OBJ_Abs_Long_Vel_STD_V_17 1 "VALID" 0 "INVALID" ;
VAL_ 179 OBJ_Abs_Lat_Velocity_V_17 1 "VALID" 0 "INVALID" ;
VAL_ 179 OBJ_Abs_Lat_Vel_STD_V_17 1 "VALID" 0 "INVALID" ;
VAL_ 179 OBJ_Abs_Long_Acc_V_17 1 "VALID" 0 "INVALID" ;
VAL_ 179 OBJ_Abs_Long_Acc_STD_V_17 1 "VALID" 0 "INVALID" ;
VAL_ 179 OBJ_Abs_Lat_Acc_V_17 1 "VALID" 0 "INVALID" ;
VAL_ 179 OBJ_Abs_Lat_Acc_STD_V_17 1 "VALID" 0 "INVALID" ;
VAL_ 179 OBJ_Abs_Acceleration_V_17 1 "VALID" 0 "INVALID" ;
VAL_ 179 OBJ_Abs_Acc_STD_V_17 1 "VALID" 0 "INVALID" ;
VAL_ 179 OBJ_Inv_TTC_V_17 1 "VALID" 0 "INVALID" ;
VAL_ 179 OBJ_Inv_TTC_STD_V_17 1 "VALID" 0 "INVALID" ;
VAL_ 179 OBJ_Relative_Long_Acc_V_17 1 "VALID" 0 "INVALID" ;
VAL_ 179 OBJ_Rel_Long_Acc_STD_V_17 1 "VALID" 0 "INVALID" ;
VAL_ 178 OBJ_Relative_Long_Velocity_V_16 1 "VALID" 0 "INVALID" ;
VAL_ 178 OBJ_Rel_Long_Vel_STD_V_16 1 "VALID" 0 "INVALID" ;
VAL_ 178 OBJ_Relative_Lat_Velocity_V_16 1 "VALID" 0 "INVALID" ;
VAL_ 178 OBJ_Rel_Lat_Vel_STD_V_16 1 "VALID" 0 "INVALID" ;
VAL_ 178 OBJ_Long_Distance_V_16 1 "VALID" 0 "INVALID" ;
VAL_ 178 OBJ_Long_Distance_STD_V_16 1 "VALID" 0 "INVALID" ;
VAL_ 178 OBJ_Lat_Distance_V_16 1 "VALID" 0 "INVALID" ;
VAL_ 178 OBJ_Lat_Distance_STD_V_16 1 "VALID" 0 "INVALID" ;
VAL_ 178 OBJ_Absolute_Speed_V_16 1 "VALID" 0 "INVALID" ;
VAL_ 178 OBJ_Absolute_Speed_STD_V_16 1 "VALID" 0 "INVALID" ;
VAL_ 178 OBJ_Heading_V_16 1 "VALID" 0 "INVALID" ;
VAL_ 178 OBJ_Heading_STD_V_16 1 "VALID" 0 "INVALID" ;
VAL_ 178 OBJ_Angle_Rate_STD_V_16 1 "VALID" 0 "INVALID" ;
VAL_ 178 OBJ_Angle_Rate_V_16 1 "VALID" 0 "INVALID" ;
VAL_ 178 OBJ_Angle_Right_V_16 1 "VALID" 0 "INVALID" ;
VAL_ 178 OBJ_Angle_Right_STD_V_16 1 "VALID" 0 "INVALID" ;
VAL_ 178 OBJ_Angle_Left_V_16 1 "VALID" 0 "INVALID" ;
VAL_ 178 OBJ_Angle_Left_STD_V_16 1 "VALID" 0 "INVALID" ;
VAL_ 178 OBJ_Angle_Side_V_16 1 "VALID" 0 "INVALID" ;
VAL_ 178 OBJ_Angle_Side_STD_V_16 1 "VALID" 0 "INVALID" ;
VAL_ 178 OBJ_Angle_Mid_V_16 1 "VALID" 0 "INVALID" ;
VAL_ 178 OBJ_Angle_Mid_STD_V_16 1 "VALID" 0 "INVALID" ;
VAL_ 178 OBJ_Angle_Bottom_V_16 1 "VALID" 0 "INVALID" ;
VAL_ 178 OBJ_Angle_Bottom_STD_V_16 1 "VALID" 0 "INVALID" ;
VAL_ 178 OBJ_Visibility_Side_V_16 1 "VALID" 0 "INVALID" ;
VAL_ 178 OBJ_Visibility_Side_16 2 "REAR" 1 "FRONT" 0 "NOT_VISIBLE" ;
VAL_ 178 OBJ_Is_In_Drivable_Area_16 1 "TRUE" 0 "FALSE" ;
VAL_ 178 OBJ_Is_In_Drivable_Area_V_16 1 "VALID" 0 "INVALID" ;
VAL_ 178 OBJ_Is_VeryClose_16 1 "TRUE" 0 "FALSE" ;
VAL_ 178 OBJ_Is_VeryClose_V_16 1 "VALID" 0 "INVALID" ;
VAL_ 177 OBJ_Triggered_SDM_16 2 "NOT_TRIGGERED" 1 "TRIGGERED" 0 "NOT_AVAILABLE" ;
VAL_ 177 OBJ_Motion_Category_16 13 "ONCOMING" 12 "PRECEEDING" 11 "MOVING" 10 "RTAP" 9 "LTAP" 8 "CROSSING" 7 "MOVING_OUT" 6 "MOVING_IN" 5 "CLOSE_CUT_IN" 4 "PASSING_OUT" 3 "PASSING_IN" 2 "PASSING" 1 "UNDEFINED" 0 "INVALID" ;
VAL_ 177 OBJ_Measuring_Status_16 2 "(BIT_2)NOT_VALID_OR_VALID" 1 "(BIT_1)PREDICTED_OR_MEASURED" 0 "(BIT_0)OLD_OR_NEW" ;
VAL_ 177 OBJ_Object_Class_16 8 "UNCERTAIN_VCL" 7 "ANIMAL" 6 "GENERAL_OBJECT" 5 "PEDESTRIAN" 4 "BICYCLE" 3 "MOTOR_BIKE" 2 "TRUCK" 1 "CAR" 0 "INVALID" ;
VAL_ 177 OBJ_Camera_Source_16 11 "PARKING_RIGHT" 10 "PARKING_LEFT" 9 "PARKING_REAR" 8 "PARKING_FRONT" 7 "FRONT_CORNER_RIGHT" 6 "FRONT_CORNER_LEFT" 5 "REAR_CORNER_RIGHT" 4 "REAR_CORNER_LEFT" 3 "REAR" 2 "FRONT_FISHEYE" 1 "FRONT_NARROW" 0 "FRONT_MAIN" ;
VAL_ 177 OBJ_Motion_Status_16 5 "MOVING_SLOWLY" 4 "STOPPED" 3 "STATIONARY" 2 "MOVING" 1 "UNKNOWN" 0 "INVALID" ;
VAL_ 177 OBJ_Motion_Orientation_16 13 "UNKNOWN" 12 "PRECEEDING" 11 "DRIFTING_LEFT" 9 "CROSSING_LEFT" 7 "OC_DRIFTING_LEFT" 6 "ONCOMING" 5 "OC_DRIFTING_RIGHT" 3 "CROSSING_RIGHT" 1 "DRIFTING_RIGHT" 0 "INVALID" ;
VAL_ 177 OBJ_Has_Cut_Lane_16 1 "TRUE" 0 "FALSE" ;
VAL_ 177 OBJ_Has_Cut_Path_16 1 "TRUE" 0 "FALSE" ;
VAL_ 177 OBJ_Brake_Light_16 1 "TRUE" 0 "FALSE" ;
VAL_ 177 OBJ_Turn_Indicator_Right_16 1 "TRUE" 0 "FALSE" ;
VAL_ 177 OBJ_Turn_Indicator_Left_16 1 "TRUE" 0 "FALSE" ;
VAL_ 177 OBJ_Light_Indicator_Validity_16 1 "TRUE" 0 "FALSE" ;
VAL_ 177 OBJ_Right_Out_Of_Image_16 1 "TRUE" 0 "FALSE" ;
VAL_ 177 OBJ_Left_Out_Of_Image_16 1 "TRUE" 0 "FALSE" ;
VAL_ 177 OBJ_Right_Out_Of_Image_V_16 1 "TRUE" 0 "FALSE" ;
VAL_ 177 OBJ_Left_Out_Of_Image_V_16 1 "TRUE" 0 "FALSE" ;
VAL_ 177 OBJ_Top_Out_Of_Image_16 1 "TRUE" 0 "FALSE" ;
VAL_ 177 OBJ_Bottom_Out_Of_Image_16 1 "TRUE" 0 "FALSE" ;
VAL_ 177 OBJ_Top_Out_Of_Image_V_16 1 "VALID" 0 "INVALID" ;
VAL_ 177 OBJ_Bottom_Out_Of_Image_V_16 1 "VALID" 0 "INVALID" ;
VAL_ 177 OBJ_Lane_Assignment_16 5 "RIGHT_RIGHT" 4 "RIGHT" 3 "HOST" 2 "LEFT" 1 "LEFT_LEFT" 0 "UNKNOWN" ;
VAL_ 177 OBJ_Lane_Assignment_V_16 1 "VALID" 0 "INVALID" ;
VAL_ 177 OBJ_Age_Seconds_V_16 1 "VALID" 0 "INVALID" ;
VAL_ 177 OBJ_Width_V_16 1 "VALID" 0 "INVALID" ;
VAL_ 177 OBJ_Width_STD_V_16 1 "VALID" 0 "INVALID" ;
VAL_ 177 OBJ_Length_V_16 1 "VALID" 0 "INVALID" ;
VAL_ 177 OBJ_Length_STD_V_16 1 "VALID" 0 "INVALID" ;
VAL_ 177 OBJ_Height_V_16 1 "VALID" 0 "INVALID" ;
VAL_ 177 OBJ_Height_STD_V_16 1 "VALID" 0 "INVALID" ;
VAL_ 177 OBJ_Abs_Long_Velocity_V_16 1 "VALID" 0 "INVALID" ;
VAL_ 177 OBJ_Abs_Long_Vel_STD_V_16 1 "VALID" 0 "INVALID" ;
VAL_ 177 OBJ_Abs_Lat_Velocity_V_16 1 "VALID" 0 "INVALID" ;
VAL_ 177 OBJ_Abs_Lat_Vel_STD_V_16 1 "VALID" 0 "INVALID" ;
VAL_ 177 OBJ_Abs_Long_Acc_V_16 1 "VALID" 0 "INVALID" ;
VAL_ 177 OBJ_Abs_Long_Acc_STD_V_16 1 "VALID" 0 "INVALID" ;
VAL_ 177 OBJ_Abs_Lat_Acc_V_16 1 "VALID" 0 "INVALID" ;
VAL_ 177 OBJ_Abs_Lat_Acc_STD_V_16 1 "VALID" 0 "INVALID" ;
VAL_ 177 OBJ_Abs_Acceleration_V_16 1 "VALID" 0 "INVALID" ;
VAL_ 177 OBJ_Abs_Acc_STD_V_16 1 "VALID" 0 "INVALID" ;
VAL_ 177 OBJ_Inv_TTC_V_16 1 "VALID" 0 "INVALID" ;
VAL_ 177 OBJ_Inv_TTC_STD_V_16 1 "VALID" 0 "INVALID" ;
VAL_ 177 OBJ_Relative_Long_Acc_V_16 1 "VALID" 0 "INVALID" ;
VAL_ 177 OBJ_Rel_Long_Acc_STD_V_16 1 "VALID" 0 "INVALID" ;
SIG_GROUP_ 196 ICM_Object_Prot25_B 1 : OBJ_Buffer_25 OBJ_Is_VeryClose_V_25 OBJ_Is_VeryClose_25 OBJ_Is_In_Drivable_Area_V_25 OBJ_Is_In_Drivable_Area_25 OBJ_Visibility_Side_25 OBJ_Visibility_Side_V_25 OBJ_Angle_Bottom_STD_V_25 OBJ_Angle_Bottom_STD_25 OBJ_Angle_Bottom_25 OBJ_Angle_Bottom_V_25 OBJ_Angle_Mid_STD_V_25 OBJ_Angle_Mid_STD_25 OBJ_Angle_Mid_25 OBJ_Angle_Mid_V_25 OBJ_Angle_Side_STD_V_25 OBJ_Angle_Side_STD_25 OBJ_Angle_Side_V_25 OBJ_Angle_Side_25 OBJ_Angle_Left_STD_V_25 OBJ_Angle_Left_STD_25 OBJ_Angle_Left_V_25 OBJ_Angle_Left_25 OBJ_Angle_Right_STD_V_25 OBJ_Angle_Right_STD_25 OBJ_Angle_Right_V_25 OBJ_Angle_Right_25 OBJ_Angle_Rate_V_25 OBJ_Angle_Rate_25 OBJ_Angle_Rate_STD_V_25 OBJ_Angle_Rate_STD_25 OBJ_Heading_STD_V_25 OBJ_Heading_STD_25 OBJ_Heading_V_25 OBJ_Heading_25 OBJ_Absolute_Speed_STD_V_25 OBJ_Absolute_Speed_STD_25 OBJ_Absolute_Speed_V_25 OBJ_Absolute_Speed_25 OBJ_Lat_Distance_STD_V_25 OBJ_Lat_Distance_STD_25 OBJ_Lat_Distance_V_25 OBJ_Lat_Distance_25 OBJ_Long_Distance_STD_V_25 OBJ_Long_Distance_STD_25 OBJ_Long_Distance_V_25 OBJ_Long_Distance_25 OBJ_Rel_Lat_Vel_STD_V_25 OBJ_Relative_Lat_Velocity_STD_25 OBJ_Relative_Lat_Velocity_V_25 OBJ_Relative_Lat_Velocity_25 OBJ_Rel_Long_Vel_STD_V_25 OBJ_Relative_Long_Vel_STD_25 OBJ_Relative_Long_Velocity_V_25 OBJ_Relative_Long_Velocity_25 ICM_Object_Prot25_B_Header;
SIG_GROUP_ 195 ICM_Object_Prot25_A 1 : OBJ_Rel_Long_Acc_STD_V_25 OBJ_Relative_Long_Acc_STD_25 OBJ_Relative_Long_Acc_V_25 OBJ_Relative_Long_Acc_25 OBJ_Inv_TTC_STD_V_25 OBJ_Inv_TTC_STD_25 OBJ_Inv_TTC_V_25 OBJ_Inv_TTC_25 OBJ_Abs_Acc_STD_V_25 OBJ_Abs_Acc_STD_25 OBJ_Abs_Acceleration_V_25 OBJ_Abs_Acceleration_25 OBJ_Abs_Lat_Acc_STD_V_25 OBJ_Abs_Lat_Acc_STD_25 OBJ_Abs_Lat_Acc_V_25 OBJ_Abs_Lat_Acc_25 OBJ_Abs_Long_Acc_STD_V_25 OBJ_Abs_Long_Acc_STD_25 OBJ_Abs_Long_Acc_V_25 OBJ_Abs_Long_Acc_25 OBJ_Abs_Lat_Vel_STD_V_25 OBJ_Abs_Lat_Velocity_STD_25 OBJ_Abs_Lat_Velocity_V_25 OBJ_Abs_Lat_Velocity_25 OBJ_Abs_Long_Vel_STD_V_25 OBJ_Abs_Long_Velocity_STD_25 OBJ_Abs_Long_Velocity_V_25 OBJ_Abs_Long_Velocity_25 OBJ_Height_STD_V_25 OBJ_Height_STD_25 OBJ_Height_V_25 OBJ_Height_25 OBJ_Length_STD_V_25 OBJ_Length_STD_25 OBJ_Length_V_25 OBJ_Length_25 OBJ_Width_STD_V_25 OBJ_Width_STD_25 OBJ_Width_V_25 OBJ_Width_25 OBJ_Age_Seconds_V_25 OBJ_Age_Seconds_25 OBJ_Lane_Assignment_V_25 OBJ_Lane_Assignment_25 OBJ_Bottom_Out_Of_Image_V_25 OBJ_Top_Out_Of_Image_V_25 OBJ_Bottom_Out_Of_Image_25 OBJ_Top_Out_Of_Image_25 OBJ_Left_Out_Of_Image_V_25 OBJ_Right_Out_Of_Image_V_25 OBJ_Left_Out_Of_Image_25 OBJ_Right_Out_Of_Image_25 OBJ_Light_Indicator_Validity_25 OBJ_Turn_Indicator_Left_25 OBJ_Turn_Indicator_Right_25 OBJ_Brake_Light_25 OBJ_Has_Cut_Path_25 OBJ_Has_Cut_Lane_25 OBJ_Motion_Orientation_25 OBJ_Motion_Status_25 OBJ_Camera_Source_25 OBJ_Bike_Probability_25 OBJ_Truck_Probability_25 OBJ_Car_Probability_25 OBJ_Class_Probability_25 OBJ_Object_Class_25 OBJ_Measuring_Status_25 OBJ_Object_Age_25 OBJ_Moving_IN_Probability_25 OBJ_Motion_Category_25 OBJ_Triggered_SDM_25 OBJ_Fusion_Source_25 OBJ_Existence_Probability_25 OBJ_ID_25 OBJ_CRC_25 ICM_Object_Prot25_A_Header;
SIG_GROUP_ 194 ICM_Object_Prot24_B 1 : OBJ_Buffer_24 OBJ_Is_VeryClose_V_24 OBJ_Is_VeryClose_24 OBJ_Is_In_Drivable_Area_V_24 OBJ_Is_In_Drivable_Area_24 OBJ_Visibility_Side_24 OBJ_Visibility_Side_V_24 OBJ_Angle_Bottom_STD_V_24 OBJ_Angle_Bottom_STD_24 OBJ_Angle_Bottom_24 OBJ_Angle_Bottom_V_24 OBJ_Angle_Mid_STD_V_24 OBJ_Angle_Mid_STD_24 OBJ_Angle_Mid_24 OBJ_Angle_Mid_V_24 OBJ_Angle_Side_STD_V_24 OBJ_Angle_Side_STD_24 OBJ_Angle_Side_V_24 OBJ_Angle_Side_24 OBJ_Angle_Left_STD_V_24 OBJ_Angle_Left_STD_24 OBJ_Angle_Left_V_24 OBJ_Angle_Left_24 OBJ_Angle_Right_STD_V_24 OBJ_Angle_Right_STD_24 OBJ_Angle_Right_V_24 OBJ_Angle_Right_24 OBJ_Angle_Rate_V_24 OBJ_Angle_Rate_24 OBJ_Angle_Rate_STD_V_24 OBJ_Angle_Rate_STD_24 OBJ_Heading_STD_V_24 OBJ_Heading_STD_24 OBJ_Heading_V_24 OBJ_Heading_24 OBJ_Absolute_Speed_STD_V_24 OBJ_Absolute_Speed_STD_24 OBJ_Absolute_Speed_V_24 OBJ_Absolute_Speed_24 OBJ_Lat_Distance_STD_V_24 OBJ_Lat_Distance_STD_24 OBJ_Lat_Distance_V_24 OBJ_Lat_Distance_24 OBJ_Long_Distance_STD_V_24 OBJ_Long_Distance_STD_24 OBJ_Long_Distance_V_24 OBJ_Long_Distance_24 OBJ_Rel_Lat_Vel_STD_V_24 OBJ_Relative_Lat_Velocity_STD_24 OBJ_Relative_Lat_Velocity_V_24 OBJ_Relative_Lat_Velocity_24 OBJ_Rel_Long_Vel_STD_V_24 OBJ_Relative_Long_Vel_STD_24 OBJ_Relative_Long_Velocity_V_24 OBJ_Relative_Long_Velocity_24 ICM_Object_Prot24_B_Header;
SIG_GROUP_ 193 ICM_Object_Prot24_A 1 : OBJ_Rel_Long_Acc_STD_V_24 OBJ_Relative_Long_Acc_STD_24 OBJ_Relative_Long_Acc_V_24 OBJ_Relative_Long_Acc_24 OBJ_Inv_TTC_STD_V_24 OBJ_Inv_TTC_STD_24 OBJ_Inv_TTC_V_24 OBJ_Inv_TTC_24 OBJ_Abs_Acc_STD_V_24 OBJ_Abs_Acc_STD_24 OBJ_Abs_Acceleration_V_24 OBJ_Abs_Acceleration_24 OBJ_Abs_Lat_Acc_STD_V_24 OBJ_Abs_Lat_Acc_STD_24 OBJ_Abs_Lat_Acc_V_24 OBJ_Abs_Lat_Acc_24 OBJ_Abs_Long_Acc_STD_V_24 OBJ_Abs_Long_Acc_STD_24 OBJ_Abs_Long_Acc_V_24 OBJ_Abs_Long_Acc_24 OBJ_Abs_Lat_Vel_STD_V_24 OBJ_Abs_Lat_Velocity_STD_24 OBJ_Abs_Lat_Velocity_V_24 OBJ_Abs_Lat_Velocity_24 OBJ_Abs_Long_Vel_STD_V_24 OBJ_Abs_Long_Velocity_STD_24 OBJ_Abs_Long_Velocity_V_24 OBJ_Abs_Long_Velocity_24 OBJ_Height_STD_V_24 OBJ_Height_STD_24 OBJ_Height_V_24 OBJ_Height_24 OBJ_Length_STD_V_24 OBJ_Length_STD_24 OBJ_Length_V_24 OBJ_Length_24 OBJ_Width_STD_V_24 OBJ_Width_STD_24 OBJ_Width_V_24 OBJ_Width_24 OBJ_Age_Seconds_V_24 OBJ_Age_Seconds_24 OBJ_Lane_Assignment_V_24 OBJ_Lane_Assignment_24 OBJ_Bottom_Out_Of_Image_V_24 OBJ_Top_Out_Of_Image_V_24 OBJ_Bottom_Out_Of_Image_24 OBJ_Top_Out_Of_Image_24 OBJ_Left_Out_Of_Image_V_24 OBJ_Right_Out_Of_Image_V_24 OBJ_Left_Out_Of_Image_24 OBJ_Right_Out_Of_Image_24 OBJ_Light_Indicator_Validity_24 OBJ_Turn_Indicator_Left_24 OBJ_Turn_Indicator_Right_24 OBJ_Brake_Light_24 OBJ_Has_Cut_Path_24 OBJ_Has_Cut_Lane_24 OBJ_Motion_Orientation_24 OBJ_Motion_Status_24 OBJ_Camera_Source_24 OBJ_Bike_Probability_24 OBJ_Truck_Probability_24 OBJ_Car_Probability_24 OBJ_Class_Probability_24 OBJ_Object_Class_24 OBJ_Measuring_Status_24 OBJ_Object_Age_24 OBJ_Moving_IN_Probability_24 OBJ_Motion_Category_24 OBJ_Triggered_SDM_24 OBJ_Fusion_Source_24 OBJ_Existence_Probability_24 OBJ_ID_24 OBJ_CRC_24 ICM_Object_Prot24_A_Header;
SIG_GROUP_ 192 ICM_Object_Prot23_B 1 : OBJ_Buffer_23 OBJ_Is_VeryClose_V_23 OBJ_Is_VeryClose_23 OBJ_Is_In_Drivable_Area_V_23 OBJ_Is_In_Drivable_Area_23 OBJ_Visibility_Side_23 OBJ_Visibility_Side_V_23 OBJ_Angle_Bottom_STD_V_23 OBJ_Angle_Bottom_STD_23 OBJ_Angle_Bottom_23 OBJ_Angle_Bottom_V_23 OBJ_Angle_Mid_STD_V_23 OBJ_Angle_Mid_STD_23 OBJ_Angle_Mid_23 OBJ_Angle_Mid_V_23 OBJ_Angle_Side_STD_V_23 OBJ_Angle_Side_STD_23 OBJ_Angle_Side_V_23 OBJ_Angle_Side_23 OBJ_Angle_Left_STD_V_23 OBJ_Angle_Left_STD_23 OBJ_Angle_Left_V_23 OBJ_Angle_Left_23 OBJ_Angle_Right_STD_V_23 OBJ_Angle_Right_STD_23 OBJ_Angle_Right_V_23 OBJ_Angle_Right_23 OBJ_Angle_Rate_V_23 OBJ_Angle_Rate_23 OBJ_Angle_Rate_STD_V_23 OBJ_Angle_Rate_STD_23 OBJ_Heading_STD_V_23 OBJ_Heading_STD_23 OBJ_Heading_V_23 OBJ_Heading_23 OBJ_Absolute_Speed_STD_V_23 OBJ_Absolute_Speed_STD_23 OBJ_Absolute_Speed_V_23 OBJ_Absolute_Speed_23 OBJ_Lat_Distance_STD_V_23 OBJ_Lat_Distance_STD_23 OBJ_Lat_Distance_V_23 OBJ_Lat_Distance_23 OBJ_Long_Distance_STD_V_23 OBJ_Long_Distance_STD_23 OBJ_Long_Distance_V_23 OBJ_Long_Distance_23 OBJ_Rel_Lat_Vel_STD_V_23 OBJ_Relative_Lat_Velocity_STD_23 OBJ_Relative_Lat_Velocity_V_23 OBJ_Relative_Lat_Velocity_23 OBJ_Rel_Long_Vel_STD_V_23 OBJ_Relative_Long_Vel_STD_23 OBJ_Relative_Long_Velocity_V_23 OBJ_Relative_Long_Velocity_23 ICM_Object_Prot23_B_Header;
SIG_GROUP_ 191 ICM_Object_Prot23_A 1 : OBJ_Rel_Long_Acc_STD_V_23 OBJ_Relative_Long_Acc_STD_23 OBJ_Relative_Long_Acc_V_23 OBJ_Relative_Long_Acc_23 OBJ_Inv_TTC_STD_V_23 OBJ_Inv_TTC_STD_23 OBJ_Inv_TTC_V_23 OBJ_Inv_TTC_23 OBJ_Abs_Acc_STD_V_23 OBJ_Abs_Acc_STD_23 OBJ_Abs_Acceleration_V_23 OBJ_Abs_Acceleration_23 OBJ_Abs_Lat_Acc_STD_V_23 OBJ_Abs_Lat_Acc_STD_23 OBJ_Abs_Lat_Acc_V_23 OBJ_Abs_Lat_Acc_23 OBJ_Abs_Long_Acc_STD_V_23 OBJ_Abs_Long_Acc_STD_23 OBJ_Abs_Long_Acc_V_23 OBJ_Abs_Long_Acc_23 OBJ_Abs_Lat_Vel_STD_V_23 OBJ_Abs_Lat_Velocity_STD_23 OBJ_Abs_Lat_Velocity_V_23 OBJ_Abs_Lat_Velocity_23 OBJ_Abs_Long_Vel_STD_V_23 OBJ_Abs_Long_Velocity_STD_23 OBJ_Abs_Long_Velocity_V_23 OBJ_Abs_Long_Velocity_23 OBJ_Height_STD_V_23 OBJ_Height_STD_23 OBJ_Height_V_23 OBJ_Height_23 OBJ_Length_STD_V_23 OBJ_Length_STD_23 OBJ_Length_V_23 OBJ_Length_23 OBJ_Width_STD_V_23 OBJ_Width_STD_23 OBJ_Width_V_23 OBJ_Width_23 OBJ_Age_Seconds_V_23 OBJ_Age_Seconds_23 OBJ_Lane_Assignment_V_23 OBJ_Lane_Assignment_23 OBJ_Bottom_Out_Of_Image_V_23 OBJ_Top_Out_Of_Image_V_23 OBJ_Bottom_Out_Of_Image_23 OBJ_Top_Out_Of_Image_23 OBJ_Left_Out_Of_Image_V_23 OBJ_Right_Out_Of_Image_V_23 OBJ_Left_Out_Of_Image_23 OBJ_Right_Out_Of_Image_23 OBJ_Light_Indicator_Validity_23 OBJ_Turn_Indicator_Left_23 OBJ_Turn_Indicator_Right_23 OBJ_Brake_Light_23 OBJ_Has_Cut_Path_23 OBJ_Has_Cut_Lane_23 OBJ_Motion_Orientation_23 OBJ_Motion_Status_23 OBJ_Camera_Source_23 OBJ_Bike_Probability_23 OBJ_Truck_Probability_23 OBJ_Car_Probability_23 OBJ_Class_Probability_23 OBJ_Object_Class_23 OBJ_Measuring_Status_23 OBJ_Object_Age_23 OBJ_Moving_IN_Probability_23 OBJ_Motion_Category_23 OBJ_Triggered_SDM_23 OBJ_Fusion_Source_23 OBJ_Existence_Probability_23 OBJ_ID_23 OBJ_CRC_23 ICM_Object_Prot23_A_Header;
SIG_GROUP_ 190 ICM_Object_Prot22_B 1 : OBJ_Buffer_22 OBJ_Is_VeryClose_V_22 OBJ_Is_VeryClose_22 OBJ_Is_In_Drivable_Area_V_22 OBJ_Is_In_Drivable_Area_22 OBJ_Visibility_Side_22 OBJ_Visibility_Side_V_22 OBJ_Angle_Bottom_STD_V_22 OBJ_Angle_Bottom_STD_22 OBJ_Angle_Bottom_22 OBJ_Angle_Bottom_V_22 OBJ_Angle_Mid_STD_V_22 OBJ_Angle_Mid_STD_22 OBJ_Angle_Mid_22 OBJ_Angle_Mid_V_22 OBJ_Angle_Side_STD_V_22 OBJ_Angle_Side_STD_22 OBJ_Angle_Side_V_22 OBJ_Angle_Side_22 OBJ_Angle_Left_STD_V_22 OBJ_Angle_Left_STD_22 OBJ_Angle_Left_V_22 OBJ_Angle_Left_22 OBJ_Angle_Right_STD_V_22 OBJ_Angle_Right_STD_22 OBJ_Angle_Right_V_22 OBJ_Angle_Right_22 OBJ_Angle_Rate_V_22 OBJ_Angle_Rate_22 OBJ_Angle_Rate_STD_V_22 OBJ_Angle_Rate_STD_22 OBJ_Heading_STD_V_22 OBJ_Heading_STD_22 OBJ_Heading_V_22 OBJ_Heading_22 OBJ_Absolute_Speed_STD_V_22 OBJ_Absolute_Speed_STD_22 OBJ_Absolute_Speed_V_22 OBJ_Absolute_Speed_22 OBJ_Lat_Distance_STD_V_22 OBJ_Lat_Distance_STD_22 OBJ_Lat_Distance_V_22 OBJ_Lat_Distance_22 OBJ_Long_Distance_STD_V_22 OBJ_Long_Distance_STD_22 OBJ_Long_Distance_V_22 OBJ_Long_Distance_22 OBJ_Rel_Lat_Vel_STD_V_22 OBJ_Relative_Lat_Velocity_STD_22 OBJ_Relative_Lat_Velocity_V_22 OBJ_Relative_Lat_Velocity_22 OBJ_Rel_Long_Vel_STD_V_22 OBJ_Relative_Long_Vel_STD_22 OBJ_Relative_Long_Velocity_V_22 OBJ_Relative_Long_Velocity_22 ICM_Object_Prot22_B_Header;
SIG_GROUP_ 189 ICM_Object_Prot22_A 1 : OBJ_Rel_Long_Acc_STD_V_22 OBJ_Relative_Long_Acc_STD_22 OBJ_Relative_Long_Acc_V_22 OBJ_Relative_Long_Acc_22 OBJ_Inv_TTC_STD_V_22 OBJ_Inv_TTC_STD_22 OBJ_Inv_TTC_V_22 OBJ_Inv_TTC_22 OBJ_Abs_Acc_STD_V_22 OBJ_Abs_Acc_STD_22 OBJ_Abs_Acceleration_V_22 OBJ_Abs_Acceleration_22 OBJ_Abs_Lat_Acc_STD_V_22 OBJ_Abs_Lat_Acc_STD_22 OBJ_Abs_Lat_Acc_V_22 OBJ_Abs_Lat_Acc_22 OBJ_Abs_Long_Acc_STD_V_22 OBJ_Abs_Long_Acc_STD_22 OBJ_Abs_Long_Acc_V_22 OBJ_Abs_Long_Acc_22 OBJ_Abs_Lat_Vel_STD_V_22 OBJ_Abs_Lat_Velocity_STD_22 OBJ_Abs_Lat_Velocity_V_22 OBJ_Abs_Lat_Velocity_22 OBJ_Abs_Long_Vel_STD_V_22 OBJ_Abs_Long_Velocity_STD_22 OBJ_Abs_Long_Velocity_V_22 OBJ_Abs_Long_Velocity_22 OBJ_Height_STD_V_22 OBJ_Height_STD_22 OBJ_Height_V_22 OBJ_Height_22 OBJ_Length_STD_V_22 OBJ_Length_STD_22 OBJ_Length_V_22 OBJ_Length_22 OBJ_Width_STD_V_22 OBJ_Width_STD_22 OBJ_Width_V_22 OBJ_Width_22 OBJ_Age_Seconds_V_22 OBJ_Age_Seconds_22 OBJ_Lane_Assignment_V_22 OBJ_Lane_Assignment_22 OBJ_Bottom_Out_Of_Image_V_22 OBJ_Top_Out_Of_Image_V_22 OBJ_Bottom_Out_Of_Image_22 OBJ_Top_Out_Of_Image_22 OBJ_Left_Out_Of_Image_V_22 OBJ_Right_Out_Of_Image_V_22 OBJ_Left_Out_Of_Image_22 OBJ_Right_Out_Of_Image_22 OBJ_Light_Indicator_Validity_22 OBJ_Turn_Indicator_Left_22 OBJ_Turn_Indicator_Right_22 OBJ_Brake_Light_22 OBJ_Has_Cut_Path_22 OBJ_Has_Cut_Lane_22 OBJ_Motion_Orientation_22 OBJ_Motion_Status_22 OBJ_Camera_Source_22 OBJ_Bike_Probability_22 OBJ_Truck_Probability_22 OBJ_Car_Probability_22 OBJ_Class_Probability_22 OBJ_Object_Class_22 OBJ_Measuring_Status_22 OBJ_Object_Age_22 OBJ_Moving_IN_Probability_22 OBJ_Motion_Category_22 OBJ_Triggered_SDM_22 OBJ_Fusion_Source_22 OBJ_Existence_Probability_22 OBJ_ID_22 OBJ_CRC_22 ICM_Object_Prot22_A_Header;
SIG_GROUP_ 188 ICM_Object_Prot21_B 1 : OBJ_Buffer_21 OBJ_Is_VeryClose_V_21 OBJ_Is_VeryClose_21 OBJ_Is_In_Drivable_Area_V_21 OBJ_Is_In_Drivable_Area_21 OBJ_Visibility_Side_21 OBJ_Visibility_Side_V_21 OBJ_Angle_Bottom_STD_V_21 OBJ_Angle_Bottom_STD_21 OBJ_Angle_Bottom_21 OBJ_Angle_Bottom_V_21 OBJ_Angle_Mid_STD_V_21 OBJ_Angle_Mid_STD_21 OBJ_Angle_Mid_21 OBJ_Angle_Mid_V_21 OBJ_Angle_Side_STD_V_21 OBJ_Angle_Side_STD_21 OBJ_Angle_Side_V_21 OBJ_Angle_Side_21 OBJ_Angle_Left_STD_V_21 OBJ_Angle_Left_STD_21 OBJ_Angle_Left_V_21 OBJ_Angle_Left_21 OBJ_Angle_Right_STD_V_21 OBJ_Angle_Right_STD_21 OBJ_Angle_Right_V_21 OBJ_Angle_Right_21 OBJ_Angle_Rate_V_21 OBJ_Angle_Rate_21 OBJ_Angle_Rate_STD_V_21 OBJ_Angle_Rate_STD_21 OBJ_Heading_STD_V_21 OBJ_Heading_STD_21 OBJ_Heading_V_21 OBJ_Heading_21 OBJ_Absolute_Speed_STD_V_21 OBJ_Absolute_Speed_STD_21 OBJ_Absolute_Speed_V_21 OBJ_Absolute_Speed_21 OBJ_Lat_Distance_STD_V_21 OBJ_Lat_Distance_STD_21 OBJ_Lat_Distance_V_21 OBJ_Lat_Distance_21 OBJ_Long_Distance_STD_V_21 OBJ_Long_Distance_STD_21 OBJ_Long_Distance_V_21 OBJ_Long_Distance_21 OBJ_Rel_Lat_Vel_STD_V_21 OBJ_Relative_Lat_Velocity_STD_21 OBJ_Relative_Lat_Velocity_V_21 OBJ_Relative_Lat_Velocity_21 OBJ_Rel_Long_Vel_STD_V_21 OBJ_Relative_Long_Vel_STD_21 OBJ_Relative_Long_Velocity_V_21 OBJ_Relative_Long_Velocity_21 ICM_Object_Prot21_B_Header;
SIG_GROUP_ 187 ICM_Object_Prot21_A 1 : OBJ_Rel_Long_Acc_STD_V_21 OBJ_Relative_Long_Acc_STD_21 OBJ_Relative_Long_Acc_V_21 OBJ_Relative_Long_Acc_21 OBJ_Inv_TTC_STD_V_21 OBJ_Inv_TTC_STD_21 OBJ_Inv_TTC_V_21 OBJ_Inv_TTC_21 OBJ_Abs_Acc_STD_V_21 OBJ_Abs_Acc_STD_21 OBJ_Abs_Acceleration_V_21 OBJ_Abs_Acceleration_21 OBJ_Abs_Lat_Acc_STD_V_21 OBJ_Abs_Lat_Acc_STD_21 OBJ_Abs_Lat_Acc_V_21 OBJ_Abs_Lat_Acc_21 OBJ_Abs_Long_Acc_STD_V_21 OBJ_Abs_Long_Acc_STD_21 OBJ_Abs_Long_Acc_V_21 OBJ_Abs_Long_Acc_21 OBJ_Abs_Lat_Vel_STD_V_21 OBJ_Abs_Lat_Velocity_STD_21 OBJ_Abs_Lat_Velocity_V_21 OBJ_Abs_Lat_Velocity_21 OBJ_Abs_Long_Vel_STD_V_21 OBJ_Abs_Long_Velocity_STD_21 OBJ_Abs_Long_Velocity_V_21 OBJ_Abs_Long_Velocity_21 OBJ_Height_STD_V_21 OBJ_Height_STD_21 OBJ_Height_V_21 OBJ_Height_21 OBJ_Length_STD_V_21 OBJ_Length_STD_21 OBJ_Length_V_21 OBJ_Length_21 OBJ_Width_STD_V_21 OBJ_Width_STD_21 OBJ_Width_V_21 OBJ_Width_21 OBJ_Age_Seconds_V_21 OBJ_Age_Seconds_21 OBJ_Lane_Assignment_V_21 OBJ_Lane_Assignment_21 OBJ_Bottom_Out_Of_Image_V_21 OBJ_Top_Out_Of_Image_V_21 OBJ_Bottom_Out_Of_Image_21 OBJ_Top_Out_Of_Image_21 OBJ_Left_Out_Of_Image_V_21 OBJ_Right_Out_Of_Image_V_21 OBJ_Left_Out_Of_Image_21 OBJ_Right_Out_Of_Image_21 OBJ_Light_Indicator_Validity_21 OBJ_Turn_Indicator_Left_21 OBJ_Turn_Indicator_Right_21 OBJ_Brake_Light_21 OBJ_Has_Cut_Path_21 OBJ_Has_Cut_Lane_21 OBJ_Motion_Orientation_21 OBJ_Motion_Status_21 OBJ_Camera_Source_21 OBJ_Bike_Probability_21 OBJ_Truck_Probability_21 OBJ_Car_Probability_21 OBJ_Class_Probability_21 OBJ_Object_Class_21 OBJ_Measuring_Status_21 OBJ_Object_Age_21 OBJ_Moving_IN_Probability_21 OBJ_Motion_Category_21 OBJ_Triggered_SDM_21 OBJ_Fusion_Source_21 OBJ_Existence_Probability_21 OBJ_ID_21 OBJ_CRC_21 ICM_Object_Prot21_A_Header;
SIG_GROUP_ 186 ICM_Object_Prot20_B 1 : OBJ_Buffer_20 OBJ_Is_VeryClose_V_20 OBJ_Is_VeryClose_20 OBJ_Is_In_Drivable_Area_V_20 OBJ_Is_In_Drivable_Area_20 OBJ_Visibility_Side_20 OBJ_Visibility_Side_V_20 OBJ_Angle_Bottom_STD_V_20 OBJ_Angle_Bottom_STD_20 OBJ_Angle_Bottom_20 OBJ_Angle_Bottom_V_20 OBJ_Angle_Mid_STD_V_20 OBJ_Angle_Mid_STD_20 OBJ_Angle_Mid_20 OBJ_Angle_Mid_V_20 OBJ_Angle_Side_STD_V_20 OBJ_Angle_Side_STD_20 OBJ_Angle_Side_V_20 OBJ_Angle_Side_20 OBJ_Angle_Left_STD_V_20 OBJ_Angle_Left_STD_20 OBJ_Angle_Left_V_20 OBJ_Angle_Left_20 OBJ_Angle_Right_STD_V_20 OBJ_Angle_Right_STD_20 OBJ_Angle_Right_V_20 OBJ_Angle_Right_20 OBJ_Angle_Rate_V_20 OBJ_Angle_Rate_20 OBJ_Angle_Rate_STD_V_20 OBJ_Angle_Rate_STD_20 OBJ_Heading_STD_V_20 OBJ_Heading_STD_20 OBJ_Heading_V_20 OBJ_Heading_20 OBJ_Absolute_Speed_STD_V_20 OBJ_Absolute_Speed_STD_20 OBJ_Absolute_Speed_V_20 OBJ_Absolute_Speed_20 OBJ_Lat_Distance_STD_V_20 OBJ_Lat_Distance_STD_20 OBJ_Lat_Distance_V_20 OBJ_Lat_Distance_20 OBJ_Long_Distance_STD_V_20 OBJ_Long_Distance_STD_20 OBJ_Long_Distance_V_20 OBJ_Long_Distance_20 OBJ_Rel_Lat_Vel_STD_V_20 OBJ_Relative_Lat_Velocity_STD_20 OBJ_Relative_Lat_Velocity_V_20 OBJ_Relative_Lat_Velocity_20 OBJ_Rel_Long_Vel_STD_V_20 OBJ_Relative_Long_Vel_STD_20 OBJ_Relative_Long_Velocity_V_20 OBJ_Relative_Long_Velocity_20 ICM_Object_Prot20_B_Header;
SIG_GROUP_ 185 ICM_Object_Prot20_A 1 : OBJ_Rel_Long_Acc_STD_V_20 OBJ_Relative_Long_Acc_STD_20 OBJ_Relative_Long_Acc_V_20 OBJ_Relative_Long_Acc_20 OBJ_Inv_TTC_STD_V_20 OBJ_Inv_TTC_STD_20 OBJ_Inv_TTC_V_20 OBJ_Inv_TTC_20 OBJ_Abs_Acc_STD_V_20 OBJ_Abs_Acc_STD_20 OBJ_Abs_Acceleration_V_20 OBJ_Abs_Acceleration_20 OBJ_Abs_Lat_Acc_STD_V_20 OBJ_Abs_Lat_Acc_STD_20 OBJ_Abs_Lat_Acc_V_20 OBJ_Abs_Lat_Acc_20 OBJ_Abs_Long_Acc_STD_V_20 OBJ_Abs_Long_Acc_STD_20 OBJ_Abs_Long_Acc_V_20 OBJ_Abs_Long_Acc_20 OBJ_Abs_Lat_Vel_STD_V_20 OBJ_Abs_Lat_Velocity_STD_20 OBJ_Abs_Lat_Velocity_V_20 OBJ_Abs_Lat_Velocity_20 OBJ_Abs_Long_Vel_STD_V_20 OBJ_Abs_Long_Velocity_STD_20 OBJ_Abs_Long_Velocity_V_20 OBJ_Abs_Long_Velocity_20 OBJ_Height_STD_V_20 OBJ_Height_STD_20 OBJ_Height_V_20 OBJ_Height_20 OBJ_Length_STD_V_20 OBJ_Length_STD_20 OBJ_Length_V_20 OBJ_Length_20 OBJ_Width_STD_V_20 OBJ_Width_STD_20 OBJ_Width_V_20 OBJ_Width_20 OBJ_Age_Seconds_V_20 OBJ_Age_Seconds_20 OBJ_Lane_Assignment_V_20 OBJ_Lane_Assignment_20 OBJ_Bottom_Out_Of_Image_V_20 OBJ_Top_Out_Of_Image_V_20 OBJ_Bottom_Out_Of_Image_20 OBJ_Top_Out_Of_Image_20 OBJ_Left_Out_Of_Image_V_20 OBJ_Right_Out_Of_Image_V_20 OBJ_Left_Out_Of_Image_20 OBJ_Right_Out_Of_Image_20 OBJ_Light_Indicator_Validity_20 OBJ_Turn_Indicator_Left_20 OBJ_Turn_Indicator_Right_20 OBJ_Brake_Light_20 OBJ_Has_Cut_Path_20 OBJ_Has_Cut_Lane_20 OBJ_Motion_Orientation_20 OBJ_Motion_Status_20 OBJ_Camera_Source_20 OBJ_Bike_Probability_20 OBJ_Truck_Probability_20 OBJ_Car_Probability_20 OBJ_Class_Probability_20 OBJ_Object_Class_20 OBJ_Measuring_Status_20 OBJ_Object_Age_20 OBJ_Moving_IN_Probability_20 OBJ_Motion_Category_20 OBJ_Triggered_SDM_20 OBJ_Fusion_Source_20 OBJ_Existence_Probability_20 OBJ_ID_20 OBJ_CRC_20 ICM_Object_Prot20_A_Header;
SIG_GROUP_ 184 ICM_Object_Prot19_B 1 : OBJ_Buffer_19 OBJ_Is_VeryClose_V_19 OBJ_Is_VeryClose_19 OBJ_Is_In_Drivable_Area_V_19 OBJ_Is_In_Drivable_Area_19 OBJ_Visibility_Side_19 OBJ_Visibility_Side_V_19 OBJ_Angle_Bottom_STD_V_19 OBJ_Angle_Bottom_STD_19 OBJ_Angle_Bottom_19 OBJ_Angle_Bottom_V_19 OBJ_Angle_Mid_STD_V_19 OBJ_Angle_Mid_STD_19 OBJ_Angle_Mid_19 OBJ_Angle_Mid_V_19 OBJ_Angle_Side_STD_V_19 OBJ_Angle_Side_STD_19 OBJ_Angle_Side_V_19 OBJ_Angle_Side_19 OBJ_Angle_Left_STD_V_19 OBJ_Angle_Left_STD_19 OBJ_Angle_Left_V_19 OBJ_Angle_Left_19 OBJ_Angle_Right_STD_V_19 OBJ_Angle_Right_STD_19 OBJ_Angle_Right_V_19 OBJ_Angle_Right_19 OBJ_Angle_Rate_V_19 OBJ_Angle_Rate_19 OBJ_Angle_Rate_STD_V_19 OBJ_Angle_Rate_STD_19 OBJ_Heading_STD_V_19 OBJ_Heading_STD_19 OBJ_Heading_V_19 OBJ_Heading_19 OBJ_Absolute_Speed_STD_V_19 OBJ_Absolute_Speed_STD_19 OBJ_Absolute_Speed_V_19 OBJ_Absolute_Speed_19 OBJ_Lat_Distance_STD_V_19 OBJ_Lat_Distance_STD_19 OBJ_Lat_Distance_V_19 OBJ_Lat_Distance_19 OBJ_Long_Distance_STD_V_19 OBJ_Long_Distance_STD_19 OBJ_Long_Distance_V_19 OBJ_Long_Distance_19 OBJ_Rel_Lat_Vel_STD_V_19 OBJ_Relative_Lat_Velocity_STD_19 OBJ_Relative_Lat_Velocity_V_19 OBJ_Relative_Lat_Velocity_19 OBJ_Rel_Long_Vel_STD_V_19 OBJ_Relative_Long_Vel_STD_19 OBJ_Relative_Long_Velocity_V_19 OBJ_Relative_Long_Velocity_19 ICM_Object_Prot19_B_Header;
SIG_GROUP_ 183 ICM_Object_Prot19_A 1 : OBJ_Rel_Long_Acc_STD_V_19 OBJ_Relative_Long_Acc_STD_19 OBJ_Relative_Long_Acc_V_19 OBJ_Relative_Long_Acc_19 OBJ_Inv_TTC_STD_V_19 OBJ_Inv_TTC_STD_19 OBJ_Inv_TTC_V_19 OBJ_Inv_TTC_19 OBJ_Abs_Acc_STD_V_19 OBJ_Abs_Acc_STD_19 OBJ_Abs_Acceleration_V_19 OBJ_Abs_Acceleration_19 OBJ_Abs_Lat_Acc_STD_V_19 OBJ_Abs_Lat_Acc_STD_19 OBJ_Abs_Lat_Acc_V_19 OBJ_Abs_Lat_Acc_19 OBJ_Abs_Long_Acc_STD_V_19 OBJ_Abs_Long_Acc_STD_19 OBJ_Abs_Long_Acc_V_19 OBJ_Abs_Long_Acc_19 OBJ_Abs_Lat_Vel_STD_V_19 OBJ_Abs_Lat_Velocity_STD_19 OBJ_Abs_Lat_Velocity_V_19 OBJ_Abs_Lat_Velocity_19 OBJ_Abs_Long_Vel_STD_V_19 OBJ_Abs_Long_Velocity_STD_19 OBJ_Abs_Long_Velocity_V_19 OBJ_Abs_Long_Velocity_19 OBJ_Height_STD_V_19 OBJ_Height_STD_19 OBJ_Height_V_19 OBJ_Height_19 OBJ_Length_STD_V_19 OBJ_Length_STD_19 OBJ_Length_V_19 OBJ_Length_19 OBJ_Width_STD_V_19 OBJ_Width_STD_19 OBJ_Width_V_19 OBJ_Width_19 OBJ_Age_Seconds_V_19 OBJ_Age_Seconds_19 OBJ_Lane_Assignment_V_19 OBJ_Lane_Assignment_19 OBJ_Bottom_Out_Of_Image_V_19 OBJ_Top_Out_Of_Image_V_19 OBJ_Bottom_Out_Of_Image_19 OBJ_Top_Out_Of_Image_19 OBJ_Left_Out_Of_Image_V_19 OBJ_Right_Out_Of_Image_V_19 OBJ_Left_Out_Of_Image_19 OBJ_Right_Out_Of_Image_19 OBJ_Light_Indicator_Validity_19 OBJ_Turn_Indicator_Left_19 OBJ_Turn_Indicator_Right_19 OBJ_Brake_Light_19 OBJ_Has_Cut_Path_19 OBJ_Has_Cut_Lane_19 OBJ_Motion_Orientation_19 OBJ_Motion_Status_19 OBJ_Camera_Source_19 OBJ_Bike_Probability_19 OBJ_Truck_Probability_19 OBJ_Car_Probability_19 OBJ_Class_Probability_19 OBJ_Object_Class_19 OBJ_Measuring_Status_19 OBJ_Object_Age_19 OBJ_Moving_IN_Probability_19 OBJ_Motion_Category_19 OBJ_Triggered_SDM_19 OBJ_Fusion_Source_19 OBJ_Existence_Probability_19 OBJ_ID_19 OBJ_CRC_19 ICM_Object_Prot19_A_Header;
SIG_GROUP_ 182 ICM_Object_Prot18_B 1 : OBJ_Buffer_18 OBJ_Is_VeryClose_V_18 OBJ_Is_VeryClose_18 OBJ_Is_In_Drivable_Area_V_18 OBJ_Is_In_Drivable_Area_18 OBJ_Visibility_Side_18 OBJ_Visibility_Side_V_18 OBJ_Angle_Bottom_STD_V_18 OBJ_Angle_Bottom_STD_18 OBJ_Angle_Bottom_18 OBJ_Angle_Bottom_V_18 OBJ_Angle_Mid_STD_V_18 OBJ_Angle_Mid_STD_18 OBJ_Angle_Mid_18 OBJ_Angle_Mid_V_18 OBJ_Angle_Side_STD_V_18 OBJ_Angle_Side_STD_18 OBJ_Angle_Side_V_18 OBJ_Angle_Side_18 OBJ_Angle_Left_STD_V_18 OBJ_Angle_Left_STD_18 OBJ_Angle_Left_V_18 OBJ_Angle_Left_18 OBJ_Angle_Right_STD_V_18 OBJ_Angle_Right_STD_18 OBJ_Angle_Right_V_18 OBJ_Angle_Right_18 OBJ_Angle_Rate_V_18 OBJ_Angle_Rate_18 OBJ_Angle_Rate_STD_V_18 OBJ_Angle_Rate_STD_18 OBJ_Heading_STD_V_18 OBJ_Heading_STD_18 OBJ_Heading_V_18 OBJ_Heading_18 OBJ_Absolute_Speed_STD_V_18 OBJ_Absolute_Speed_STD_18 OBJ_Absolute_Speed_V_18 OBJ_Absolute_Speed_18 OBJ_Lat_Distance_STD_V_18 OBJ_Lat_Distance_STD_18 OBJ_Lat_Distance_V_18 OBJ_Lat_Distance_18 OBJ_Long_Distance_STD_V_18 OBJ_Long_Distance_STD_18 OBJ_Long_Distance_V_18 OBJ_Long_Distance_18 OBJ_Rel_Lat_Vel_STD_V_18 OBJ_Relative_Lat_Velocity_STD_18 OBJ_Relative_Lat_Velocity_V_18 OBJ_Relative_Lat_Velocity_18 OBJ_Rel_Long_Vel_STD_V_18 OBJ_Relative_Long_Vel_STD_18 OBJ_Relative_Long_Velocity_V_18 OBJ_Relative_Long_Velocity_18 ICM_Object_Prot18_B_Header;
SIG_GROUP_ 181 ICM_Object_Prot18_A 1 : OBJ_Rel_Long_Acc_STD_V_18 OBJ_Relative_Long_Acc_STD_18 OBJ_Relative_Long_Acc_V_18 OBJ_Relative_Long_Acc_18 OBJ_Inv_TTC_STD_V_18 OBJ_Inv_TTC_STD_18 OBJ_Inv_TTC_V_18 OBJ_Inv_TTC_18 OBJ_Abs_Acc_STD_V_18 OBJ_Abs_Acc_STD_18 OBJ_Abs_Acceleration_V_18 OBJ_Abs_Acceleration_18 OBJ_Abs_Lat_Acc_STD_V_18 OBJ_Abs_Lat_Acc_STD_18 OBJ_Abs_Lat_Acc_V_18 OBJ_Abs_Lat_Acc_18 OBJ_Abs_Long_Acc_STD_V_18 OBJ_Abs_Long_Acc_STD_18 OBJ_Abs_Long_Acc_V_18 OBJ_Abs_Long_Acc_18 OBJ_Abs_Lat_Vel_STD_V_18 OBJ_Abs_Lat_Velocity_STD_18 OBJ_Abs_Lat_Velocity_V_18 OBJ_Abs_Lat_Velocity_18 OBJ_Abs_Long_Vel_STD_V_18 OBJ_Abs_Long_Velocity_STD_18 OBJ_Abs_Long_Velocity_V_18 OBJ_Abs_Long_Velocity_18 OBJ_Height_STD_V_18 OBJ_Height_STD_18 OBJ_Height_V_18 OBJ_Height_18 OBJ_Length_STD_V_18 OBJ_Length_STD_18 OBJ_Length_V_18 OBJ_Length_18 OBJ_Width_STD_V_18 OBJ_Width_STD_18 OBJ_Width_V_18 OBJ_Width_18 OBJ_Age_Seconds_V_18 OBJ_Age_Seconds_18 OBJ_Lane_Assignment_V_18 OBJ_Lane_Assignment_18 OBJ_Bottom_Out_Of_Image_V_18 OBJ_Top_Out_Of_Image_V_18 OBJ_Bottom_Out_Of_Image_18 OBJ_Top_Out_Of_Image_18 OBJ_Left_Out_Of_Image_V_18 OBJ_Right_Out_Of_Image_V_18 OBJ_Left_Out_Of_Image_18 OBJ_Right_Out_Of_Image_18 OBJ_Light_Indicator_Validity_18 OBJ_Turn_Indicator_Left_18 OBJ_Turn_Indicator_Right_18 OBJ_Brake_Light_18 OBJ_Has_Cut_Path_18 OBJ_Has_Cut_Lane_18 OBJ_Motion_Orientation_18 OBJ_Motion_Status_18 OBJ_Camera_Source_18 OBJ_Bike_Probability_18 OBJ_Truck_Probability_18 OBJ_Car_Probability_18 OBJ_Class_Probability_18 OBJ_Object_Class_18 OBJ_Measuring_Status_18 OBJ_Object_Age_18 OBJ_Moving_IN_Probability_18 OBJ_Motion_Category_18 OBJ_Triggered_SDM_18 OBJ_Fusion_Source_18 OBJ_Existence_Probability_18 OBJ_ID_18 OBJ_CRC_18 ICM_Object_Prot18_A_Header;
SIG_GROUP_ 180 ICM_Object_Prot17_B 1 : OBJ_Buffer_17 OBJ_Is_VeryClose_V_17 OBJ_Is_VeryClose_17 OBJ_Is_In_Drivable_Area_V_17 OBJ_Is_In_Drivable_Area_17 OBJ_Visibility_Side_17 OBJ_Visibility_Side_V_17 OBJ_Angle_Bottom_STD_V_17 OBJ_Angle_Bottom_STD_17 OBJ_Angle_Bottom_17 OBJ_Angle_Bottom_V_17 OBJ_Angle_Mid_STD_V_17 OBJ_Angle_Mid_STD_17 OBJ_Angle_Mid_17 OBJ_Angle_Mid_V_17 OBJ_Angle_Side_STD_V_17 OBJ_Angle_Side_STD_17 OBJ_Angle_Side_V_17 OBJ_Angle_Side_17 OBJ_Angle_Left_STD_V_17 OBJ_Angle_Left_STD_17 OBJ_Angle_Left_V_17 OBJ_Angle_Left_17 OBJ_Angle_Right_STD_V_17 OBJ_Angle_Right_STD_17 OBJ_Angle_Right_V_17 OBJ_Angle_Right_17 OBJ_Angle_Rate_V_17 OBJ_Angle_Rate_17 OBJ_Angle_Rate_STD_V_17 OBJ_Angle_Rate_STD_17 OBJ_Heading_STD_V_17 OBJ_Heading_STD_17 OBJ_Heading_V_17 OBJ_Heading_17 OBJ_Absolute_Speed_STD_V_17 OBJ_Absolute_Speed_STD_17 OBJ_Absolute_Speed_V_17 OBJ_Absolute_Speed_17 OBJ_Lat_Distance_STD_V_17 OBJ_Lat_Distance_STD_17 OBJ_Lat_Distance_V_17 OBJ_Lat_Distance_17 OBJ_Long_Distance_STD_V_17 OBJ_Long_Distance_STD_17 OBJ_Long_Distance_V_17 OBJ_Long_Distance_17 OBJ_Rel_Lat_Vel_STD_V_17 OBJ_Relative_Lat_Velocity_STD_17 OBJ_Relative_Lat_Velocity_V_17 OBJ_Relative_Lat_Velocity_17 OBJ_Rel_Long_Vel_STD_V_17 OBJ_Relative_Long_Vel_STD_17 OBJ_Relative_Long_Velocity_V_17 OBJ_Relative_Long_Velocity_17 ICM_Object_Prot17_B_Header;
SIG_GROUP_ 179 ICM_Object_Prot17_A 1 : OBJ_Rel_Long_Acc_STD_V_17 OBJ_Relative_Long_Acc_STD_17 OBJ_Relative_Long_Acc_V_17 OBJ_Relative_Long_Acc_17 OBJ_Inv_TTC_STD_V_17 OBJ_Inv_TTC_STD_17 OBJ_Inv_TTC_V_17 OBJ_Inv_TTC_17 OBJ_Abs_Acc_STD_V_17 OBJ_Abs_Acc_STD_17 OBJ_Abs_Acceleration_V_17 OBJ_Abs_Acceleration_17 OBJ_Abs_Lat_Acc_STD_V_17 OBJ_Abs_Lat_Acc_STD_17 OBJ_Abs_Lat_Acc_V_17 OBJ_Abs_Lat_Acc_17 OBJ_Abs_Long_Acc_STD_V_17 OBJ_Abs_Long_Acc_STD_17 OBJ_Abs_Long_Acc_V_17 OBJ_Abs_Long_Acc_17 OBJ_Abs_Lat_Vel_STD_V_17 OBJ_Abs_Lat_Velocity_STD_17 OBJ_Abs_Lat_Velocity_V_17 OBJ_Abs_Lat_Velocity_17 OBJ_Abs_Long_Vel_STD_V_17 OBJ_Abs_Long_Velocity_STD_17 OBJ_Abs_Long_Velocity_V_17 OBJ_Abs_Long_Velocity_17 OBJ_Height_STD_V_17 OBJ_Height_STD_17 OBJ_Height_V_17 OBJ_Height_17 OBJ_Length_STD_V_17 OBJ_Length_STD_17 OBJ_Length_V_17 OBJ_Length_17 OBJ_Width_STD_V_17 OBJ_Width_STD_17 OBJ_Width_V_17 OBJ_Width_17 OBJ_Age_Seconds_V_17 OBJ_Age_Seconds_17 OBJ_Lane_Assignment_V_17 OBJ_Lane_Assignment_17 OBJ_Bottom_Out_Of_Image_V_17 OBJ_Top_Out_Of_Image_V_17 OBJ_Bottom_Out_Of_Image_17 OBJ_Top_Out_Of_Image_17 OBJ_Left_Out_Of_Image_V_17 OBJ_Right_Out_Of_Image_V_17 OBJ_Left_Out_Of_Image_17 OBJ_Right_Out_Of_Image_17 OBJ_Light_Indicator_Validity_17 OBJ_Turn_Indicator_Left_17 OBJ_Turn_Indicator_Right_17 OBJ_Brake_Light_17 OBJ_Has_Cut_Path_17 OBJ_Has_Cut_Lane_17 OBJ_Motion_Orientation_17 OBJ_Motion_Status_17 OBJ_Camera_Source_17 OBJ_Bike_Probability_17 OBJ_Truck_Probability_17 OBJ_Car_Probability_17 OBJ_Class_Probability_17 OBJ_Object_Class_17 OBJ_Measuring_Status_17 OBJ_Object_Age_17 OBJ_Moving_IN_Probability_17 OBJ_Motion_Category_17 OBJ_Triggered_SDM_17 OBJ_Fusion_Source_17 OBJ_Existence_Probability_17 OBJ_ID_17 OBJ_CRC_17 ICM_Object_Prot17_A_Header;
SIG_GROUP_ 178 ICM_Object_Prot16_B 1 : OBJ_Buffer_16 OBJ_Is_VeryClose_V_16 OBJ_Is_VeryClose_16 OBJ_Is_In_Drivable_Area_V_16 OBJ_Is_In_Drivable_Area_16 OBJ_Visibility_Side_16 OBJ_Visibility_Side_V_16 OBJ_Angle_Bottom_STD_V_16 OBJ_Angle_Bottom_STD_16 OBJ_Angle_Bottom_16 OBJ_Angle_Bottom_V_16 OBJ_Angle_Mid_STD_V_16 OBJ_Angle_Mid_STD_16 OBJ_Angle_Mid_16 OBJ_Angle_Mid_V_16 OBJ_Angle_Side_STD_V_16 OBJ_Angle_Side_STD_16 OBJ_Angle_Side_V_16 OBJ_Angle_Side_16 OBJ_Angle_Left_STD_V_16 OBJ_Angle_Left_STD_16 OBJ_Angle_Left_V_16 OBJ_Angle_Left_16 OBJ_Angle_Right_STD_V_16 OBJ_Angle_Right_STD_16 OBJ_Angle_Right_V_16 OBJ_Angle_Right_16 OBJ_Angle_Rate_V_16 OBJ_Angle_Rate_16 OBJ_Angle_Rate_STD_V_16 OBJ_Angle_Rate_STD_16 OBJ_Heading_STD_V_16 OBJ_Heading_STD_16 OBJ_Heading_V_16 OBJ_Heading_16 OBJ_Absolute_Speed_STD_V_16 OBJ_Absolute_Speed_STD_16 OBJ_Absolute_Speed_V_16 OBJ_Absolute_Speed_16 OBJ_Lat_Distance_STD_V_16 OBJ_Lat_Distance_STD_16 OBJ_Lat_Distance_V_16 OBJ_Lat_Distance_16 OBJ_Long_Distance_STD_V_16 OBJ_Long_Distance_STD_16 OBJ_Long_Distance_V_16 OBJ_Long_Distance_16 OBJ_Rel_Lat_Vel_STD_V_16 OBJ_Relative_Lat_Velocity_STD_16 OBJ_Relative_Lat_Velocity_V_16 OBJ_Relative_Lat_Velocity_16 OBJ_Rel_Long_Vel_STD_V_16 OBJ_Relative_Long_Vel_STD_16 OBJ_Relative_Long_Velocity_V_16 OBJ_Relative_Long_Velocity_16 ICM_Object_Prot16_B_Header;
SIG_GROUP_ 177 ICM_Object_Prot16_A 1 : OBJ_Rel_Long_Acc_STD_V_16 OBJ_Relative_Long_Acc_STD_16 OBJ_Relative_Long_Acc_V_16 OBJ_Relative_Long_Acc_16 OBJ_Inv_TTC_STD_V_16 OBJ_Inv_TTC_STD_16 OBJ_Inv_TTC_V_16 OBJ_Inv_TTC_16 OBJ_Abs_Acc_STD_V_16 OBJ_Abs_Acc_STD_16 OBJ_Abs_Acceleration_V_16 OBJ_Abs_Acceleration_16 OBJ_Abs_Lat_Acc_STD_V_16 OBJ_Abs_Lat_Acc_STD_16 OBJ_Abs_Lat_Acc_V_16 OBJ_Abs_Lat_Acc_16 OBJ_Abs_Long_Acc_STD_V_16 OBJ_Abs_Long_Acc_STD_16 OBJ_Abs_Long_Acc_V_16 OBJ_Abs_Long_Acc_16 OBJ_Abs_Lat_Vel_STD_V_16 OBJ_Abs_Lat_Velocity_STD_16 OBJ_Abs_Lat_Velocity_V_16 OBJ_Abs_Lat_Velocity_16 OBJ_Abs_Long_Vel_STD_V_16 OBJ_Abs_Long_Velocity_STD_16 OBJ_Abs_Long_Velocity_V_16 OBJ_Abs_Long_Velocity_16 OBJ_Height_STD_V_16 OBJ_Height_STD_16 OBJ_Height_V_16 OBJ_Height_16 OBJ_Length_STD_V_16 OBJ_Length_STD_16 OBJ_Length_V_16 OBJ_Length_16 OBJ_Width_STD_V_16 OBJ_Width_STD_16 OBJ_Width_V_16 OBJ_Width_16 OBJ_Age_Seconds_V_16 OBJ_Age_Seconds_16 OBJ_Lane_Assignment_V_16 OBJ_Lane_Assignment_16 OBJ_Bottom_Out_Of_Image_V_16 OBJ_Top_Out_Of_Image_V_16 OBJ_Bottom_Out_Of_Image_16 OBJ_Top_Out_Of_Image_16 OBJ_Left_Out_Of_Image_V_16 OBJ_Right_Out_Of_Image_V_16 OBJ_Left_Out_Of_Image_16 OBJ_Right_Out_Of_Image_16 OBJ_Light_Indicator_Validity_16 OBJ_Turn_Indicator_Left_16 OBJ_Turn_Indicator_Right_16 OBJ_Brake_Light_16 OBJ_Has_Cut_Path_16 OBJ_Has_Cut_Lane_16 OBJ_Motion_Orientation_16 OBJ_Motion_Status_16 OBJ_Camera_Source_16 OBJ_Bike_Probability_16 OBJ_Truck_Probability_16 OBJ_Car_Probability_16 OBJ_Class_Probability_16 OBJ_Object_Class_16 OBJ_Measuring_Status_16 OBJ_Object_Age_16 OBJ_Moving_IN_Probability_16 OBJ_Motion_Category_16 OBJ_Triggered_SDM_16 OBJ_Fusion_Source_16 OBJ_Existence_Probability_16 OBJ_ID_16 OBJ_CRC_16 ICM_Object_Prot16_A_Header;
