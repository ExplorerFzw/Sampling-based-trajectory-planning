VERSION "3"

NS_ :

BS_:

BU_: MyECU ACM

BO_ 176 ICM_Object_Prot15_B: 64 MyECU
 SG_ ICM_Object_Prot15_B_Header : 0|16@1+ (1,0) [0|65535] ""  ACM
 SG_ OBJ_Relative_Long_Velocity_15 : 16|13@1+ (0.05,-120) [-120|130] "MPS"  ACM
 SG_ OBJ_Relative_Long_Velocity_V_15 : 29|1@1+ (1,0) [0|1] "bool"  ACM
 SG_ OBJ_Relative_Long_Vel_STD_15 : 30|12@1+ (0.05,0) [0|130] "MPS"  ACM
 SG_ OBJ_Rel_Long_Vel_STD_V_15 : 42|1@1+ (1,0) [0|1] "bool"  ACM
 SG_ OBJ_Relative_Lat_Velocity_15 : 48|11@1+ (0.05,-50) [-50|50] "MPS"  ACM
 SG_ OBJ_Relative_Lat_Velocity_V_15 : 59|1@1+ (1,0) [0|1] "bool"  ACM
 SG_ OBJ_Relative_Lat_Velocity_STD_15 : 60|10@1+ (0.05,0) [0|50] "MPS"  ACM
 SG_ OBJ_Rel_Lat_Vel_STD_V_15 : 70|1@1+ (1,0) [0|1] "bool"  ACM
 SG_ OBJ_Long_Distance_15 : 80|14@1+ (0.05,-200) [-200|250] "m"  ACM
 SG_ OBJ_Long_Distance_V_15 : 94|1@1+ (1,0) [0|1] "bool"  ACM
 SG_ OBJ_Long_Distance_STD_15 : 95|13@1+ (0.05,0) [0|250] "m"  ACM
 SG_ OBJ_Long_Distance_STD_V_15 : 108|1@1+ (1,0) [0|1] "bool"  ACM
 SG_ OBJ_Lat_Distance_15 : 112|12@1+ (0.05,-100) [-100|100] "m"  ACM
 SG_ OBJ_Lat_Distance_V_15 : 124|1@1+ (1,0) [0|1] "bool"  ACM
 SG_ OBJ_Lat_Distance_STD_15 : 125|11@1+ (0.05,0) [0|100] "m"  ACM
 SG_ OBJ_Lat_Distance_STD_V_15 : 136|1@1+ (1,0) [0|1] "bool"  ACM
 SG_ OBJ_Absolute_Speed_15 : 144|12@1+ (0.05,-65) [-65|65] "MPS"  ACM
 SG_ OBJ_Absolute_Speed_V_15 : 156|1@1+ (1,0) [0|1] "bool"  ACM
 SG_ OBJ_Absolute_Speed_STD_15 : 157|11@1+ (0.05,-65) [0|65] "MPS"  ACM
 SG_ OBJ_Absolute_Speed_STD_V_15 : 168|1@1+ (1,0) [0|1] "bool"  ACM
 SG_ OBJ_Heading_15 : 176|10@1+ (0.01,-3.14) [-3.14|3.14] "rad"  ACM
 SG_ OBJ_Heading_V_15 : 186|1@1+ (1,0) [0|1] "bool"  ACM
 SG_ OBJ_Heading_STD_15 : 187|9@1+ (0.01,0) [0|3.14] "rad"  ACM
 SG_ OBJ_Heading_STD_V_15 : 196|1@1+ (1,0) [0|1] "bool"  ACM
 SG_ OBJ_Angle_Rate_STD_15 : 197|11@1+ (0.002,0) [0|2.2318] "RPS"  ACM
 SG_ OBJ_Angle_Rate_STD_V_15 : 208|1@1+ (1,0) [0|1] "bool"  ACM
 SG_ OBJ_Angle_Rate_15 : 209|12@1+ (0.002,-2.234) [-2.234|2.2318] "RPS"  ACM
 SG_ OBJ_Angle_Rate_V_15 : 221|1@1+ (1,0) [0|1] "bool"  ACM
 SG_ OBJ_Angle_Right_15 : 222|14@1+ (0.0002,-1.571) [-1.571|1.571] "rad "  ACM
 SG_ OBJ_Angle_Right_V_15 : 236|1@1+ (1,0) [0|1] "bool"  ACM
 SG_ OBJ_Angle_Right_STD_15 : 240|13@1+ (0.0002,0) [0|1.571] "rad "  ACM
 SG_ OBJ_Angle_Right_STD_V_15 : 253|1@1+ (1,0) [0|1] "bool"  ACM
 SG_ OBJ_Angle_Left_15 : 254|14@1+ (0.0002,-1.571) [-1.571|1.571] "rad "  ACM
 SG_ OBJ_Angle_Left_V_15 : 268|1@1+ (1,0) [0|1] "bool"  ACM
 SG_ OBJ_Angle_Left_STD_15 : 272|13@1+ (0.0002,0) [0|1.571] "rad"  ACM
 SG_ OBJ_Angle_Left_STD_V_15 : 285|1@1+ (1,0) [0|1] "bool"  ACM
 SG_ OBJ_Angle_Side_15 : 286|14@1+ (0.0002,-1.571) [-1.571|1.571] "rad"  ACM
 SG_ OBJ_Angle_Side_V_15 : 300|1@1+ (1,0) [0|1] "bool"  ACM
 SG_ OBJ_Angle_Side_STD_15 : 304|13@1+ (0.0002,0) [0|1.571] "rad"  ACM
 SG_ OBJ_Angle_Side_STD_V_15 : 317|1@1+ (1,0) [0|1] "bool"  ACM
 SG_ OBJ_Angle_Mid_V_15 : 318|1@1+ (1,0) [0|1] "bool"  ACM
 SG_ OBJ_Angle_Mid_15 : 319|14@1+ (0.0002,-1.571) [-1.571|1.571] "rad"  ACM
 SG_ OBJ_Angle_Mid_STD_15 : 336|13@1+ (0.0002,0) [0|1.571] "rad"  ACM
 SG_ OBJ_Angle_Mid_STD_V_15 : 349|1@1+ (1,0) [0|1] "bool"  ACM
 SG_ OBJ_Angle_Bottom_V_15 : 350|1@1+ (1,0) [0|1] "bool"  ACM
 SG_ OBJ_Angle_Bottom_15 : 351|14@1+ (0.0002,-1.571) [-1.571|1.571] "rad"  ACM
 SG_ OBJ_Angle_Bottom_STD_15 : 368|13@1+ (0.0002,0) [0|1.571] "rad"  ACM
 SG_ OBJ_Angle_Bottom_STD_V_15 : 381|1@1+ (1,0) [0|1] "bool"  ACM
 SG_ OBJ_Visibility_Side_V_15 : 382|1@1+ (1,0) [0|1] "bool"  ACM
 SG_ OBJ_Visibility_Side_15 : 383|2@1+ (1,0) [0|2] "ENUM"  ACM
 SG_ OBJ_Is_In_Drivable_Area_15 : 385|1@1+ (1,0) [0|1] "bool"  ACM
 SG_ OBJ_Is_In_Drivable_Area_V_15 : 386|1@1+ (1,0) [0|1] "bool"  ACM
 SG_ OBJ_Is_VeryClose_15 : 387|1@1+ (1,0) [0|1] "bool"  ACM
 SG_ OBJ_Is_VeryClose_V_15 : 388|1@1+ (1,0) [0|1] "bool"  ACM
 SG_ OBJ_Buffer_15 : 389|11@1+ (1,0) [0|0] "NA"  ACM

BO_ 175 ICM_Object_Prot15_A: 64 MyECU
 SG_ ICM_Object_Prot15_A_Header : 0|16@1+ (1,0) [0|65535] ""  ACM
 SG_ OBJ_CRC_15 : 16|32@1+ (1,0) [0|4294967295] "NA"  ACM
 SG_ OBJ_ID_15 : 48|8@1+ (1,0) [0|255] "NA"  ACM
 SG_ OBJ_Existence_Probability_15 : 56|8@1+ (0.01,0) [0|1] "NA"  ACM
 SG_ OBJ_Fusion_Source_15 : 64|16@1+ (1,0) [0|65535] "BITWIZE"  ACM
 SG_ OBJ_Triggered_SDM_15 : 80|2@1+ (1,0) [0|2] "ENUM"  ACM
 SG_ OBJ_Motion_Category_15 : 82|4@1+ (1,0) [0|13] "ENUM "  ACM
 SG_ OBJ_Moving_IN_Probability_15 : 86|7@1+ (0.01,0) [0|0] "NA"  ACM
 SG_ OBJ_Object_Age_15 : 93|11@1+ (1,0) [0|2047] "Frame"  ACM
 SG_ OBJ_Measuring_Status_15 : 104|3@1+ (1,0) [0|7] "BITWIZE"  ACM
 SG_ OBJ_Object_Class_15 : 107|4@1+ (1,0) [0|8] "ENUM"  ACM
 SG_ OBJ_Class_Probability_15 : 112|7@1+ (0.01,0) [0|1] "NA"  ACM
 SG_ OBJ_Car_Probability_15 : 119|7@1+ (0.01,0) [0|0] "NA"  ACM
 SG_ OBJ_Truck_Probability_15 : 126|7@1+ (0.01,0) [0|0] "NA"  ACM
 SG_ OBJ_Bike_Probability_15 : 133|7@1+ (0.01,0) [0|0] "NA"  ACM
 SG_ OBJ_Camera_Source_15 : 140|4@1+ (1,0) [0|15] "ENUM"  ACM
 SG_ OBJ_Motion_Status_15 : 144|3@1+ (1,0) [0|5] "ENUM "  ACM
 SG_ OBJ_Motion_Orientation_15 : 147|4@1+ (1,0) [0|13] "ENUM "  ACM
 SG_ OBJ_Has_Cut_Lane_15 : 151|1@1+ (1,0) [0|1] "bool"  ACM
 SG_ OBJ_Has_Cut_Path_15 : 152|1@1+ (1,0) [0|1] "bool"  ACM
 SG_ OBJ_Brake_Light_15 : 153|1@1+ (1,0) [0|1] "bool"  ACM
 SG_ OBJ_Turn_Indicator_Right_15 : 154|1@1+ (1,0) [0|1] "bool"  ACM
 SG_ OBJ_Turn_Indicator_Left_15 : 155|1@1+ (1,0) [0|1] "bool"  ACM
 SG_ OBJ_Light_Indicator_Validity_15 : 156|1@1+ (1,0) [0|1] "bool"  ACM
 SG_ OBJ_Right_Out_Of_Image_15 : 157|1@1+ (1,0) [0|1] "bool"  ACM
 SG_ OBJ_Left_Out_Of_Image_15 : 158|1@1+ (1,0) [0|1] "bool"  ACM
 SG_ OBJ_Right_Out_Of_Image_V_15 : 159|1@1+ (1,0) [0|1] "bool"  ACM
 SG_ OBJ_Left_Out_Of_Image_V_15 : 160|1@1+ (1,0) [0|1] "bool"  ACM
 SG_ OBJ_Top_Out_Of_Image_15 : 161|1@1+ (1,0) [0|1] "bool"  ACM
 SG_ OBJ_Bottom_Out_Of_Image_15 : 162|1@1+ (1,0) [0|1] "bool"  ACM
 SG_ OBJ_Top_Out_Of_Image_V_15 : 163|1@1+ (1,0) [0|1] "bool"  ACM
 SG_ OBJ_Bottom_Out_Of_Image_V_15 : 164|1@1+ (1,0) [0|1] "bool"  ACM
 SG_ OBJ_Lane_Assignment_15 : 165|3@1+ (1,0) [0|5] "ENUM"  ACM
 SG_ OBJ_Lane_Assignment_V_15 : 168|1@1+ (1,0) [0|1] "bool"  ACM
 SG_ OBJ_Age_Seconds_15 : 169|7@1+ (1,0) [0|100] "s"  ACM
 SG_ OBJ_Age_Seconds_V_15 : 176|1@1+ (1,0) [0|1] "bool"  ACM
 SG_ OBJ_Width_15 : 177|9@1+ (0.01,0) [0.4|2.95] "m"  ACM
 SG_ OBJ_Width_V_15 : 186|1@1+ (1,0) [0|1] "bool"  ACM
 SG_ OBJ_Width_STD_15 : 187|8@1+ (0.01,0) [0|2] "m"  ACM
 SG_ OBJ_Width_STD_V_15 : 195|1@1+ (1,0) [0|1] "bool"  ACM
 SG_ OBJ_Length_15 : 196|9@1+ (0.05,0) [1.2|21] "m"  ACM
 SG_ OBJ_Length_V_15 : 205|1@1+ (1,0) [0|1] "bool"  ACM
 SG_ OBJ_Length_STD_15 : 208|8@1+ (0.05,0) [0|10] "m"  ACM
 SG_ OBJ_Length_STD_V_15 : 216|1@1+ (1,0) [0|1] "bool"  ACM
 SG_ OBJ_Height_15 : 217|9@1+ (0.01,0) [0|2.95] "m"  ACM
 SG_ OBJ_Height_V_15 : 226|1@1+ (1,0) [0|1] "bool"  ACM
 SG_ OBJ_Height_STD_15 : 227|8@1+ (0.01,0) [0|2] "m"  ACM
 SG_ OBJ_Height_STD_V_15 : 235|1@1+ (1,0) [0|1] "bool"  ACM
 SG_ OBJ_Abs_Long_Velocity_15 : 240|12@1+ (0.05,-30) [-30|100] "MPS"  ACM
 SG_ OBJ_Abs_Long_Velocity_V_15 : 252|1@1+ (1,0) [0|1] "bool"  ACM
 SG_ OBJ_Abs_Long_Velocity_STD_15 : 253|11@1+ (0.05,0) [0|65] "MPS"  ACM
 SG_ OBJ_Abs_Long_Vel_STD_V_15 : 264|1@1+ (1,0) [0|1] "bool"  ACM
 SG_ OBJ_Abs_Lat_Velocity_15 : 272|11@1+ (0.05,-50) [-50|50] "MPS"  ACM
 SG_ OBJ_Abs_Lat_Velocity_V_15 : 283|1@1+ (1,0) [0|1] "bool"  ACM
 SG_ OBJ_Abs_Lat_Velocity_STD_15 : 284|10@1+ (0.05,0) [0|50] "MPS"  ACM
 SG_ OBJ_Abs_Lat_Vel_STD_V_15 : 294|1@1+ (1,0) [0|1] "bool"  ACM
 SG_ OBJ_Abs_Long_Acc_15 : 295|9@1+ (0.05,-10.3) [-10.3|7.3] "MPS2"  ACM
 SG_ OBJ_Abs_Long_Acc_V_15 : 304|1@1+ (1,0) [0|1] "bool"  ACM
 SG_ OBJ_Abs_Long_Acc_STD_15 : 305|8@1+ (0.05,0) [0|7.3] "MPS2"  ACM
 SG_ OBJ_Abs_Long_Acc_STD_V_15 : 313|1@1+ (1,0) [0|1] "bool"  ACM
 SG_ OBJ_Abs_Lat_Acc_15 : 314|9@1+ (0.05,-10.3) [-10.3|7.3] "MPS2"  ACM
 SG_ OBJ_Abs_Lat_Acc_V_15 : 323|1@1+ (1,0) [0|1] "bool"  ACM
 SG_ OBJ_Abs_Lat_Acc_STD_15 : 324|8@1+ (0.05,0) [0|7.3] "MPS2"  ACM
 SG_ OBJ_Abs_Lat_Acc_STD_V_15 : 332|1@1+ (1,0) [0|1] "bool"  ACM
 SG_ OBJ_Abs_Acceleration_15 : 336|9@1+ (0.05,-10.3) [-10.3|7.3] "MPS2"  ACM
 SG_ OBJ_Abs_Acceleration_V_15 : 345|1@1+ (1,0) [0|1] "bool"  ACM
 SG_ OBJ_Abs_Acc_STD_15 : 346|8@1+ (0.05,0) [0|7.3] "MPS2"  ACM
 SG_ OBJ_Abs_Acc_STD_V_15 : 354|1@1+ (1,0) [0|1] "bool"  ACM
 SG_ OBJ_Inv_TTC_15 : 355|11@1+ (0.01,-8) [-8|8] "INV(s)"  ACM
 SG_ OBJ_Inv_TTC_V_15 : 366|1@1+ (1,0) [0|1] "bool"  ACM
 SG_ OBJ_Inv_TTC_STD_15 : 368|11@1+ (0.01,0) [0|4] "INV(s)"  ACM
 SG_ OBJ_Inv_TTC_STD_V_15 : 379|1@1+ (1,0) [0|1] "bool"  ACM
 SG_ OBJ_Relative_Long_Acc_15 : 380|9@1+ (0.05,-10.3) [-10.3|7.3] "MPS2"  ACM
 SG_ OBJ_Relative_Long_Acc_V_15 : 389|1@1+ (1,0) [0|1] "bool"  ACM
 SG_ OBJ_Relative_Long_Acc_STD_15 : 390|8@1+ (0.05,0) [0|7.3] "MPS2"  ACM
 SG_ OBJ_Rel_Long_Acc_STD_V_15 : 398|1@1+ (1,0) [0|1] "bool"  ACM

BO_ 174 ICM_Object_Prot14_B: 64 MyECU
 SG_ ICM_Object_Prot14_B_Header : 0|16@1+ (1,0) [0|65535] ""  ACM
 SG_ OBJ_Relative_Long_Velocity_14 : 16|13@1+ (0.05,-120) [-120|130] "MPS"  ACM
 SG_ OBJ_Relative_Long_Velocity_V_14 : 29|1@1+ (1,0) [0|1] "bool"  ACM
 SG_ OBJ_Relative_Long_Vel_STD_14 : 30|12@1+ (0.05,0) [0|130] "MPS"  ACM
 SG_ OBJ_Rel_Long_Vel_STD_V_14 : 42|1@1+ (1,0) [0|1] "bool"  ACM
 SG_ OBJ_Relative_Lat_Velocity_14 : 48|11@1+ (0.05,-50) [-50|50] "MPS"  ACM
 SG_ OBJ_Relative_Lat_Velocity_V_14 : 59|1@1+ (1,0) [0|1] "bool"  ACM
 SG_ OBJ_Relative_Lat_Velocity_STD_14 : 60|10@1+ (0.05,0) [0|50] "MPS"  ACM
 SG_ OBJ_Rel_Lat_Vel_STD_V_14 : 70|1@1+ (1,0) [0|1] "bool"  ACM
 SG_ OBJ_Long_Distance_14 : 80|14@1+ (0.05,-200) [-200|250] "m"  ACM
 SG_ OBJ_Long_Distance_V_14 : 94|1@1+ (1,0) [0|1] "bool"  ACM
 SG_ OBJ_Long_Distance_STD_14 : 95|13@1+ (0.05,0) [0|250] "m"  ACM
 SG_ OBJ_Long_Distance_STD_V_14 : 108|1@1+ (1,0) [0|1] "bool"  ACM
 SG_ OBJ_Lat_Distance_14 : 112|12@1+ (0.05,-100) [-100|100] "m"  ACM
 SG_ OBJ_Lat_Distance_V_14 : 124|1@1+ (1,0) [0|1] "bool"  ACM
 SG_ OBJ_Lat_Distance_STD_14 : 125|11@1+ (0.05,0) [0|100] "m"  ACM
 SG_ OBJ_Lat_Distance_STD_V_14 : 136|1@1+ (1,0) [0|1] "bool"  ACM
 SG_ OBJ_Absolute_Speed_14 : 144|12@1+ (0.05,-65) [-65|65] "MPS"  ACM
 SG_ OBJ_Absolute_Speed_V_14 : 156|1@1+ (1,0) [0|1] "bool"  ACM
 SG_ OBJ_Absolute_Speed_STD_14 : 157|11@1+ (0.05,-65) [0|65] "MPS"  ACM
 SG_ OBJ_Absolute_Speed_STD_V_14 : 168|1@1+ (1,0) [0|1] "bool"  ACM
 SG_ OBJ_Heading_14 : 176|10@1+ (0.01,-3.14) [-3.14|3.14] "rad"  ACM
 SG_ OBJ_Heading_V_14 : 186|1@1+ (1,0) [0|1] "bool"  ACM
 SG_ OBJ_Heading_STD_14 : 187|9@1+ (0.01,0) [0|3.14] "rad"  ACM
 SG_ OBJ_Heading_STD_V_14 : 196|1@1+ (1,0) [0|1] "bool"  ACM
 SG_ OBJ_Angle_Rate_STD_14 : 197|11@1+ (0.002,0) [0|2.2318] "RPS"  ACM
 SG_ OBJ_Angle_Rate_STD_V_14 : 208|1@1+ (1,0) [0|1] "bool"  ACM
 SG_ OBJ_Angle_Rate_14 : 209|12@1+ (0.002,-2.234) [-2.234|2.2318] "RPS"  ACM
 SG_ OBJ_Angle_Rate_V_14 : 221|1@1+ (1,0) [0|1] "bool"  ACM
 SG_ OBJ_Angle_Right_14 : 222|14@1+ (0.0002,-1.571) [-1.571|1.571] "rad "  ACM
 SG_ OBJ_Angle_Right_V_14 : 236|1@1+ (1,0) [0|1] "bool"  ACM
 SG_ OBJ_Angle_Right_STD_14 : 240|13@1+ (0.0002,0) [0|1.571] "rad "  ACM
 SG_ OBJ_Angle_Right_STD_V_14 : 253|1@1+ (1,0) [0|1] "bool"  ACM
 SG_ OBJ_Angle_Left_14 : 254|14@1+ (0.0002,-1.571) [-1.571|1.571] "rad "  ACM
 SG_ OBJ_Angle_Left_V_14 : 268|1@1+ (1,0) [0|1] "bool"  ACM
 SG_ OBJ_Angle_Left_STD_14 : 272|13@1+ (0.0002,0) [0|1.571] "rad"  ACM
 SG_ OBJ_Angle_Left_STD_V_14 : 285|1@1+ (1,0) [0|1] "bool"  ACM
 SG_ OBJ_Angle_Side_14 : 286|14@1+ (0.0002,-1.571) [-1.571|1.571] "rad"  ACM
 SG_ OBJ_Angle_Side_V_14 : 300|1@1+ (1,0) [0|1] "bool"  ACM
 SG_ OBJ_Angle_Side_STD_14 : 304|13@1+ (0.0002,0) [0|1.571] "rad"  ACM
 SG_ OBJ_Angle_Side_STD_V_14 : 317|1@1+ (1,0) [0|1] "bool"  ACM
 SG_ OBJ_Angle_Mid_V_14 : 318|1@1+ (1,0) [0|1] "bool"  ACM
 SG_ OBJ_Angle_Mid_14 : 319|14@1+ (0.0002,-1.571) [-1.571|1.571] "rad"  ACM
 SG_ OBJ_Angle_Mid_STD_14 : 336|13@1+ (0.0002,0) [0|1.571] "rad"  ACM
 SG_ OBJ_Angle_Mid_STD_V_14 : 349|1@1+ (1,0) [0|1] "bool"  ACM
 SG_ OBJ_Angle_Bottom_V_14 : 350|1@1+ (1,0) [0|1] "bool"  ACM
 SG_ OBJ_Angle_Bottom_14 : 351|14@1+ (0.0002,-1.571) [-1.571|1.571] "rad"  ACM
 SG_ OBJ_Angle_Bottom_STD_14 : 368|13@1+ (0.0002,0) [0|1.571] "rad"  ACM
 SG_ OBJ_Angle_Bottom_STD_V_14 : 381|1@1+ (1,0) [0|1] "bool"  ACM
 SG_ OBJ_Visibility_Side_V_14 : 382|1@1+ (1,0) [0|1] "bool"  ACM
 SG_ OBJ_Visibility_Side_14 : 383|2@1+ (1,0) [0|2] "ENUM"  ACM
 SG_ OBJ_Is_In_Drivable_Area_14 : 385|1@1+ (1,0) [0|1] "bool"  ACM
 SG_ OBJ_Is_In_Drivable_Area_V_14 : 386|1@1+ (1,0) [0|1] "bool"  ACM
 SG_ OBJ_Is_VeryClose_14 : 387|1@1+ (1,0) [0|1] "bool"  ACM
 SG_ OBJ_Is_VeryClose_V_14 : 388|1@1+ (1,0) [0|1] "bool"  ACM
 SG_ OBJ_Buffer_14 : 389|11@1+ (1,0) [0|0] "NA"  ACM

BO_ 173 ICM_Object_Prot14_A: 64 MyECU
 SG_ ICM_Object_Prot14_A_Header : 0|16@1+ (1,0) [0|65535] ""  ACM
 SG_ OBJ_CRC_14 : 16|32@1+ (1,0) [0|4294967295] "NA"  ACM
 SG_ OBJ_ID_14 : 48|8@1+ (1,0) [0|255] "NA"  ACM
 SG_ OBJ_Existence_Probability_14 : 56|8@1+ (0.01,0) [0|1] "NA"  ACM
 SG_ OBJ_Fusion_Source_14 : 64|16@1+ (1,0) [0|65535] "BITWIZE"  ACM
 SG_ OBJ_Triggered_SDM_14 : 80|2@1+ (1,0) [0|2] "ENUM"  ACM
 SG_ OBJ_Motion_Category_14 : 82|4@1+ (1,0) [0|13] "ENUM "  ACM
 SG_ OBJ_Moving_IN_Probability_14 : 86|7@1+ (0.01,0) [0|0] "NA"  ACM
 SG_ OBJ_Object_Age_14 : 93|11@1+ (1,0) [0|2047] "Frame"  ACM
 SG_ OBJ_Measuring_Status_14 : 104|3@1+ (1,0) [0|7] "BITWIZE"  ACM
 SG_ OBJ_Object_Class_14 : 107|4@1+ (1,0) [0|8] "ENUM"  ACM
 SG_ OBJ_Class_Probability_14 : 112|7@1+ (0.01,0) [0|1] "NA"  ACM
 SG_ OBJ_Car_Probability_14 : 119|7@1+ (0.01,0) [0|0] "NA"  ACM
 SG_ OBJ_Truck_Probability_14 : 126|7@1+ (0.01,0) [0|0] "NA"  ACM
 SG_ OBJ_Bike_Probability_14 : 133|7@1+ (0.01,0) [0|0] "NA"  ACM
 SG_ OBJ_Camera_Source_14 : 140|4@1+ (1,0) [0|15] "ENUM"  ACM
 SG_ OBJ_Motion_Status_14 : 144|3@1+ (1,0) [0|5] "ENUM "  ACM
 SG_ OBJ_Motion_Orientation_14 : 147|4@1+ (1,0) [0|13] "ENUM "  ACM
 SG_ OBJ_Has_Cut_Lane_14 : 151|1@1+ (1,0) [0|1] "bool"  ACM
 SG_ OBJ_Has_Cut_Path_14 : 152|1@1+ (1,0) [0|1] "bool"  ACM
 SG_ OBJ_Brake_Light_14 : 153|1@1+ (1,0) [0|1] "bool"  ACM
 SG_ OBJ_Turn_Indicator_Right_14 : 154|1@1+ (1,0) [0|1] "bool"  ACM
 SG_ OBJ_Turn_Indicator_Left_14 : 155|1@1+ (1,0) [0|1] "bool"  ACM
 SG_ OBJ_Light_Indicator_Validity_14 : 156|1@1+ (1,0) [0|1] "bool"  ACM
 SG_ OBJ_Right_Out_Of_Image_14 : 157|1@1+ (1,0) [0|1] "bool"  ACM
 SG_ OBJ_Left_Out_Of_Image_14 : 158|1@1+ (1,0) [0|1] "bool"  ACM
 SG_ OBJ_Right_Out_Of_Image_V_14 : 159|1@1+ (1,0) [0|1] "bool"  ACM
 SG_ OBJ_Left_Out_Of_Image_V_14 : 160|1@1+ (1,0) [0|1] "bool"  ACM
 SG_ OBJ_Top_Out_Of_Image_14 : 161|1@1+ (1,0) [0|1] "bool"  ACM
 SG_ OBJ_Bottom_Out_Of_Image_14 : 162|1@1+ (1,0) [0|1] "bool"  ACM
 SG_ OBJ_Top_Out_Of_Image_V_14 : 163|1@1+ (1,0) [0|1] "bool"  ACM
 SG_ OBJ_Bottom_Out_Of_Image_V_14 : 164|1@1+ (1,0) [0|1] "bool"  ACM
 SG_ OBJ_Lane_Assignment_14 : 165|3@1+ (1,0) [0|5] "ENUM"  ACM
 SG_ OBJ_Lane_Assignment_V_14 : 168|1@1+ (1,0) [0|1] "bool"  ACM
 SG_ OBJ_Age_Seconds_14 : 169|7@1+ (1,0) [0|100] "s"  ACM
 SG_ OBJ_Age_Seconds_V_14 : 176|1@1+ (1,0) [0|1] "bool"  ACM
 SG_ OBJ_Width_14 : 177|9@1+ (0.01,0) [0.4|2.95] "m"  ACM
 SG_ OBJ_Width_V_14 : 186|1@1+ (1,0) [0|1] "bool"  ACM
 SG_ OBJ_Width_STD_14 : 187|8@1+ (0.01,0) [0|2] "m"  ACM
 SG_ OBJ_Width_STD_V_14 : 195|1@1+ (1,0) [0|1] "bool"  ACM
 SG_ OBJ_Length_14 : 196|9@1+ (0.05,0) [1.2|21] "m"  ACM
 SG_ OBJ_Length_V_14 : 205|1@1+ (1,0) [0|1] "bool"  ACM
 SG_ OBJ_Length_STD_14 : 208|8@1+ (0.05,0) [0|10] "m"  ACM
 SG_ OBJ_Length_STD_V_14 : 216|1@1+ (1,0) [0|1] "bool"  ACM
 SG_ OBJ_Height_14 : 217|9@1+ (0.01,0) [0|2.95] "m"  ACM
 SG_ OBJ_Height_V_14 : 226|1@1+ (1,0) [0|1] "bool"  ACM
 SG_ OBJ_Height_STD_14 : 227|8@1+ (0.01,0) [0|2] "m"  ACM
 SG_ OBJ_Height_STD_V_14 : 235|1@1+ (1,0) [0|1] "bool"  ACM
 SG_ OBJ_Abs_Long_Velocity_14 : 240|12@1+ (0.05,-30) [-30|100] "MPS"  ACM
 SG_ OBJ_Abs_Long_Velocity_V_14 : 252|1@1+ (1,0) [0|1] "bool"  ACM
 SG_ OBJ_Abs_Long_Velocity_STD_14 : 253|11@1+ (0.05,0) [0|65] "MPS"  ACM
 SG_ OBJ_Abs_Long_Vel_STD_V_14 : 264|1@1+ (1,0) [0|1] "bool"  ACM
 SG_ OBJ_Abs_Lat_Velocity_14 : 272|11@1+ (0.05,-50) [-50|50] "MPS"  ACM
 SG_ OBJ_Abs_Lat_Velocity_V_14 : 283|1@1+ (1,0) [0|1] "bool"  ACM
 SG_ OBJ_Abs_Lat_Velocity_STD_14 : 284|10@1+ (0.05,0) [0|50] "MPS"  ACM
 SG_ OBJ_Abs_Lat_Vel_STD_V_14 : 294|1@1+ (1,0) [0|1] "bool"  ACM
 SG_ OBJ_Abs_Long_Acc_14 : 295|9@1+ (0.05,-10.3) [-10.3|7.3] "MPS2"  ACM
 SG_ OBJ_Abs_Long_Acc_V_14 : 304|1@1+ (1,0) [0|1] "bool"  ACM
 SG_ OBJ_Abs_Long_Acc_STD_14 : 305|8@1+ (0.05,0) [0|7.3] "MPS2"  ACM
 SG_ OBJ_Abs_Long_Acc_STD_V_14 : 313|1@1+ (1,0) [0|1] "bool"  ACM
 SG_ OBJ_Abs_Lat_Acc_14 : 314|9@1+ (0.05,-10.3) [-10.3|7.3] "MPS2"  ACM
 SG_ OBJ_Abs_Lat_Acc_V_14 : 323|1@1+ (1,0) [0|1] "bool"  ACM
 SG_ OBJ_Abs_Lat_Acc_STD_14 : 324|8@1+ (0.05,0) [0|7.3] "MPS2"  ACM
 SG_ OBJ_Abs_Lat_Acc_STD_V_14 : 332|1@1+ (1,0) [0|1] "bool"  ACM
 SG_ OBJ_Abs_Acceleration_14 : 336|9@1+ (0.05,-10.3) [-10.3|7.3] "MPS2"  ACM
 SG_ OBJ_Abs_Acceleration_V_14 : 345|1@1+ (1,0) [0|1] "bool"  ACM
 SG_ OBJ_Abs_Acc_STD_14 : 346|8@1+ (0.05,0) [0|7.3] "MPS2"  ACM
 SG_ OBJ_Abs_Acc_STD_V_14 : 354|1@1+ (1,0) [0|1] "bool"  ACM
 SG_ OBJ_Inv_TTC_14 : 355|11@1+ (0.01,-8) [-8|8] "INV(s)"  ACM
 SG_ OBJ_Inv_TTC_V_14 : 366|1@1+ (1,0) [0|1] "bool"  ACM
 SG_ OBJ_Inv_TTC_STD_14 : 368|11@1+ (0.01,0) [0|4] "INV(s)"  ACM
 SG_ OBJ_Inv_TTC_STD_V_14 : 379|1@1+ (1,0) [0|1] "bool"  ACM
 SG_ OBJ_Relative_Long_Acc_14 : 380|9@1+ (0.05,-10.3) [-10.3|7.3] "MPS2"  ACM
 SG_ OBJ_Relative_Long_Acc_V_14 : 389|1@1+ (1,0) [0|1] "bool"  ACM
 SG_ OBJ_Relative_Long_Acc_STD_14 : 390|8@1+ (0.05,0) [0|7.3] "MPS2"  ACM
 SG_ OBJ_Rel_Long_Acc_STD_V_14 : 398|1@1+ (1,0) [0|1] "bool"  ACM

BO_ 172 ICM_Object_Prot13_B: 64 MyECU
 SG_ ICM_Object_Prot13_B_Header : 0|16@1+ (1,0) [0|65535] ""  ACM
 SG_ OBJ_Relative_Long_Velocity_13 : 16|13@1+ (0.05,-120) [-120|130] "MPS"  ACM
 SG_ OBJ_Relative_Long_Velocity_V_13 : 29|1@1+ (1,0) [0|1] "bool"  ACM
 SG_ OBJ_Relative_Long_Vel_STD_13 : 30|12@1+ (0.05,0) [0|130] "MPS"  ACM
 SG_ OBJ_Rel_Long_Vel_STD_V_13 : 42|1@1+ (1,0) [0|1] "bool"  ACM
 SG_ OBJ_Relative_Lat_Velocity_13 : 48|11@1+ (0.05,-50) [-50|50] "MPS"  ACM
 SG_ OBJ_Relative_Lat_Velocity_V_13 : 59|1@1+ (1,0) [0|1] "bool"  ACM
 SG_ OBJ_Relative_Lat_Velocity_STD_13 : 60|10@1+ (0.05,0) [0|50] "MPS"  ACM
 SG_ OBJ_Rel_Lat_Vel_STD_V_13 : 70|1@1+ (1,0) [0|1] "bool"  ACM
 SG_ OBJ_Long_Distance_13 : 80|14@1+ (0.05,-200) [-200|250] "m"  ACM
 SG_ OBJ_Long_Distance_V_13 : 94|1@1+ (1,0) [0|1] "bool"  ACM
 SG_ OBJ_Long_Distance_STD_13 : 95|13@1+ (0.05,0) [0|250] "m"  ACM
 SG_ OBJ_Long_Distance_STD_V_13 : 108|1@1+ (1,0) [0|1] "bool"  ACM
 SG_ OBJ_Lat_Distance_13 : 112|12@1+ (0.05,-100) [-100|100] "m"  ACM
 SG_ OBJ_Lat_Distance_V_13 : 124|1@1+ (1,0) [0|1] "bool"  ACM
 SG_ OBJ_Lat_Distance_STD_13 : 125|11@1+ (0.05,0) [0|100] "m"  ACM
 SG_ OBJ_Lat_Distance_STD_V_13 : 136|1@1+ (1,0) [0|1] "bool"  ACM
 SG_ OBJ_Absolute_Speed_13 : 144|12@1+ (0.05,-65) [-65|65] "MPS"  ACM
 SG_ OBJ_Absolute_Speed_V_13 : 156|1@1+ (1,0) [0|1] "bool"  ACM
 SG_ OBJ_Absolute_Speed_STD_13 : 157|11@1+ (0.05,-65) [0|65] "MPS"  ACM
 SG_ OBJ_Absolute_Speed_STD_V_13 : 168|1@1+ (1,0) [0|1] "bool"  ACM
 SG_ OBJ_Heading_13 : 176|10@1+ (0.01,-3.14) [-3.14|3.14] "rad"  ACM
 SG_ OBJ_Heading_V_13 : 186|1@1+ (1,0) [0|1] "bool"  ACM
 SG_ OBJ_Heading_STD_13 : 187|9@1+ (0.01,0) [0|3.14] "rad"  ACM
 SG_ OBJ_Heading_STD_V_13 : 196|1@1+ (1,0) [0|1] "bool"  ACM
 SG_ OBJ_Angle_Rate_STD_13 : 197|11@1+ (0.002,0) [0|2.2318] "RPS"  ACM
 SG_ OBJ_Angle_Rate_STD_V_13 : 208|1@1+ (1,0) [0|1] "bool"  ACM
 SG_ OBJ_Angle_Rate_13 : 209|12@1+ (0.002,-2.234) [-2.234|2.2318] "RPS"  ACM
 SG_ OBJ_Angle_Rate_V_13 : 221|1@1+ (1,0) [0|1] "bool"  ACM
 SG_ OBJ_Angle_Right_13 : 222|14@1+ (0.0002,-1.571) [-1.571|1.571] "rad "  ACM
 SG_ OBJ_Angle_Right_V_13 : 236|1@1+ (1,0) [0|1] "bool"  ACM
 SG_ OBJ_Angle_Right_STD_13 : 240|13@1+ (0.0002,0) [0|1.571] "rad "  ACM
 SG_ OBJ_Angle_Right_STD_V_13 : 253|1@1+ (1,0) [0|1] "bool"  ACM
 SG_ OBJ_Angle_Left_13 : 254|14@1+ (0.0002,-1.571) [-1.571|1.571] "rad "  ACM
 SG_ OBJ_Angle_Left_V_13 : 268|1@1+ (1,0) [0|1] "bool"  ACM
 SG_ OBJ_Angle_Left_STD_13 : 272|13@1+ (0.0002,0) [0|1.571] "rad"  ACM
 SG_ OBJ_Angle_Left_STD_V_13 : 285|1@1+ (1,0) [0|1] "bool"  ACM
 SG_ OBJ_Angle_Side_13 : 286|14@1+ (0.0002,-1.571) [-1.571|1.571] "rad"  ACM
 SG_ OBJ_Angle_Side_V_13 : 300|1@1+ (1,0) [0|1] "bool"  ACM
 SG_ OBJ_Angle_Side_STD_13 : 304|13@1+ (0.0002,0) [0|1.571] "rad"  ACM
 SG_ OBJ_Angle_Side_STD_V_13 : 317|1@1+ (1,0) [0|1] "bool"  ACM
 SG_ OBJ_Angle_Mid_V_13 : 318|1@1+ (1,0) [0|1] "bool"  ACM
 SG_ OBJ_Angle_Mid_13 : 319|14@1+ (0.0002,-1.571) [-1.571|1.571] "rad"  ACM
 SG_ OBJ_Angle_Mid_STD_13 : 336|13@1+ (0.0002,0) [0|1.571] "rad"  ACM
 SG_ OBJ_Angle_Mid_STD_V_13 : 349|1@1+ (1,0) [0|1] "bool"  ACM
 SG_ OBJ_Angle_Bottom_V_13 : 350|1@1+ (1,0) [0|1] "bool"  ACM
 SG_ OBJ_Angle_Bottom_13 : 351|14@1+ (0.0002,-1.571) [-1.571|1.571] "rad"  ACM
 SG_ OBJ_Angle_Bottom_STD_13 : 368|13@1+ (0.0002,0) [0|1.571] "rad"  ACM
 SG_ OBJ_Angle_Bottom_STD_V_13 : 381|1@1+ (1,0) [0|1] "bool"  ACM
 SG_ OBJ_Visibility_Side_V_13 : 382|1@1+ (1,0) [0|1] "bool"  ACM
 SG_ OBJ_Visibility_Side_13 : 383|2@1+ (1,0) [0|2] "ENUM"  ACM
 SG_ OBJ_Is_In_Drivable_Area_13 : 385|1@1+ (1,0) [0|1] "bool"  ACM
 SG_ OBJ_Is_In_Drivable_Area_V_13 : 386|1@1+ (1,0) [0|1] "bool"  ACM
 SG_ OBJ_Is_VeryClose_13 : 387|1@1+ (1,0) [0|1] "bool"  ACM
 SG_ OBJ_Is_VeryClose_V_13 : 388|1@1+ (1,0) [0|1] "bool"  ACM
 SG_ OBJ_Buffer_13 : 389|11@1+ (1,0) [0|0] "NA"  ACM

BO_ 171 ICM_Object_Prot13_A: 64 MyECU
 SG_ ICM_Object_Prot13_A_Header : 0|16@1+ (1,0) [0|65535] ""  ACM
 SG_ OBJ_CRC_13 : 16|32@1+ (1,0) [0|4294967295] "NA"  ACM
 SG_ OBJ_ID_13 : 48|8@1+ (1,0) [0|255] "NA"  ACM
 SG_ OBJ_Existence_Probability_13 : 56|8@1+ (0.01,0) [0|1] "NA"  ACM
 SG_ OBJ_Fusion_Source_13 : 64|16@1+ (1,0) [0|65535] "BITWIZE"  ACM
 SG_ OBJ_Triggered_SDM_13 : 80|2@1+ (1,0) [0|2] "ENUM"  ACM
 SG_ OBJ_Motion_Category_13 : 82|4@1+ (1,0) [0|13] "ENUM "  ACM
 SG_ OBJ_Moving_IN_Probability_13 : 86|7@1+ (0.01,0) [0|0] "NA"  ACM
 SG_ OBJ_Object_Age_13 : 93|11@1+ (1,0) [0|2047] "Frame"  ACM
 SG_ OBJ_Measuring_Status_13 : 104|3@1+ (1,0) [0|7] "BITWIZE"  ACM
 SG_ OBJ_Object_Class_13 : 107|4@1+ (1,0) [0|8] "ENUM"  ACM
 SG_ OBJ_Class_Probability_13 : 112|7@1+ (0.01,0) [0|1] "NA"  ACM
 SG_ OBJ_Car_Probability_13 : 119|7@1+ (0.01,0) [0|0] "NA"  ACM
 SG_ OBJ_Truck_Probability_13 : 126|7@1+ (0.01,0) [0|0] "NA"  ACM
 SG_ OBJ_Bike_Probability_13 : 133|7@1+ (0.01,0) [0|0] "NA"  ACM
 SG_ OBJ_Camera_Source_13 : 140|4@1+ (1,0) [0|15] "ENUM"  ACM
 SG_ OBJ_Motion_Status_13 : 144|3@1+ (1,0) [0|5] "ENUM "  ACM
 SG_ OBJ_Motion_Orientation_13 : 147|4@1+ (1,0) [0|13] "ENUM "  ACM
 SG_ OBJ_Has_Cut_Lane_13 : 151|1@1+ (1,0) [0|1] "bool"  ACM
 SG_ OBJ_Has_Cut_Path_13 : 152|1@1+ (1,0) [0|1] "bool"  ACM
 SG_ OBJ_Brake_Light_13 : 153|1@1+ (1,0) [0|1] "bool"  ACM
 SG_ OBJ_Turn_Indicator_Right_13 : 154|1@1+ (1,0) [0|1] "bool"  ACM
 SG_ OBJ_Turn_Indicator_Left_13 : 155|1@1+ (1,0) [0|1] "bool"  ACM
 SG_ OBJ_Light_Indicator_Validity_13 : 156|1@1+ (1,0) [0|1] "bool"  ACM
 SG_ OBJ_Right_Out_Of_Image_13 : 157|1@1+ (1,0) [0|1] "bool"  ACM
 SG_ OBJ_Left_Out_Of_Image_13 : 158|1@1+ (1,0) [0|1] "bool"  ACM
 SG_ OBJ_Right_Out_Of_Image_V_13 : 159|1@1+ (1,0) [0|1] "bool"  ACM
 SG_ OBJ_Left_Out_Of_Image_V_13 : 160|1@1+ (1,0) [0|1] "bool"  ACM
 SG_ OBJ_Top_Out_Of_Image_13 : 161|1@1+ (1,0) [0|1] "bool"  ACM
 SG_ OBJ_Bottom_Out_Of_Image_13 : 162|1@1+ (1,0) [0|1] "bool"  ACM
 SG_ OBJ_Top_Out_Of_Image_V_13 : 163|1@1+ (1,0) [0|1] "bool"  ACM
 SG_ OBJ_Bottom_Out_Of_Image_V_13 : 164|1@1+ (1,0) [0|1] "bool"  ACM
 SG_ OBJ_Lane_Assignment_13 : 165|3@1+ (1,0) [0|5] "ENUM"  ACM
 SG_ OBJ_Lane_Assignment_V_13 : 168|1@1+ (1,0) [0|1] "bool"  ACM
 SG_ OBJ_Age_Seconds_13 : 169|7@1+ (1,0) [0|100] "s"  ACM
 SG_ OBJ_Age_Seconds_V_13 : 176|1@1+ (1,0) [0|1] "bool"  ACM
 SG_ OBJ_Width_13 : 177|9@1+ (0.01,0) [0.4|2.95] "m"  ACM
 SG_ OBJ_Width_V_13 : 186|1@1+ (1,0) [0|1] "bool"  ACM
 SG_ OBJ_Width_STD_13 : 187|8@1+ (0.01,0) [0|2] "m"  ACM
 SG_ OBJ_Width_STD_V_13 : 195|1@1+ (1,0) [0|1] "bool"  ACM
 SG_ OBJ_Length_13 : 196|9@1+ (0.05,0) [1.2|21] "m"  ACM
 SG_ OBJ_Length_V_13 : 205|1@1+ (1,0) [0|1] "bool"  ACM
 SG_ OBJ_Length_STD_13 : 208|8@1+ (0.05,0) [0|10] "m"  ACM
 SG_ OBJ_Length_STD_V_13 : 216|1@1+ (1,0) [0|1] "bool"  ACM
 SG_ OBJ_Height_13 : 217|9@1+ (0.01,0) [0|2.95] "m"  ACM
 SG_ OBJ_Height_V_13 : 226|1@1+ (1,0) [0|1] "bool"  ACM
 SG_ OBJ_Height_STD_13 : 227|8@1+ (0.01,0) [0|2] "m"  ACM
 SG_ OBJ_Height_STD_V_13 : 235|1@1+ (1,0) [0|1] "bool"  ACM
 SG_ OBJ_Abs_Long_Velocity_13 : 240|12@1+ (0.05,-30) [-30|100] "MPS"  ACM
 SG_ OBJ_Abs_Long_Velocity_V_13 : 252|1@1+ (1,0) [0|1] "bool"  ACM
 SG_ OBJ_Abs_Long_Velocity_STD_13 : 253|11@1+ (0.05,0) [0|65] "MPS"  ACM
 SG_ OBJ_Abs_Long_Vel_STD_V_13 : 264|1@1+ (1,0) [0|1] "bool"  ACM
 SG_ OBJ_Abs_Lat_Velocity_13 : 272|11@1+ (0.05,-50) [-50|50] "MPS"  ACM
 SG_ OBJ_Abs_Lat_Velocity_V_13 : 283|1@1+ (1,0) [0|1] "bool"  ACM
 SG_ OBJ_Abs_Lat_Velocity_STD_13 : 284|10@1+ (0.05,0) [0|50] "MPS"  ACM
 SG_ OBJ_Abs_Lat_Vel_STD_V_13 : 294|1@1+ (1,0) [0|1] "bool"  ACM
 SG_ OBJ_Abs_Long_Acc_13 : 295|9@1+ (0.05,-10.3) [-10.3|7.3] "MPS2"  ACM
 SG_ OBJ_Abs_Long_Acc_V_13 : 304|1@1+ (1,0) [0|1] "bool"  ACM
 SG_ OBJ_Abs_Long_Acc_STD_13 : 305|8@1+ (0.05,0) [0|7.3] "MPS2"  ACM
 SG_ OBJ_Abs_Long_Acc_STD_V_13 : 313|1@1+ (1,0) [0|1] "bool"  ACM
 SG_ OBJ_Abs_Lat_Acc_13 : 314|9@1+ (0.05,-10.3) [-10.3|7.3] "MPS2"  ACM
 SG_ OBJ_Abs_Lat_Acc_V_13 : 323|1@1+ (1,0) [0|1] "bool"  ACM
 SG_ OBJ_Abs_Lat_Acc_STD_13 : 324|8@1+ (0.05,0) [0|7.3] "MPS2"  ACM
 SG_ OBJ_Abs_Lat_Acc_STD_V_13 : 332|1@1+ (1,0) [0|1] "bool"  ACM
 SG_ OBJ_Abs_Acceleration_13 : 336|9@1+ (0.05,-10.3) [-10.3|7.3] "MPS2"  ACM
 SG_ OBJ_Abs_Acceleration_V_13 : 345|1@1+ (1,0) [0|1] "bool"  ACM
 SG_ OBJ_Abs_Acc_STD_13 : 346|8@1+ (0.05,0) [0|7.3] "MPS2"  ACM
 SG_ OBJ_Abs_Acc_STD_V_13 : 354|1@1+ (1,0) [0|1] "bool"  ACM
 SG_ OBJ_Inv_TTC_13 : 355|11@1+ (0.01,-8) [-8|8] "INV(s)"  ACM
 SG_ OBJ_Inv_TTC_V_13 : 366|1@1+ (1,0) [0|1] "bool"  ACM
 SG_ OBJ_Inv_TTC_STD_13 : 368|11@1+ (0.01,0) [0|4] "INV(s)"  ACM
 SG_ OBJ_Inv_TTC_STD_V_13 : 379|1@1+ (1,0) [0|1] "bool"  ACM
 SG_ OBJ_Relative_Long_Acc_13 : 380|9@1+ (0.05,-10.3) [-10.3|7.3] "MPS2"  ACM
 SG_ OBJ_Relative_Long_Acc_V_13 : 389|1@1+ (1,0) [0|1] "bool"  ACM
 SG_ OBJ_Relative_Long_Acc_STD_13 : 390|8@1+ (0.05,0) [0|7.3] "MPS2"  ACM
 SG_ OBJ_Rel_Long_Acc_STD_V_13 : 398|1@1+ (1,0) [0|1] "bool"  ACM

BO_ 170 ICM_Object_Prot12_B: 64 MyECU
 SG_ ICM_Object_Prot12_B_Header : 0|16@1+ (1,0) [0|65535] ""  ACM
 SG_ OBJ_Relative_Long_Velocity_12 : 16|13@1+ (0.05,-120) [-120|130] "MPS"  ACM
 SG_ OBJ_Relative_Long_Velocity_V_12 : 29|1@1+ (1,0) [0|1] "bool"  ACM
 SG_ OBJ_Relative_Long_Vel_STD_12 : 30|12@1+ (0.05,0) [0|130] "MPS"  ACM
 SG_ OBJ_Rel_Long_Vel_STD_V_12 : 42|1@1+ (1,0) [0|1] "bool"  ACM
 SG_ OBJ_Relative_Lat_Velocity_12 : 48|11@1+ (0.05,-50) [-50|50] "MPS"  ACM
 SG_ OBJ_Relative_Lat_Velocity_V_12 : 59|1@1+ (1,0) [0|1] "bool"  ACM
 SG_ OBJ_Relative_Lat_Velocity_STD_12 : 60|10@1+ (0.05,0) [0|50] "MPS"  ACM
 SG_ OBJ_Rel_Lat_Vel_STD_V_12 : 70|1@1+ (1,0) [0|1] "bool"  ACM
 SG_ OBJ_Long_Distance_12 : 80|14@1+ (0.05,-200) [-200|250] "m"  ACM
 SG_ OBJ_Long_Distance_V_12 : 94|1@1+ (1,0) [0|1] "bool"  ACM
 SG_ OBJ_Long_Distance_STD_12 : 95|13@1+ (0.05,0) [0|250] "m"  ACM
 SG_ OBJ_Long_Distance_STD_V_12 : 108|1@1+ (1,0) [0|1] "bool"  ACM
 SG_ OBJ_Lat_Distance_12 : 112|12@1+ (0.05,-100) [-100|100] "m"  ACM
 SG_ OBJ_Lat_Distance_V_12 : 124|1@1+ (1,0) [0|1] "bool"  ACM
 SG_ OBJ_Lat_Distance_STD_12 : 125|11@1+ (0.05,0) [0|100] "m"  ACM
 SG_ OBJ_Lat_Distance_STD_V_12 : 136|1@1+ (1,0) [0|1] "bool"  ACM
 SG_ OBJ_Absolute_Speed_12 : 144|12@1+ (0.05,-65) [-65|65] "MPS"  ACM
 SG_ OBJ_Absolute_Speed_V_12 : 156|1@1+ (1,0) [0|1] "bool"  ACM
 SG_ OBJ_Absolute_Speed_STD_12 : 157|11@1+ (0.05,-65) [0|65] "MPS"  ACM
 SG_ OBJ_Absolute_Speed_STD_V_12 : 168|1@1+ (1,0) [0|1] "bool"  ACM
 SG_ OBJ_Heading_12 : 176|10@1+ (0.01,-3.14) [-3.14|3.14] "rad"  ACM
 SG_ OBJ_Heading_V_12 : 186|1@1+ (1,0) [0|1] "bool"  ACM
 SG_ OBJ_Heading_STD_12 : 187|9@1+ (0.01,0) [0|3.14] "rad"  ACM
 SG_ OBJ_Heading_STD_V_12 : 196|1@1+ (1,0) [0|1] "bool"  ACM
 SG_ OBJ_Angle_Rate_STD_12 : 197|11@1+ (0.002,0) [0|2.2318] "RPS"  ACM
 SG_ OBJ_Angle_Rate_STD_V_12 : 208|1@1+ (1,0) [0|1] "bool"  ACM
 SG_ OBJ_Angle_Rate_12 : 209|12@1+ (0.002,-2.234) [-2.234|2.2318] "RPS"  ACM
 SG_ OBJ_Angle_Rate_V_12 : 221|1@1+ (1,0) [0|1] "bool"  ACM
 SG_ OBJ_Angle_Right_12 : 222|14@1+ (0.0002,-1.571) [-1.571|1.571] "rad "  ACM
 SG_ OBJ_Angle_Right_V_12 : 236|1@1+ (1,0) [0|1] "bool"  ACM
 SG_ OBJ_Angle_Right_STD_12 : 240|13@1+ (0.0002,0) [0|1.571] "rad "  ACM
 SG_ OBJ_Angle_Right_STD_V_12 : 253|1@1+ (1,0) [0|1] "bool"  ACM
 SG_ OBJ_Angle_Left_12 : 254|14@1+ (0.0002,-1.571) [-1.571|1.571] "rad "  ACM
 SG_ OBJ_Angle_Left_V_12 : 268|1@1+ (1,0) [0|1] "bool"  ACM
 SG_ OBJ_Angle_Left_STD_12 : 272|13@1+ (0.0002,0) [0|1.571] "rad"  ACM
 SG_ OBJ_Angle_Left_STD_V_12 : 285|1@1+ (1,0) [0|1] "bool"  ACM
 SG_ OBJ_Angle_Side_12 : 286|14@1+ (0.0002,-1.571) [-1.571|1.571] "rad"  ACM
 SG_ OBJ_Angle_Side_V_12 : 300|1@1+ (1,0) [0|1] "bool"  ACM
 SG_ OBJ_Angle_Side_STD_12 : 304|13@1+ (0.0002,0) [0|1.571] "rad"  ACM
 SG_ OBJ_Angle_Side_STD_V_12 : 317|1@1+ (1,0) [0|1] "bool"  ACM
 SG_ OBJ_Angle_Mid_V_12 : 318|1@1+ (1,0) [0|1] "bool"  ACM
 SG_ OBJ_Angle_Mid_12 : 319|14@1+ (0.0002,-1.571) [-1.571|1.571] "rad"  ACM
 SG_ OBJ_Angle_Mid_STD_12 : 336|13@1+ (0.0002,0) [0|1.571] "rad"  ACM
 SG_ OBJ_Angle_Mid_STD_V_12 : 349|1@1+ (1,0) [0|1] "bool"  ACM
 SG_ OBJ_Angle_Bottom_V_12 : 350|1@1+ (1,0) [0|1] "bool"  ACM
 SG_ OBJ_Angle_Bottom_12 : 351|14@1+ (0.0002,-1.571) [-1.571|1.571] "rad"  ACM
 SG_ OBJ_Angle_Bottom_STD_12 : 368|13@1+ (0.0002,0) [0|1.571] "rad"  ACM
 SG_ OBJ_Angle_Bottom_STD_V_12 : 381|1@1+ (1,0) [0|1] "bool"  ACM
 SG_ OBJ_Visibility_Side_V_12 : 382|1@1+ (1,0) [0|1] "bool"  ACM
 SG_ OBJ_Visibility_Side_12 : 383|2@1+ (1,0) [0|2] "ENUM"  ACM
 SG_ OBJ_Is_In_Drivable_Area_12 : 385|1@1+ (1,0) [0|1] "bool"  ACM
 SG_ OBJ_Is_In_Drivable_Area_V_12 : 386|1@1+ (1,0) [0|1] "bool"  ACM
 SG_ OBJ_Is_VeryClose_12 : 387|1@1+ (1,0) [0|1] "bool"  ACM
 SG_ OBJ_Is_VeryClose_V_12 : 388|1@1+ (1,0) [0|1] "bool"  ACM
 SG_ OBJ_Buffer_12 : 389|11@1+ (1,0) [0|0] "NA"  ACM

BO_ 169 ICM_Object_Prot12_A: 64 MyECU
 SG_ ICM_Object_Prot12_A_Header : 0|16@1+ (1,0) [0|65535] ""  ACM
 SG_ OBJ_CRC_12 : 16|32@1+ (1,0) [0|4294967295] "NA"  ACM
 SG_ OBJ_ID_12 : 48|8@1+ (1,0) [0|255] "NA"  ACM
 SG_ OBJ_Existence_Probability_12 : 56|8@1+ (0.01,0) [0|1] "NA"  ACM
 SG_ OBJ_Fusion_Source_12 : 64|16@1+ (1,0) [0|65535] "BITWIZE"  ACM
 SG_ OBJ_Triggered_SDM_12 : 80|2@1+ (1,0) [0|2] "ENUM"  ACM
 SG_ OBJ_Motion_Category_12 : 82|4@1+ (1,0) [0|13] "ENUM "  ACM
 SG_ OBJ_Moving_IN_Probability_12 : 86|7@1+ (0.01,0) [0|0] "NA"  ACM
 SG_ OBJ_Object_Age_12 : 93|11@1+ (1,0) [0|2047] "Frame"  ACM
 SG_ OBJ_Measuring_Status_12 : 104|3@1+ (1,0) [0|7] "BITWIZE"  ACM
 SG_ OBJ_Object_Class_12 : 107|4@1+ (1,0) [0|8] "ENUM"  ACM
 SG_ OBJ_Class_Probability_12 : 112|7@1+ (0.01,0) [0|1] "NA"  ACM
 SG_ OBJ_Car_Probability_12 : 119|7@1+ (0.01,0) [0|0] "NA"  ACM
 SG_ OBJ_Truck_Probability_12 : 126|7@1+ (0.01,0) [0|0] "NA"  ACM
 SG_ OBJ_Bike_Probability_12 : 133|7@1+ (0.01,0) [0|0] "NA"  ACM
 SG_ OBJ_Camera_Source_12 : 140|4@1+ (1,0) [0|15] "ENUM"  ACM
 SG_ OBJ_Motion_Status_12 : 144|3@1+ (1,0) [0|5] "ENUM "  ACM
 SG_ OBJ_Motion_Orientation_12 : 147|4@1+ (1,0) [0|13] "ENUM "  ACM
 SG_ OBJ_Has_Cut_Lane_12 : 151|1@1+ (1,0) [0|1] "bool"  ACM
 SG_ OBJ_Has_Cut_Path_12 : 152|1@1+ (1,0) [0|1] "bool"  ACM
 SG_ OBJ_Brake_Light_12 : 153|1@1+ (1,0) [0|1] "bool"  ACM
 SG_ OBJ_Turn_Indicator_Right_12 : 154|1@1+ (1,0) [0|1] "bool"  ACM
 SG_ OBJ_Turn_Indicator_Left_12 : 155|1@1+ (1,0) [0|1] "bool"  ACM
 SG_ OBJ_Light_Indicator_Validity_12 : 156|1@1+ (1,0) [0|1] "bool"  ACM
 SG_ OBJ_Right_Out_Of_Image_12 : 157|1@1+ (1,0) [0|1] "bool"  ACM
 SG_ OBJ_Left_Out_Of_Image_12 : 158|1@1+ (1,0) [0|1] "bool"  ACM
 SG_ OBJ_Right_Out_Of_Image_V_12 : 159|1@1+ (1,0) [0|1] "bool"  ACM
 SG_ OBJ_Left_Out_Of_Image_V_12 : 160|1@1+ (1,0) [0|1] "bool"  ACM
 SG_ OBJ_Top_Out_Of_Image_12 : 161|1@1+ (1,0) [0|1] "bool"  ACM
 SG_ OBJ_Bottom_Out_Of_Image_12 : 162|1@1+ (1,0) [0|1] "bool"  ACM
 SG_ OBJ_Top_Out_Of_Image_V_12 : 163|1@1+ (1,0) [0|1] "bool"  ACM
 SG_ OBJ_Bottom_Out_Of_Image_V_12 : 164|1@1+ (1,0) [0|1] "bool"  ACM
 SG_ OBJ_Lane_Assignment_12 : 165|3@1+ (1,0) [0|5] "ENUM"  ACM
 SG_ OBJ_Lane_Assignment_V_12 : 168|1@1+ (1,0) [0|1] "bool"  ACM
 SG_ OBJ_Age_Seconds_12 : 169|7@1+ (1,0) [0|100] "s"  ACM
 SG_ OBJ_Age_Seconds_V_12 : 176|1@1+ (1,0) [0|1] "bool"  ACM
 SG_ OBJ_Width_12 : 177|9@1+ (0.01,0) [0.4|2.95] "m"  ACM
 SG_ OBJ_Width_V_12 : 186|1@1+ (1,0) [0|1] "bool"  ACM
 SG_ OBJ_Width_STD_12 : 187|8@1+ (0.01,0) [0|2] "m"  ACM
 SG_ OBJ_Width_STD_V_12 : 195|1@1+ (1,0) [0|1] "bool"  ACM
 SG_ OBJ_Length_12 : 196|9@1+ (0.05,0) [1.2|21] "m"  ACM
 SG_ OBJ_Length_V_12 : 205|1@1+ (1,0) [0|1] "bool"  ACM
 SG_ OBJ_Length_STD_12 : 208|8@1+ (0.05,0) [0|10] "m"  ACM
 SG_ OBJ_Length_STD_V_12 : 216|1@1+ (1,0) [0|1] "bool"  ACM
 SG_ OBJ_Height_12 : 217|9@1+ (0.01,0) [0|2.95] "m"  ACM
 SG_ OBJ_Height_V_12 : 226|1@1+ (1,0) [0|1] "bool"  ACM
 SG_ OBJ_Height_STD_12 : 227|8@1+ (0.01,0) [0|2] "m"  ACM
 SG_ OBJ_Height_STD_V_12 : 235|1@1+ (1,0) [0|1] "bool"  ACM
 SG_ OBJ_Abs_Long_Velocity_12 : 240|12@1+ (0.05,-30) [-30|100] "MPS"  ACM
 SG_ OBJ_Abs_Long_Velocity_V_12 : 252|1@1+ (1,0) [0|1] "bool"  ACM
 SG_ OBJ_Abs_Long_Velocity_STD_12 : 253|11@1+ (0.05,0) [0|65] "MPS"  ACM
 SG_ OBJ_Abs_Long_Vel_STD_V_12 : 264|1@1+ (1,0) [0|1] "bool"  ACM
 SG_ OBJ_Abs_Lat_Velocity_12 : 272|11@1+ (0.05,-50) [-50|50] "MPS"  ACM
 SG_ OBJ_Abs_Lat_Velocity_V_12 : 283|1@1+ (1,0) [0|1] "bool"  ACM
 SG_ OBJ_Abs_Lat_Velocity_STD_12 : 284|10@1+ (0.05,0) [0|50] "MPS"  ACM
 SG_ OBJ_Abs_Lat_Vel_STD_V_12 : 294|1@1+ (1,0) [0|1] "bool"  ACM
 SG_ OBJ_Abs_Long_Acc_12 : 295|9@1+ (0.05,-10.3) [-10.3|7.3] "MPS2"  ACM
 SG_ OBJ_Abs_Long_Acc_V_12 : 304|1@1+ (1,0) [0|1] "bool"  ACM
 SG_ OBJ_Abs_Long_Acc_STD_12 : 305|8@1+ (0.05,0) [0|7.3] "MPS2"  ACM
 SG_ OBJ_Abs_Long_Acc_STD_V_12 : 313|1@1+ (1,0) [0|1] "bool"  ACM
 SG_ OBJ_Abs_Lat_Acc_12 : 314|9@1+ (0.05,-10.3) [-10.3|7.3] "MPS2"  ACM
 SG_ OBJ_Abs_Lat_Acc_V_12 : 323|1@1+ (1,0) [0|1] "bool"  ACM
 SG_ OBJ_Abs_Lat_Acc_STD_12 : 324|8@1+ (0.05,0) [0|7.3] "MPS2"  ACM
 SG_ OBJ_Abs_Lat_Acc_STD_V_12 : 332|1@1+ (1,0) [0|1] "bool"  ACM
 SG_ OBJ_Abs_Acceleration_12 : 336|9@1+ (0.05,-10.3) [-10.3|7.3] "MPS2"  ACM
 SG_ OBJ_Abs_Acceleration_V_12 : 345|1@1+ (1,0) [0|1] "bool"  ACM
 SG_ OBJ_Abs_Acc_STD_12 : 346|8@1+ (0.05,0) [0|7.3] "MPS2"  ACM
 SG_ OBJ_Abs_Acc_STD_V_12 : 354|1@1+ (1,0) [0|1] "bool"  ACM
 SG_ OBJ_Inv_TTC_12 : 355|11@1+ (0.01,-8) [-8|8] "INV(s)"  ACM
 SG_ OBJ_Inv_TTC_V_12 : 366|1@1+ (1,0) [0|1] "bool"  ACM
 SG_ OBJ_Inv_TTC_STD_12 : 368|11@1+ (0.01,0) [0|4] "INV(s)"  ACM
 SG_ OBJ_Inv_TTC_STD_V_12 : 379|1@1+ (1,0) [0|1] "bool"  ACM
 SG_ OBJ_Relative_Long_Acc_12 : 380|9@1+ (0.05,-10.3) [-10.3|7.3] "MPS2"  ACM
 SG_ OBJ_Relative_Long_Acc_V_12 : 389|1@1+ (1,0) [0|1] "bool"  ACM
 SG_ OBJ_Relative_Long_Acc_STD_12 : 390|8@1+ (0.05,0) [0|7.3] "MPS2"  ACM
 SG_ OBJ_Rel_Long_Acc_STD_V_12 : 398|1@1+ (1,0) [0|1] "bool"  ACM

BO_ 168 ICM_Object_Prot11_B: 64 MyECU
 SG_ ICM_Object_Prot11_B_Header : 0|16@1+ (1,0) [0|65535] ""  ACM
 SG_ OBJ_Relative_Long_Velocity_11 : 16|13@1+ (0.05,-120) [-120|130] "MPS"  ACM
 SG_ OBJ_Relative_Long_Velocity_V_11 : 29|1@1+ (1,0) [0|1] "bool"  ACM
 SG_ OBJ_Relative_Long_Vel_STD_11 : 30|12@1+ (0.05,0) [0|130] "MPS"  ACM
 SG_ OBJ_Rel_Long_Vel_STD_V_11 : 42|1@1+ (1,0) [0|1] "bool"  ACM
 SG_ OBJ_Relative_Lat_Velocity_11 : 48|11@1+ (0.05,-50) [-50|50] "MPS"  ACM
 SG_ OBJ_Relative_Lat_Velocity_V_11 : 59|1@1+ (1,0) [0|1] "bool"  ACM
 SG_ OBJ_Relative_Lat_Velocity_STD_11 : 60|10@1+ (0.05,0) [0|50] "MPS"  ACM
 SG_ OBJ_Rel_Lat_Vel_STD_V_11 : 70|1@1+ (1,0) [0|1] "bool"  ACM
 SG_ OBJ_Long_Distance_11 : 80|14@1+ (0.05,-200) [-200|250] "m"  ACM
 SG_ OBJ_Long_Distance_V_11 : 94|1@1+ (1,0) [0|1] "bool"  ACM
 SG_ OBJ_Long_Distance_STD_11 : 95|13@1+ (0.05,0) [0|250] "m"  ACM
 SG_ OBJ_Long_Distance_STD_V_11 : 108|1@1+ (1,0) [0|1] "bool"  ACM
 SG_ OBJ_Lat_Distance_11 : 112|12@1+ (0.05,-100) [-100|100] "m"  ACM
 SG_ OBJ_Lat_Distance_V_11 : 124|1@1+ (1,0) [0|1] "bool"  ACM
 SG_ OBJ_Lat_Distance_STD_11 : 125|11@1+ (0.05,0) [0|100] "m"  ACM
 SG_ OBJ_Lat_Distance_STD_V_11 : 136|1@1+ (1,0) [0|1] "bool"  ACM
 SG_ OBJ_Absolute_Speed_11 : 144|12@1+ (0.05,-65) [-65|65] "MPS"  ACM
 SG_ OBJ_Absolute_Speed_V_11 : 156|1@1+ (1,0) [0|1] "bool"  ACM
 SG_ OBJ_Absolute_Speed_STD_11 : 157|11@1+ (0.05,-65) [0|65] "MPS"  ACM
 SG_ OBJ_Absolute_Speed_STD_V_11 : 168|1@1+ (1,0) [0|1] "bool"  ACM
 SG_ OBJ_Heading_11 : 176|10@1+ (0.01,-3.14) [-3.14|3.14] "rad"  ACM
 SG_ OBJ_Heading_V_11 : 186|1@1+ (1,0) [0|1] "bool"  ACM
 SG_ OBJ_Heading_STD_11 : 187|9@1+ (0.01,0) [0|3.14] "rad"  ACM
 SG_ OBJ_Heading_STD_V_11 : 196|1@1+ (1,0) [0|1] "bool"  ACM
 SG_ OBJ_Angle_Rate_STD_11 : 197|11@1+ (0.002,0) [0|2.2318] "RPS"  ACM
 SG_ OBJ_Angle_Rate_STD_V_11 : 208|1@1+ (1,0) [0|1] "bool"  ACM
 SG_ OBJ_Angle_Rate_11 : 209|12@1+ (0.002,-2.234) [-2.234|2.2318] "RPS"  ACM
 SG_ OBJ_Angle_Rate_V_11 : 221|1@1+ (1,0) [0|1] "bool"  ACM
 SG_ OBJ_Angle_Right_11 : 222|14@1+ (0.0002,-1.571) [-1.571|1.571] "rad "  ACM
 SG_ OBJ_Angle_Right_V_11 : 236|1@1+ (1,0) [0|1] "bool"  ACM
 SG_ OBJ_Angle_Right_STD_11 : 240|13@1+ (0.0002,0) [0|1.571] "rad "  ACM
 SG_ OBJ_Angle_Right_STD_V_11 : 253|1@1+ (1,0) [0|1] "bool"  ACM
 SG_ OBJ_Angle_Left_11 : 254|14@1+ (0.0002,-1.571) [-1.571|1.571] "rad "  ACM
 SG_ OBJ_Angle_Left_V_11 : 268|1@1+ (1,0) [0|1] "bool"  ACM
 SG_ OBJ_Angle_Left_STD_11 : 272|13@1+ (0.0002,0) [0|1.571] "rad"  ACM
 SG_ OBJ_Angle_Left_STD_V_11 : 285|1@1+ (1,0) [0|1] "bool"  ACM
 SG_ OBJ_Angle_Side_11 : 286|14@1+ (0.0002,-1.571) [-1.571|1.571] "rad"  ACM
 SG_ OBJ_Angle_Side_V_11 : 300|1@1+ (1,0) [0|1] "bool"  ACM
 SG_ OBJ_Angle_Side_STD_11 : 304|13@1+ (0.0002,0) [0|1.571] "rad"  ACM
 SG_ OBJ_Angle_Side_STD_V_11 : 317|1@1+ (1,0) [0|1] "bool"  ACM
 SG_ OBJ_Angle_Mid_V_11 : 318|1@1+ (1,0) [0|1] "bool"  ACM
 SG_ OBJ_Angle_Mid_11 : 319|14@1+ (0.0002,-1.571) [-1.571|1.571] "rad"  ACM
 SG_ OBJ_Angle_Mid_STD_11 : 336|13@1+ (0.0002,0) [0|1.571] "rad"  ACM
 SG_ OBJ_Angle_Mid_STD_V_11 : 349|1@1+ (1,0) [0|1] "bool"  ACM
 SG_ OBJ_Angle_Bottom_V_11 : 350|1@1+ (1,0) [0|1] "bool"  ACM
 SG_ OBJ_Angle_Bottom_11 : 351|14@1+ (0.0002,-1.571) [-1.571|1.571] "rad"  ACM
 SG_ OBJ_Angle_Bottom_STD_11 : 368|13@1+ (0.0002,0) [0|1.571] "rad"  ACM
 SG_ OBJ_Angle_Bottom_STD_V_11 : 381|1@1+ (1,0) [0|1] "bool"  ACM
 SG_ OBJ_Visibility_Side_V_11 : 382|1@1+ (1,0) [0|1] "bool"  ACM
 SG_ OBJ_Visibility_Side_11 : 383|2@1+ (1,0) [0|2] "ENUM"  ACM
 SG_ OBJ_Is_In_Drivable_Area_11 : 385|1@1+ (1,0) [0|1] "bool"  ACM
 SG_ OBJ_Is_In_Drivable_Area_V_11 : 386|1@1+ (1,0) [0|1] "bool"  ACM
 SG_ OBJ_Is_VeryClose_11 : 387|1@1+ (1,0) [0|1] "bool"  ACM
 SG_ OBJ_Is_VeryClose_V_11 : 388|1@1+ (1,0) [0|1] "bool"  ACM
 SG_ OBJ_Buffer_11 : 389|11@1+ (1,0) [0|0] "NA"  ACM

BO_ 167 ICM_Object_Prot11_A: 64 MyECU
 SG_ ICM_Object_Prot11_A_Header : 0|16@1+ (1,0) [0|65535] ""  ACM
 SG_ OBJ_CRC_11 : 16|32@1+ (1,0) [0|4294967295] "NA"  ACM
 SG_ OBJ_ID_11 : 48|8@1+ (1,0) [0|255] "NA"  ACM
 SG_ OBJ_Existence_Probability_11 : 56|8@1+ (0.01,0) [0|1] "NA"  ACM
 SG_ OBJ_Fusion_Source_11 : 64|16@1+ (1,0) [0|65535] "BITWIZE"  ACM
 SG_ OBJ_Triggered_SDM_11 : 80|2@1+ (1,0) [0|2] "ENUM"  ACM
 SG_ OBJ_Motion_Category_11 : 82|4@1+ (1,0) [0|13] "ENUM "  ACM
 SG_ OBJ_Moving_IN_Probability_11 : 86|7@1+ (0.01,0) [0|0] "NA"  ACM
 SG_ OBJ_Object_Age_11 : 93|11@1+ (1,0) [0|2047] "Frame"  ACM
 SG_ OBJ_Measuring_Status_11 : 104|3@1+ (1,0) [0|7] "BITWIZE"  ACM
 SG_ OBJ_Object_Class_11 : 107|4@1+ (1,0) [0|8] "ENUM"  ACM
 SG_ OBJ_Class_Probability_11 : 112|7@1+ (0.01,0) [0|1] "NA"  ACM
 SG_ OBJ_Car_Probability_11 : 119|7@1+ (0.01,0) [0|0] "NA"  ACM
 SG_ OBJ_Truck_Probability_11 : 126|7@1+ (0.01,0) [0|0] "NA"  ACM
 SG_ OBJ_Bike_Probability_11 : 133|7@1+ (0.01,0) [0|0] "NA"  ACM
 SG_ OBJ_Camera_Source_11 : 140|4@1+ (1,0) [0|15] "ENUM"  ACM
 SG_ OBJ_Motion_Status_11 : 144|3@1+ (1,0) [0|5] "ENUM "  ACM
 SG_ OBJ_Motion_Orientation_11 : 147|4@1+ (1,0) [0|13] "ENUM "  ACM
 SG_ OBJ_Has_Cut_Lane_11 : 151|1@1+ (1,0) [0|1] "bool"  ACM
 SG_ OBJ_Has_Cut_Path_11 : 152|1@1+ (1,0) [0|1] "bool"  ACM
 SG_ OBJ_Brake_Light_11 : 153|1@1+ (1,0) [0|1] "bool"  ACM
 SG_ OBJ_Turn_Indicator_Right_11 : 154|1@1+ (1,0) [0|1] "bool"  ACM
 SG_ OBJ_Turn_Indicator_Left_11 : 155|1@1+ (1,0) [0|1] "bool"  ACM
 SG_ OBJ_Light_Indicator_Validity_11 : 156|1@1+ (1,0) [0|1] "bool"  ACM
 SG_ OBJ_Right_Out_Of_Image_11 : 157|1@1+ (1,0) [0|1] "bool"  ACM
 SG_ OBJ_Left_Out_Of_Image_11 : 158|1@1+ (1,0) [0|1] "bool"  ACM
 SG_ OBJ_Right_Out_Of_Image_V_11 : 159|1@1+ (1,0) [0|1] "bool"  ACM
 SG_ OBJ_Left_Out_Of_Image_V_11 : 160|1@1+ (1,0) [0|1] "bool"  ACM
 SG_ OBJ_Top_Out_Of_Image_11 : 161|1@1+ (1,0) [0|1] "bool"  ACM
 SG_ OBJ_Bottom_Out_Of_Image_11 : 162|1@1+ (1,0) [0|1] "bool"  ACM
 SG_ OBJ_Top_Out_Of_Image_V_11 : 163|1@1+ (1,0) [0|1] "bool"  ACM
 SG_ OBJ_Bottom_Out_Of_Image_V_11 : 164|1@1+ (1,0) [0|1] "bool"  ACM
 SG_ OBJ_Lane_Assignment_11 : 165|3@1+ (1,0) [0|5] "ENUM"  ACM
 SG_ OBJ_Lane_Assignment_V_11 : 168|1@1+ (1,0) [0|1] "bool"  ACM
 SG_ OBJ_Age_Seconds_11 : 169|7@1+ (1,0) [0|100] "s"  ACM
 SG_ OBJ_Age_Seconds_V_11 : 176|1@1+ (1,0) [0|1] "bool"  ACM
 SG_ OBJ_Width_11 : 177|9@1+ (0.01,0) [0.4|2.95] "m"  ACM
 SG_ OBJ_Width_V_11 : 186|1@1+ (1,0) [0|1] "bool"  ACM
 SG_ OBJ_Width_STD_11 : 187|8@1+ (0.01,0) [0|2] "m"  ACM
 SG_ OBJ_Width_STD_V_11 : 195|1@1+ (1,0) [0|1] "bool"  ACM
 SG_ OBJ_Length_11 : 196|9@1+ (0.05,0) [1.2|21] "m"  ACM
 SG_ OBJ_Length_V_11 : 205|1@1+ (1,0) [0|1] "bool"  ACM
 SG_ OBJ_Length_STD_11 : 208|8@1+ (0.05,0) [0|10] "m"  ACM
 SG_ OBJ_Length_STD_V_11 : 216|1@1+ (1,0) [0|1] "bool"  ACM
 SG_ OBJ_Height_11 : 217|9@1+ (0.01,0) [0|2.95] "m"  ACM
 SG_ OBJ_Height_V_11 : 226|1@1+ (1,0) [0|1] "bool"  ACM
 SG_ OBJ_Height_STD_11 : 227|8@1+ (0.01,0) [0|2] "m"  ACM
 SG_ OBJ_Height_STD_V_11 : 235|1@1+ (1,0) [0|1] "bool"  ACM
 SG_ OBJ_Abs_Long_Velocity_11 : 240|12@1+ (0.05,-30) [-30|100] "MPS"  ACM
 SG_ OBJ_Abs_Long_Velocity_V_11 : 252|1@1+ (1,0) [0|1] "bool"  ACM
 SG_ OBJ_Abs_Long_Velocity_STD_11 : 253|11@1+ (0.05,0) [0|65] "MPS"  ACM
 SG_ OBJ_Abs_Long_Vel_STD_V_11 : 264|1@1+ (1,0) [0|1] "bool"  ACM
 SG_ OBJ_Abs_Lat_Velocity_11 : 272|11@1+ (0.05,-50) [-50|50] "MPS"  ACM
 SG_ OBJ_Abs_Lat_Velocity_V_11 : 283|1@1+ (1,0) [0|1] "bool"  ACM
 SG_ OBJ_Abs_Lat_Velocity_STD_11 : 284|10@1+ (0.05,0) [0|50] "MPS"  ACM
 SG_ OBJ_Abs_Lat_Vel_STD_V_11 : 294|1@1+ (1,0) [0|1] "bool"  ACM
 SG_ OBJ_Abs_Long_Acc_11 : 295|9@1+ (0.05,-10.3) [-10.3|7.3] "MPS2"  ACM
 SG_ OBJ_Abs_Long_Acc_V_11 : 304|1@1+ (1,0) [0|1] "bool"  ACM
 SG_ OBJ_Abs_Long_Acc_STD_11 : 305|8@1+ (0.05,0) [0|7.3] "MPS2"  ACM
 SG_ OBJ_Abs_Long_Acc_STD_V_11 : 313|1@1+ (1,0) [0|1] "bool"  ACM
 SG_ OBJ_Abs_Lat_Acc_11 : 314|9@1+ (0.05,-10.3) [-10.3|7.3] "MPS2"  ACM
 SG_ OBJ_Abs_Lat_Acc_V_11 : 323|1@1+ (1,0) [0|1] "bool"  ACM
 SG_ OBJ_Abs_Lat_Acc_STD_11 : 324|8@1+ (0.05,0) [0|7.3] "MPS2"  ACM
 SG_ OBJ_Abs_Lat_Acc_STD_V_11 : 332|1@1+ (1,0) [0|1] "bool"  ACM
 SG_ OBJ_Abs_Acceleration_11 : 336|9@1+ (0.05,-10.3) [-10.3|7.3] "MPS2"  ACM
 SG_ OBJ_Abs_Acceleration_V_11 : 345|1@1+ (1,0) [0|1] "bool"  ACM
 SG_ OBJ_Abs_Acc_STD_11 : 346|8@1+ (0.05,0) [0|7.3] "MPS2"  ACM
 SG_ OBJ_Abs_Acc_STD_V_11 : 354|1@1+ (1,0) [0|1] "bool"  ACM
 SG_ OBJ_Inv_TTC_11 : 355|11@1+ (0.01,-8) [-8|8] "INV(s)"  ACM
 SG_ OBJ_Inv_TTC_V_11 : 366|1@1+ (1,0) [0|1] "bool"  ACM
 SG_ OBJ_Inv_TTC_STD_11 : 368|11@1+ (0.01,0) [0|4] "INV(s)"  ACM
 SG_ OBJ_Inv_TTC_STD_V_11 : 379|1@1+ (1,0) [0|1] "bool"  ACM
 SG_ OBJ_Relative_Long_Acc_11 : 380|9@1+ (0.05,-10.3) [-10.3|7.3] "MPS2"  ACM
 SG_ OBJ_Relative_Long_Acc_V_11 : 389|1@1+ (1,0) [0|1] "bool"  ACM
 SG_ OBJ_Relative_Long_Acc_STD_11 : 390|8@1+ (0.05,0) [0|7.3] "MPS2"  ACM
 SG_ OBJ_Rel_Long_Acc_STD_V_11 : 398|1@1+ (1,0) [0|1] "bool"  ACM

BO_ 166 ICM_Object_Prot10_B: 64 MyECU
 SG_ ICM_Object_Prot10_B_Header : 0|16@1+ (1,0) [0|65535] ""  ACM
 SG_ OBJ_Relative_Long_Velocity_10 : 16|13@1+ (0.05,-120) [-120|130] "MPS"  ACM
 SG_ OBJ_Relative_Long_Velocity_V_10 : 29|1@1+ (1,0) [0|1] "bool"  ACM
 SG_ OBJ_Relative_Long_Vel_STD_10 : 30|12@1+ (0.05,0) [0|130] "MPS"  ACM
 SG_ OBJ_Rel_Long_Vel_STD_V_10 : 42|1@1+ (1,0) [0|1] "bool"  ACM
 SG_ OBJ_Relative_Lat_Velocity_10 : 48|11@1+ (0.05,-50) [-50|50] "MPS"  ACM
 SG_ OBJ_Relative_Lat_Velocity_V_10 : 59|1@1+ (1,0) [0|1] "bool"  ACM
 SG_ OBJ_Relative_Lat_Velocity_STD_10 : 60|10@1+ (0.05,0) [0|50] "MPS"  ACM
 SG_ OBJ_Rel_Lat_Vel_STD_V_10 : 70|1@1+ (1,0) [0|1] "bool"  ACM
 SG_ OBJ_Long_Distance_10 : 80|14@1+ (0.05,-200) [-200|250] "m"  ACM
 SG_ OBJ_Long_Distance_V_10 : 94|1@1+ (1,0) [0|1] "bool"  ACM
 SG_ OBJ_Long_Distance_STD_10 : 95|13@1+ (0.05,0) [0|250] "m"  ACM
 SG_ OBJ_Long_Distance_STD_V_10 : 108|1@1+ (1,0) [0|1] "bool"  ACM
 SG_ OBJ_Lat_Distance_10 : 112|12@1+ (0.05,-100) [-100|100] "m"  ACM
 SG_ OBJ_Lat_Distance_V_10 : 124|1@1+ (1,0) [0|1] "bool"  ACM
 SG_ OBJ_Lat_Distance_STD_10 : 125|11@1+ (0.05,0) [0|100] "m"  ACM
 SG_ OBJ_Lat_Distance_STD_V_10 : 136|1@1+ (1,0) [0|1] "bool"  ACM
 SG_ OBJ_Absolute_Speed_10 : 144|12@1+ (0.05,-65) [-65|65] "MPS"  ACM
 SG_ OBJ_Absolute_Speed_V_10 : 156|1@1+ (1,0) [0|1] "bool"  ACM
 SG_ OBJ_Absolute_Speed_STD_10 : 157|11@1+ (0.05,-65) [0|65] "MPS"  ACM
 SG_ OBJ_Absolute_Speed_STD_V_10 : 168|1@1+ (1,0) [0|1] "bool"  ACM
 SG_ OBJ_Heading_10 : 176|10@1+ (0.01,-3.14) [-3.14|3.14] "rad"  ACM
 SG_ OBJ_Heading_V_10 : 186|1@1+ (1,0) [0|1] "bool"  ACM
 SG_ OBJ_Heading_STD_10 : 187|9@1+ (0.01,0) [0|3.14] "rad"  ACM
 SG_ OBJ_Heading_STD_V_10 : 196|1@1+ (1,0) [0|1] "bool"  ACM
 SG_ OBJ_Angle_Rate_STD_10 : 197|11@1+ (0.002,0) [0|2.2318] "RPS"  ACM
 SG_ OBJ_Angle_Rate_STD_V_10 : 208|1@1+ (1,0) [0|1] "bool"  ACM
 SG_ OBJ_Angle_Rate_10 : 209|12@1+ (0.002,-2.234) [-2.234|2.2318] "RPS"  ACM
 SG_ OBJ_Angle_Rate_V_10 : 221|1@1+ (1,0) [0|1] "bool"  ACM
 SG_ OBJ_Angle_Right_10 : 222|14@1+ (0.0002,-1.571) [-1.571|1.571] "rad "  ACM
 SG_ OBJ_Angle_Right_V_10 : 236|1@1+ (1,0) [0|1] "bool"  ACM
 SG_ OBJ_Angle_Right_STD_10 : 240|13@1+ (0.0002,0) [0|1.571] "rad "  ACM
 SG_ OBJ_Angle_Right_STD_V_10 : 253|1@1+ (1,0) [0|1] "bool"  ACM
 SG_ OBJ_Angle_Left_10 : 254|14@1+ (0.0002,-1.571) [-1.571|1.571] "rad "  ACM
 SG_ OBJ_Angle_Left_V_10 : 268|1@1+ (1,0) [0|1] "bool"  ACM
 SG_ OBJ_Angle_Left_STD_10 : 272|13@1+ (0.0002,0) [0|1.571] "rad"  ACM
 SG_ OBJ_Angle_Left_STD_V_10 : 285|1@1+ (1,0) [0|1] "bool"  ACM
 SG_ OBJ_Angle_Side_10 : 286|14@1+ (0.0002,-1.571) [-1.571|1.571] "rad"  ACM
 SG_ OBJ_Angle_Side_V_10 : 300|1@1+ (1,0) [0|1] "bool"  ACM
 SG_ OBJ_Angle_Side_STD_10 : 304|13@1+ (0.0002,0) [0|1.571] "rad"  ACM
 SG_ OBJ_Angle_Side_STD_V_10 : 317|1@1+ (1,0) [0|1] "bool"  ACM
 SG_ OBJ_Angle_Mid_V_10 : 318|1@1+ (1,0) [0|1] "bool"  ACM
 SG_ OBJ_Angle_Mid_10 : 319|14@1+ (0.0002,-1.571) [-1.571|1.571] "rad"  ACM
 SG_ OBJ_Angle_Mid_STD_10 : 336|13@1+ (0.0002,0) [0|1.571] "rad"  ACM
 SG_ OBJ_Angle_Mid_STD_V_10 : 349|1@1+ (1,0) [0|1] "bool"  ACM
 SG_ OBJ_Angle_Bottom_V_10 : 350|1@1+ (1,0) [0|1] "bool"  ACM
 SG_ OBJ_Angle_Bottom_10 : 351|14@1+ (0.0002,-1.571) [-1.571|1.571] "rad"  ACM
 SG_ OBJ_Angle_Bottom_STD_10 : 368|13@1+ (0.0002,0) [0|1.571] "rad"  ACM
 SG_ OBJ_Angle_Bottom_STD_V_10 : 381|1@1+ (1,0) [0|1] "bool"  ACM
 SG_ OBJ_Visibility_Side_V_10 : 382|1@1+ (1,0) [0|1] "bool"  ACM
 SG_ OBJ_Visibility_Side_10 : 383|2@1+ (1,0) [0|2] "ENUM"  ACM
 SG_ OBJ_Is_In_Drivable_Area_10 : 385|1@1+ (1,0) [0|1] "bool"  ACM
 SG_ OBJ_Is_In_Drivable_Area_V_10 : 386|1@1+ (1,0) [0|1] "bool"  ACM
 SG_ OBJ_Is_VeryClose_10 : 387|1@1+ (1,0) [0|1] "bool"  ACM
 SG_ OBJ_Is_VeryClose_V_10 : 388|1@1+ (1,0) [0|1] "bool"  ACM
 SG_ OBJ_Buffer_10 : 389|11@1+ (1,0) [0|0] "NA"  ACM

BO_ 165 ICM_Object_Prot10_A: 64 MyECU
 SG_ ICM_Object_Prot10_A_Header : 0|16@1+ (1,0) [0|65535] ""  ACM
 SG_ OBJ_CRC_10 : 16|32@1+ (1,0) [0|4294967295] "NA"  ACM
 SG_ OBJ_ID_10 : 48|8@1+ (1,0) [0|255] "NA"  ACM
 SG_ OBJ_Existence_Probability_10 : 56|8@1+ (0.01,0) [0|1] "NA"  ACM
 SG_ OBJ_Fusion_Source_10 : 64|16@1+ (1,0) [0|65535] "BITWIZE"  ACM
 SG_ OBJ_Triggered_SDM_10 : 80|2@1+ (1,0) [0|2] "ENUM"  ACM
 SG_ OBJ_Motion_Category_10 : 82|4@1+ (1,0) [0|13] "ENUM "  ACM
 SG_ OBJ_Moving_IN_Probability_10 : 86|7@1+ (0.01,0) [0|0] "NA"  ACM
 SG_ OBJ_Object_Age_10 : 93|11@1+ (1,0) [0|2047] "Frame"  ACM
 SG_ OBJ_Measuring_Status_10 : 104|3@1+ (1,0) [0|7] "BITWIZE"  ACM
 SG_ OBJ_Object_Class_10 : 107|4@1+ (1,0) [0|8] "ENUM"  ACM
 SG_ OBJ_Class_Probability_10 : 112|7@1+ (0.01,0) [0|1] "NA"  ACM
 SG_ OBJ_Car_Probability_10 : 119|7@1+ (0.01,0) [0|0] "NA"  ACM
 SG_ OBJ_Truck_Probability_10 : 126|7@1+ (0.01,0) [0|0] "NA"  ACM
 SG_ OBJ_Bike_Probability_10 : 133|7@1+ (0.01,0) [0|0] "NA"  ACM
 SG_ OBJ_Camera_Source_10 : 140|4@1+ (1,0) [0|15] "ENUM"  ACM
 SG_ OBJ_Motion_Status_10 : 144|3@1+ (1,0) [0|5] "ENUM "  ACM
 SG_ OBJ_Motion_Orientation_10 : 147|4@1+ (1,0) [0|13] "ENUM "  ACM
 SG_ OBJ_Has_Cut_Lane_10 : 151|1@1+ (1,0) [0|1] "bool"  ACM
 SG_ OBJ_Has_Cut_Path_10 : 152|1@1+ (1,0) [0|1] "bool"  ACM
 SG_ OBJ_Brake_Light_10 : 153|1@1+ (1,0) [0|1] "bool"  ACM
 SG_ OBJ_Turn_Indicator_Right_10 : 154|1@1+ (1,0) [0|1] "bool"  ACM
 SG_ OBJ_Turn_Indicator_Left_10 : 155|1@1+ (1,0) [0|1] "bool"  ACM
 SG_ OBJ_Light_Indicator_Validity_10 : 156|1@1+ (1,0) [0|1] "bool"  ACM
 SG_ OBJ_Right_Out_Of_Image_10 : 157|1@1+ (1,0) [0|1] "bool"  ACM
 SG_ OBJ_Left_Out_Of_Image_10 : 158|1@1+ (1,0) [0|1] "bool"  ACM
 SG_ OBJ_Right_Out_Of_Image_V_10 : 159|1@1+ (1,0) [0|1] "bool"  ACM
 SG_ OBJ_Left_Out_Of_Image_V_10 : 160|1@1+ (1,0) [0|1] "bool"  ACM
 SG_ OBJ_Top_Out_Of_Image_10 : 161|1@1+ (1,0) [0|1] "bool"  ACM
 SG_ OBJ_Bottom_Out_Of_Image_10 : 162|1@1+ (1,0) [0|1] "bool"  ACM
 SG_ OBJ_Top_Out_Of_Image_V_10 : 163|1@1+ (1,0) [0|1] "bool"  ACM
 SG_ OBJ_Bottom_Out_Of_Image_V_10 : 164|1@1+ (1,0) [0|1] "bool"  ACM
 SG_ OBJ_Lane_Assignment_10 : 165|3@1+ (1,0) [0|5] "ENUM"  ACM
 SG_ OBJ_Lane_Assignment_V_10 : 168|1@1+ (1,0) [0|1] "bool"  ACM
 SG_ OBJ_Age_Seconds_10 : 169|7@1+ (1,0) [0|100] "s"  ACM
 SG_ OBJ_Age_Seconds_V_10 : 176|1@1+ (1,0) [0|1] "bool"  ACM
 SG_ OBJ_Width_10 : 177|9@1+ (0.01,0) [0.4|2.95] "m"  ACM
 SG_ OBJ_Width_V_10 : 186|1@1+ (1,0) [0|1] "bool"  ACM
 SG_ OBJ_Width_STD_10 : 187|8@1+ (0.01,0) [0|2] "m"  ACM
 SG_ OBJ_Width_STD_V_10 : 195|1@1+ (1,0) [0|1] "bool"  ACM
 SG_ OBJ_Length_10 : 196|9@1+ (0.05,0) [1.2|21] "m"  ACM
 SG_ OBJ_Length_V_10 : 205|1@1+ (1,0) [0|1] "bool"  ACM
 SG_ OBJ_Length_STD_10 : 208|8@1+ (0.05,0) [0|10] "m"  ACM
 SG_ OBJ_Length_STD_V_10 : 216|1@1+ (1,0) [0|1] "bool"  ACM
 SG_ OBJ_Height_10 : 217|9@1+ (0.01,0) [0|2.95] "m"  ACM
 SG_ OBJ_Height_V_10 : 226|1@1+ (1,0) [0|1] "bool"  ACM
 SG_ OBJ_Height_STD_10 : 227|8@1+ (0.01,0) [0|2] "m"  ACM
 SG_ OBJ_Height_STD_V_10 : 235|1@1+ (1,0) [0|1] "bool"  ACM
 SG_ OBJ_Abs_Long_Velocity_10 : 240|12@1+ (0.05,-30) [-30|100] "MPS"  ACM
 SG_ OBJ_Abs_Long_Velocity_V_10 : 252|1@1+ (1,0) [0|1] "bool"  ACM
 SG_ OBJ_Abs_Long_Velocity_STD_10 : 253|11@1+ (0.05,0) [0|65] "MPS"  ACM
 SG_ OBJ_Abs_Long_Vel_STD_V_10 : 264|1@1+ (1,0) [0|1] "bool"  ACM
 SG_ OBJ_Abs_Lat_Velocity_10 : 272|11@1+ (0.05,-50) [-50|50] "MPS"  ACM
 SG_ OBJ_Abs_Lat_Velocity_V_10 : 283|1@1+ (1,0) [0|1] "bool"  ACM
 SG_ OBJ_Abs_Lat_Velocity_STD_10 : 284|10@1+ (0.05,0) [0|50] "MPS"  ACM
 SG_ OBJ_Abs_Lat_Vel_STD_V_10 : 294|1@1+ (1,0) [0|1] "bool"  ACM
 SG_ OBJ_Abs_Long_Acc_10 : 295|9@1+ (0.05,-10.3) [-10.3|7.3] "MPS2"  ACM
 SG_ OBJ_Abs_Long_Acc_V_10 : 304|1@1+ (1,0) [0|1] "bool"  ACM
 SG_ OBJ_Abs_Long_Acc_STD_10 : 305|8@1+ (0.05,0) [0|7.3] "MPS2"  ACM
 SG_ OBJ_Abs_Long_Acc_STD_V_10 : 313|1@1+ (1,0) [0|1] "bool"  ACM
 SG_ OBJ_Abs_Lat_Acc_10 : 314|9@1+ (0.05,-10.3) [-10.3|7.3] "MPS2"  ACM
 SG_ OBJ_Abs_Lat_Acc_V_10 : 323|1@1+ (1,0) [0|1] "bool"  ACM
 SG_ OBJ_Abs_Lat_Acc_STD_10 : 324|8@1+ (0.05,0) [0|7.3] "MPS2"  ACM
 SG_ OBJ_Abs_Lat_Acc_STD_V_10 : 332|1@1+ (1,0) [0|1] "bool"  ACM
 SG_ OBJ_Abs_Acceleration_10 : 336|9@1+ (0.05,-10.3) [-10.3|7.3] "MPS2"  ACM
 SG_ OBJ_Abs_Acceleration_V_10 : 345|1@1+ (1,0) [0|1] "bool"  ACM
 SG_ OBJ_Abs_Acc_STD_10 : 346|8@1+ (0.05,0) [0|7.3] "MPS2"  ACM
 SG_ OBJ_Abs_Acc_STD_V_10 : 354|1@1+ (1,0) [0|1] "bool"  ACM
 SG_ OBJ_Inv_TTC_10 : 355|11@1+ (0.01,-8) [-8|8] "INV(s)"  ACM
 SG_ OBJ_Inv_TTC_V_10 : 366|1@1+ (1,0) [0|1] "bool"  ACM
 SG_ OBJ_Inv_TTC_STD_10 : 368|11@1+ (0.01,0) [0|4] "INV(s)"  ACM
 SG_ OBJ_Inv_TTC_STD_V_10 : 379|1@1+ (1,0) [0|1] "bool"  ACM
 SG_ OBJ_Relative_Long_Acc_10 : 380|9@1+ (0.05,-10.3) [-10.3|7.3] "MPS2"  ACM
 SG_ OBJ_Relative_Long_Acc_V_10 : 389|1@1+ (1,0) [0|1] "bool"  ACM
 SG_ OBJ_Relative_Long_Acc_STD_10 : 390|8@1+ (0.05,0) [0|7.3] "MPS2"  ACM
 SG_ OBJ_Rel_Long_Acc_STD_V_10 : 398|1@1+ (1,0) [0|1] "bool"  ACM

BO_ 164 ICM_Object_Prot9_B: 64 MyECU
 SG_ ICM_Object_Prot9_B_Header : 0|16@1+ (1,0) [0|65535] ""  ACM
 SG_ OBJ_Relative_Long_Velocity_9 : 16|13@1+ (0.05,-120) [-120|130] "MPS"  ACM
 SG_ OBJ_Relative_Long_Velocity_V_9 : 29|1@1+ (1,0) [0|1] "bool"  ACM
 SG_ OBJ_Relative_Long_Vel_STD_9 : 30|12@1+ (0.05,0) [0|130] "MPS"  ACM
 SG_ OBJ_Rel_Long_Vel_STD_V_9 : 42|1@1+ (1,0) [0|1] "bool"  ACM
 SG_ OBJ_Relative_Lat_Velocity_9 : 48|11@1+ (0.05,-50) [-50|50] "MPS"  ACM
 SG_ OBJ_Relative_Lat_Velocity_V_9 : 59|1@1+ (1,0) [0|1] "bool"  ACM
 SG_ OBJ_Relative_Lat_Velocity_STD_9 : 60|10@1+ (0.05,0) [0|50] "MPS"  ACM
 SG_ OBJ_Rel_Lat_Vel_STD_V_9 : 70|1@1+ (1,0) [0|1] "bool"  ACM
 SG_ OBJ_Long_Distance_9 : 80|14@1+ (0.05,-200) [-200|250] "m"  ACM
 SG_ OBJ_Long_Distance_V_9 : 94|1@1+ (1,0) [0|1] "bool"  ACM
 SG_ OBJ_Long_Distance_STD_9 : 95|13@1+ (0.05,0) [0|250] "m"  ACM
 SG_ OBJ_Long_Distance_STD_V_9 : 108|1@1+ (1,0) [0|1] "bool"  ACM
 SG_ OBJ_Lat_Distance_9 : 112|12@1+ (0.05,-100) [-100|100] "m"  ACM
 SG_ OBJ_Lat_Distance_V_9 : 124|1@1+ (1,0) [0|1] "bool"  ACM
 SG_ OBJ_Lat_Distance_STD_9 : 125|11@1+ (0.05,0) [0|100] "m"  ACM
 SG_ OBJ_Lat_Distance_STD_V_9 : 136|1@1+ (1,0) [0|1] "bool"  ACM
 SG_ OBJ_Absolute_Speed_9 : 144|12@1+ (0.05,-65) [-65|65] "MPS"  ACM
 SG_ OBJ_Absolute_Speed_V_9 : 156|1@1+ (1,0) [0|1] "bool"  ACM
 SG_ OBJ_Absolute_Speed_STD_9 : 157|11@1+ (0.05,0) [0|65] "MPS"  ACM
 SG_ OBJ_Absolute_Speed_STD_V_9 : 168|1@1+ (1,0) [0|1] "bool"  ACM
 SG_ OBJ_Heading_9 : 176|10@1+ (0.01,-3.14) [-3.14|3.14] "rad"  ACM
 SG_ OBJ_Heading_V_9 : 186|1@1+ (1,0) [0|1] "bool"  ACM
 SG_ OBJ_Heading_STD_9 : 187|9@1+ (0.01,0) [0|3.14] "rad"  ACM
 SG_ OBJ_Heading_STD_V_9 : 196|1@1+ (1,0) [0|1] "bool"  ACM
 SG_ OBJ_Angle_Rate_STD_9 : 197|11@1+ (0.002,0) [0|2.2318] "RPS"  ACM
 SG_ OBJ_Angle_Rate_STD_V_9 : 208|1@1+ (1,0) [0|1] "bool"  ACM
 SG_ OBJ_Angle_Rate_9 : 209|12@1+ (0.002,-2.234) [-2.234|2.2318] "RPS"  ACM
 SG_ OBJ_Angle_Rate_V_9 : 221|1@1+ (1,0) [0|1] "bool"  ACM
 SG_ OBJ_Angle_Right_9 : 222|14@1+ (0.0002,-1.571) [-1.571|1.571] "rad "  ACM
 SG_ OBJ_Angle_Right_V_9 : 236|1@1+ (1,0) [0|1] "bool"  ACM
 SG_ OBJ_Angle_Right_STD_9 : 240|13@1+ (0.0002,0) [0|1.571] "rad "  ACM
 SG_ OBJ_Angle_Right_STD_V_9 : 253|1@1+ (1,0) [0|1] "bool"  ACM
 SG_ OBJ_Angle_Left_9 : 254|14@1+ (0.0002,-1.571) [-1.571|1.571] "rad "  ACM
 SG_ OBJ_Angle_Left_V_9 : 268|1@1+ (1,0) [0|1] "bool"  ACM
 SG_ OBJ_Angle_Left_STD_9 : 272|13@1+ (0.0002,0) [0|1.571] "rad"  ACM
 SG_ OBJ_Angle_Left_STD_V_9 : 285|1@1+ (1,0) [0|1] "bool"  ACM
 SG_ OBJ_Angle_Side_9 : 286|14@1+ (0.0002,-1.571) [-1.571|1.571] "rad"  ACM
 SG_ OBJ_Angle_Side_V_9 : 300|1@1+ (1,0) [0|1] "bool"  ACM
 SG_ OBJ_Angle_Side_STD_9 : 304|13@1+ (0.0002,0) [0|1.571] "rad"  ACM
 SG_ OBJ_Angle_Side_STD_V_9 : 317|1@1+ (1,0) [0|1] "bool"  ACM
 SG_ OBJ_Angle_Mid_V_9 : 318|1@1+ (1,0) [0|1] "bool"  ACM
 SG_ OBJ_Angle_Mid_9 : 319|14@1+ (0.0002,-1.571) [-1.571|1.571] "rad"  ACM
 SG_ OBJ_Angle_Mid_STD_9 : 336|13@1+ (0.0002,0) [0|1.571] "rad"  ACM
 SG_ OBJ_Angle_Mid_STD_V_9 : 349|1@1+ (1,0) [0|1] "bool"  ACM
 SG_ OBJ_Angle_Bottom_V_9 : 350|1@1+ (1,0) [0|1] "bool"  ACM
 SG_ OBJ_Angle_Bottom_9 : 351|14@1+ (0.0002,-1.571) [-1.571|1.571] "rad"  ACM
 SG_ OBJ_Angle_Bottom_STD_9 : 368|13@1+ (0.0002,0) [0|1.571] "rad"  ACM
 SG_ OBJ_Angle_Bottom_STD_V_9 : 381|1@1+ (1,0) [0|1] "bool"  ACM
 SG_ OBJ_Visibility_Side_V_9 : 382|1@1+ (1,0) [0|1] "bool"  ACM
 SG_ OBJ_Visibility_Side_9 : 383|2@1+ (1,0) [0|2] "ENUM"  ACM
 SG_ OBJ_Is_In_Drivable_Area_9 : 385|1@1+ (1,0) [0|1] "bool"  ACM
 SG_ OBJ_Is_In_Drivable_Area_V_9 : 386|1@1+ (1,0) [0|1] "bool"  ACM
 SG_ OBJ_Is_VeryClose_9 : 387|1@1+ (1,0) [0|1] "bool"  ACM
 SG_ OBJ_Is_VeryClose_V_9 : 388|1@1+ (1,0) [0|1] "bool"  ACM
 SG_ OBJ_Buffer_9 : 389|11@1+ (1,0) [0|0] "NA"  ACM

BO_ 163 ICM_Object_Prot9_A: 64 MyECU
 SG_ ICM_Object_Prot9_A_Header : 0|16@1+ (1,0) [0|65535] ""  ACM
 SG_ OBJ_CRC_9 : 16|32@1+ (1,0) [0|4294967295] "NA"  ACM
 SG_ OBJ_ID_9 : 48|8@1+ (1,0) [0|255] "NA"  ACM
 SG_ OBJ_Existence_Probability_9 : 56|8@1+ (0.01,0) [0|1] "NA"  ACM
 SG_ OBJ_Fusion_Source_9 : 64|16@1+ (1,0) [0|65535] "BITWIZE"  ACM
 SG_ OBJ_Triggered_SDM_9 : 80|2@1+ (1,0) [0|2] "ENUM"  ACM
 SG_ OBJ_Motion_Category_9 : 82|4@1+ (1,0) [0|13] "ENUM "  ACM
 SG_ OBJ_Moving_IN_Probability_9 : 86|7@1+ (0.01,0) [0|0] "NA"  ACM
 SG_ OBJ_Object_Age_9 : 93|11@1+ (1,0) [0|2047] "Frame"  ACM
 SG_ OBJ_Measuring_Status_9 : 104|3@1+ (1,0) [0|7] "BITWIZE"  ACM
 SG_ OBJ_Object_Class_9 : 107|4@1+ (1,0) [0|8] "ENUM"  ACM
 SG_ OBJ_Class_Probability_9 : 112|7@1+ (0.01,0) [0|1] "NA"  ACM
 SG_ OBJ_Car_Probability_9 : 119|7@1+ (0.01,0) [0|0] "NA"  ACM
 SG_ OBJ_Truck_Probability_9 : 126|7@1+ (0.01,0) [0|0] "NA"  ACM
 SG_ OBJ_Bike_Probability_9 : 133|7@1+ (0.01,0) [0|0] "NA"  ACM
 SG_ OBJ_Camera_Source_9 : 140|4@1+ (1,0) [0|15] "ENUM"  ACM
 SG_ OBJ_Motion_Status_9 : 144|3@1+ (1,0) [0|5] "ENUM "  ACM
 SG_ OBJ_Motion_Orientation_9 : 147|4@1+ (1,0) [0|13] "ENUM "  ACM
 SG_ OBJ_Has_Cut_Lane_9 : 151|1@1+ (1,0) [0|1] "bool"  ACM
 SG_ OBJ_Has_Cut_Path_9 : 152|1@1+ (1,0) [0|1] "bool"  ACM
 SG_ OBJ_Brake_Light_9 : 153|1@1+ (1,0) [0|1] "bool"  ACM
 SG_ OBJ_Turn_Indicator_Right_9 : 154|1@1+ (1,0) [0|1] "bool"  ACM
 SG_ OBJ_Turn_Indicator_Left_9 : 155|1@1+ (1,0) [0|1] "bool"  ACM
 SG_ OBJ_Light_Indicator_Validity_9 : 156|1@1+ (1,0) [0|1] "bool"  ACM
 SG_ OBJ_Right_Out_Of_Image_9 : 157|1@1+ (1,0) [0|1] "bool"  ACM
 SG_ OBJ_Left_Out_Of_Image_9 : 158|1@1+ (1,0) [0|1] "bool"  ACM
 SG_ OBJ_Right_Out_Of_Image_V_9 : 159|1@1+ (1,0) [0|1] "bool"  ACM
 SG_ OBJ_Left_Out_Of_Image_V_9 : 160|1@1+ (1,0) [0|1] "bool"  ACM
 SG_ OBJ_Top_Out_Of_Image_9 : 161|1@1+ (1,0) [0|1] "bool"  ACM
 SG_ OBJ_Bottom_Out_Of_Image_9 : 162|1@1+ (1,0) [0|1] "bool"  ACM
 SG_ OBJ_Top_Out_Of_Image_V_9 : 163|1@1+ (1,0) [0|1] "bool"  ACM
 SG_ OBJ_Bottom_Out_Of_Image_V_9 : 164|1@1+ (1,0) [0|1] "bool"  ACM
 SG_ OBJ_Lane_Assignment_9 : 165|3@1+ (1,0) [0|5] "ENUM"  ACM
 SG_ OBJ_Lane_Assignment_V_9 : 168|1@1+ (1,0) [0|1] "bool"  ACM
 SG_ OBJ_Age_Seconds_9 : 169|7@1+ (1,0) [0|100] "s"  ACM
 SG_ OBJ_Age_Seconds_V_9 : 176|1@1+ (1,0) [0|1] "bool"  ACM
 SG_ OBJ_Width_9 : 177|9@1+ (0.01,0) [0.4|2.95] "m"  ACM
 SG_ OBJ_Width_V_9 : 186|1@1+ (1,0) [0|1] "bool"  ACM
 SG_ OBJ_Width_STD_9 : 187|8@1+ (0.01,0) [0|2] "m"  ACM
 SG_ OBJ_Width_STD_V_9 : 195|1@1+ (1,0) [0|1] "bool"  ACM
 SG_ OBJ_Length_9 : 196|9@1+ (0.05,0) [1.2|21] "m"  ACM
 SG_ OBJ_Length_V_9 : 205|1@1+ (1,0) [0|1] "bool"  ACM
 SG_ OBJ_Length_STD_9 : 208|8@1+ (0.05,0) [0|10] "m"  ACM
 SG_ OBJ_Length_STD_V_9 : 216|1@1+ (1,0) [0|1] "bool"  ACM
 SG_ OBJ_Height_9 : 217|9@1+ (0.01,0) [0|2.95] "m"  ACM
 SG_ OBJ_Height_V_9 : 226|1@1+ (1,0) [0|1] "bool"  ACM
 SG_ OBJ_Height_STD_9 : 227|8@1+ (0.01,0) [0|2] "m"  ACM
 SG_ OBJ_Height_STD_V_9 : 235|1@1+ (1,0) [0|1] "bool"  ACM
 SG_ OBJ_Abs_Long_Velocity_9 : 240|12@1+ (0.05,-30) [-30|100] "MPS"  ACM
 SG_ OBJ_Abs_Long_Velocity_V_9 : 252|1@1+ (1,0) [0|1] "bool"  ACM
 SG_ OBJ_Abs_Long_Velocity_STD_9 : 253|11@1+ (0.05,0) [0|65] "MPS"  ACM
 SG_ OBJ_Abs_Long_Vel_STD_V_9 : 264|1@1+ (1,0) [0|1] "bool"  ACM
 SG_ OBJ_Abs_Lat_Velocity_9 : 272|11@1+ (0.05,-50) [-50|50] "MPS"  ACM
 SG_ OBJ_Abs_Lat_Velocity_V_9 : 283|1@1+ (1,0) [0|1] "bool"  ACM
 SG_ OBJ_Abs_Lat_Velocity_STD_9 : 284|10@1+ (0.05,0) [0|50] "MPS"  ACM
 SG_ OBJ_Abs_Lat_Vel_STD_V_9 : 294|1@1+ (1,0) [0|1] "bool"  ACM
 SG_ OBJ_Abs_Long_Acc_9 : 295|9@1+ (0.05,-10.3) [-10.3|7.3] "MPS2"  ACM
 SG_ OBJ_Abs_Long_Acc_V_9 : 304|1@1+ (1,0) [0|1] "bool"  ACM
 SG_ OBJ_Abs_Long_Acc_STD_9 : 305|8@1+ (0.05,0) [0|7.3] "MPS2"  ACM
 SG_ OBJ_Abs_Long_Acc_STD_V_9 : 313|1@1+ (1,0) [0|1] "bool"  ACM
 SG_ OBJ_Abs_Lat_Acc_9 : 314|9@1+ (0.05,-10.3) [-10.3|7.3] "MPS2"  ACM
 SG_ OBJ_Abs_Lat_Acc_V_9 : 323|1@1+ (1,0) [0|1] "bool"  ACM
 SG_ OBJ_Abs_Lat_Acc_STD_9 : 324|8@1+ (0.05,0) [0|7.3] "MPS2"  ACM
 SG_ OBJ_Abs_Lat_Acc_STD_V_9 : 332|1@1+ (1,0) [0|1] "bool"  ACM
 SG_ OBJ_Abs_Acceleration_9 : 336|9@1+ (0.05,-10.3) [-10.3|7.3] "MPS2"  ACM
 SG_ OBJ_Abs_Acceleration_V_9 : 345|1@1+ (1,0) [0|1] "bool"  ACM
 SG_ OBJ_Abs_Acc_STD_9 : 346|8@1+ (0.05,0) [0|7.3] "MPS2"  ACM
 SG_ OBJ_Abs_Acc_STD_V_9 : 354|1@1+ (1,0) [0|1] "bool"  ACM
 SG_ OBJ_Inv_TTC_9 : 355|11@1+ (0.01,-8) [-8|8] "INV(s)"  ACM
 SG_ OBJ_Inv_TTC_V_9 : 366|1@1+ (1,0) [0|1] "bool"  ACM
 SG_ OBJ_Inv_TTC_STD_9 : 368|11@1+ (0.01,0) [0|4] "INV(s)"  ACM
 SG_ OBJ_Inv_TTC_STD_V_9 : 379|1@1+ (1,0) [0|1] "bool"  ACM
 SG_ OBJ_Relative_Long_Acc_9 : 380|9@1+ (0.05,-10.3) [-10.3|7.3] "MPS2"  ACM
 SG_ OBJ_Relative_Long_Acc_V_9 : 389|1@1+ (1,0) [0|1] "bool"  ACM
 SG_ OBJ_Relative_Long_Acc_STD_9 : 390|8@1+ (0.05,0) [0|7.3] "MPS2"  ACM
 SG_ OBJ_Rel_Long_Acc_STD_V_9 : 398|1@1+ (1,0) [0|1] "bool"  ACM

BO_ 162 ICM_Object_Prot8_B: 64 MyECU
 SG_ ICM_Object_Prot8_B_Header : 0|16@1+ (1,0) [0|65535] ""  ACM
 SG_ OBJ_Relative_Long_Velocity_8 : 16|13@1+ (0.05,-120) [-120|130] "MPS"  ACM
 SG_ OBJ_Relative_Long_Velocity_V_8 : 29|1@1+ (1,0) [0|1] "bool"  ACM
 SG_ OBJ_Relative_Long_Vel_STD_8 : 30|12@1+ (0.05,0) [0|130] "MPS"  ACM
 SG_ OBJ_Rel_Long_Vel_STD_V_8 : 42|1@1+ (1,0) [0|1] "bool"  ACM
 SG_ OBJ_Relative_Lat_Velocity_8 : 48|11@1+ (0.05,-50) [-50|50] "MPS"  ACM
 SG_ OBJ_Relative_Lat_Velocity_V_8 : 59|1@1+ (1,0) [0|1] "bool"  ACM
 SG_ OBJ_Relative_Lat_Velocity_STD_8 : 60|10@1+ (0.05,0) [0|50] "MPS"  ACM
 SG_ OBJ_Rel_Lat_Vel_STD_V_8 : 70|1@1+ (1,0) [0|1] "bool"  ACM
 SG_ OBJ_Long_Distance_8 : 80|14@1+ (0.05,-200) [-200|250] "m"  ACM
 SG_ OBJ_Long_Distance_V_8 : 94|1@1+ (1,0) [0|1] "bool"  ACM
 SG_ OBJ_Long_Distance_STD_8 : 95|13@1+ (0.05,0) [0|250] "m"  ACM
 SG_ OBJ_Long_Distance_STD_V_8 : 108|1@1+ (1,0) [0|1] "bool"  ACM
 SG_ OBJ_Lat_Distance_8 : 112|12@1+ (0.05,-100) [-100|100] "m"  ACM
 SG_ OBJ_Lat_Distance_V_8 : 124|1@1+ (1,0) [0|1] "bool"  ACM
 SG_ OBJ_Lat_Distance_STD_8 : 125|11@1+ (0.05,0) [0|100] "m"  ACM
 SG_ OBJ_Lat_Distance_STD_V_8 : 136|1@1+ (1,0) [0|1] "bool"  ACM
 SG_ OBJ_Absolute_Speed_8 : 144|12@1+ (0.05,-65) [-65|65] "MPS"  ACM
 SG_ OBJ_Absolute_Speed_V_8 : 156|1@1+ (1,0) [0|1] "bool"  ACM
 SG_ OBJ_Absolute_Speed_STD_8 : 157|11@1+ (0.05,0) [0|65] "MPS"  ACM
 SG_ OBJ_Absolute_Speed_STD_V_8 : 168|1@1+ (1,0) [0|1] "bool"  ACM
 SG_ OBJ_Heading_8 : 176|10@1+ (0.01,-3.14) [-3.14|3.14] "rad"  ACM
 SG_ OBJ_Heading_V_8 : 186|1@1+ (1,0) [0|1] "bool"  ACM
 SG_ OBJ_Heading_STD_8 : 187|9@1+ (0.01,0) [0|3.14] "rad"  ACM
 SG_ OBJ_Heading_STD_V_8 : 196|1@1+ (1,0) [0|1] "bool"  ACM
 SG_ OBJ_Angle_Rate_STD_8 : 197|11@1+ (0.002,0) [0|2.2318] "RPS"  ACM
 SG_ OBJ_Angle_Rate_STD_V_8 : 208|1@1+ (1,0) [0|1] "bool"  ACM
 SG_ OBJ_Angle_Rate_8 : 209|12@1+ (0.002,-2.234) [-2.234|2.2318] "RPS"  ACM
 SG_ OBJ_Angle_Rate_V_8 : 221|1@1+ (1,0) [0|1] "bool"  ACM
 SG_ OBJ_Angle_Right_8 : 222|14@1+ (0.0002,-1.571) [-1.571|1.571] "rad "  ACM
 SG_ OBJ_Angle_Right_V_8 : 236|1@1+ (1,0) [0|1] "bool"  ACM
 SG_ OBJ_Angle_Right_STD_8 : 240|13@1+ (0.0002,0) [0|1.571] "rad "  ACM
 SG_ OBJ_Angle_Right_STD_V_8 : 253|1@1+ (1,0) [0|1] "bool"  ACM
 SG_ OBJ_Angle_Left_8 : 254|14@1+ (0.0002,-1.571) [-1.571|1.571] "rad "  ACM
 SG_ OBJ_Angle_Left_V_8 : 268|1@1+ (1,0) [0|1] "bool"  ACM
 SG_ OBJ_Angle_Left_STD_8 : 272|13@1+ (0.0002,0) [0|1.571] "rad"  ACM
 SG_ OBJ_Angle_Left_STD_V_8 : 285|1@1+ (1,0) [0|1] "bool"  ACM
 SG_ OBJ_Angle_Side_8 : 286|14@1+ (0.0002,-1.571) [-1.571|1.571] "rad"  ACM
 SG_ OBJ_Angle_Side_V_8 : 300|1@1+ (1,0) [0|1] "bool"  ACM
 SG_ OBJ_Angle_Side_STD_8 : 304|13@1+ (0.0002,0) [0|1.571] "rad"  ACM
 SG_ OBJ_Angle_Side_STD_V_8 : 317|1@1+ (1,0) [0|1] "bool"  ACM
 SG_ OBJ_Angle_Mid_V_8 : 318|1@1+ (1,0) [0|1] "bool"  ACM
 SG_ OBJ_Angle_Mid_8 : 319|14@1+ (0.0002,-1.571) [-1.571|1.571] "rad"  ACM
 SG_ OBJ_Angle_Mid_STD_8 : 336|13@1+ (0.0002,0) [0|1.571] "rad"  ACM
 SG_ OBJ_Angle_Mid_STD_V_8 : 349|1@1+ (1,0) [0|1] "bool"  ACM
 SG_ OBJ_Angle_Bottom_V_8 : 350|1@1+ (1,0) [0|1] "bool"  ACM
 SG_ OBJ_Angle_Bottom_8 : 351|14@1+ (0.0002,-1.571) [-1.571|1.571] "rad"  ACM
 SG_ OBJ_Angle_Bottom_STD_8 : 368|13@1+ (0.0002,0) [0|1.571] "rad"  ACM
 SG_ OBJ_Angle_Bottom_STD_V_8 : 381|1@1+ (1,0) [0|1] "bool"  ACM
 SG_ OBJ_Visibility_Side_V_8 : 382|1@1+ (1,0) [0|1] "bool"  ACM
 SG_ OBJ_Visibility_Side_8 : 383|2@1+ (1,0) [0|2] "ENUM"  ACM
 SG_ OBJ_Is_In_Drivable_Area_8 : 385|1@1+ (1,0) [0|1] "bool"  ACM
 SG_ OBJ_Is_In_Drivable_Area_V_8 : 386|1@1+ (1,0) [0|1] "bool"  ACM
 SG_ OBJ_Is_VeryClose_8 : 387|1@1+ (1,0) [0|1] "bool"  ACM
 SG_ OBJ_Is_VeryClose_V_8 : 388|1@1+ (1,0) [0|1] "bool"  ACM
 SG_ OBJ_Buffer_8 : 389|11@1+ (1,0) [0|0] "NA"  ACM

BO_ 161 ICM_Object_Prot8_A: 64 MyECU
 SG_ ICM_Object_Prot8_A_Header : 0|16@1+ (1,0) [0|65535] ""  ACM
 SG_ OBJ_CRC_8 : 16|32@1+ (1,0) [0|4294967295] "NA"  ACM
 SG_ OBJ_ID_8 : 48|8@1+ (1,0) [0|255] "NA"  ACM
 SG_ OBJ_Existence_Probability_8 : 56|8@1+ (0.01,0) [0|1] "NA"  ACM
 SG_ OBJ_Fusion_Source_8 : 64|16@1+ (1,0) [0|65535] "BITWIZE"  ACM
 SG_ OBJ_Triggered_SDM_8 : 80|2@1+ (1,0) [0|2] "ENUM"  ACM
 SG_ OBJ_Motion_Category_8 : 82|4@1+ (1,0) [0|13] "ENUM "  ACM
 SG_ OBJ_Moving_IN_Probability_8 : 86|7@1+ (0.01,0) [0|0] "NA"  ACM
 SG_ OBJ_Object_Age_8 : 93|11@1+ (1,0) [0|2047] "Frame"  ACM
 SG_ OBJ_Measuring_Status_8 : 104|3@1+ (1,0) [0|7] "BITWIZE"  ACM
 SG_ OBJ_Object_Class_8 : 107|4@1+ (1,0) [0|8] "ENUM"  ACM
 SG_ OBJ_Class_Probability_8 : 112|7@1+ (0.01,0) [0|1] "NA"  ACM
 SG_ OBJ_Car_Probability_8 : 119|7@1+ (0.01,0) [0|0] "NA"  ACM
 SG_ OBJ_Truck_Probability_8 : 126|7@1+ (0.01,0) [0|0] "NA"  ACM
 SG_ OBJ_Bike_Probability_8 : 133|7@1+ (0.01,0) [0|0] "NA"  ACM
 SG_ OBJ_Camera_Source_8 : 140|4@1+ (1,0) [0|15] "ENUM"  ACM
 SG_ OBJ_Motion_Status_8 : 144|3@1+ (1,0) [0|5] "ENUM "  ACM
 SG_ OBJ_Motion_Orientation_8 : 147|4@1+ (1,0) [0|13] "ENUM "  ACM
 SG_ OBJ_Has_Cut_Lane_8 : 151|1@1+ (1,0) [0|1] "bool"  ACM
 SG_ OBJ_Has_Cut_Path_8 : 152|1@1+ (1,0) [0|1] "bool"  ACM
 SG_ OBJ_Brake_Light_8 : 153|1@1+ (1,0) [0|1] "bool"  ACM
 SG_ OBJ_Turn_Indicator_Right_8 : 154|1@1+ (1,0) [0|1] "bool"  ACM
 SG_ OBJ_Turn_Indicator_Left_8 : 155|1@1+ (1,0) [0|1] "bool"  ACM
 SG_ OBJ_Light_Indicator_Validity_8 : 156|1@1+ (1,0) [0|1] "bool"  ACM
 SG_ OBJ_Right_Out_Of_Image_8 : 157|1@1+ (1,0) [0|1] "bool"  ACM
 SG_ OBJ_Left_Out_Of_Image_8 : 158|1@1+ (1,0) [0|1] "bool"  ACM
 SG_ OBJ_Right_Out_Of_Image_V_8 : 159|1@1+ (1,0) [0|1] "bool"  ACM
 SG_ OBJ_Left_Out_Of_Image_V_8 : 160|1@1+ (1,0) [0|1] "bool"  ACM
 SG_ OBJ_Top_Out_Of_Image_8 : 161|1@1+ (1,0) [0|1] "bool"  ACM
 SG_ OBJ_Bottom_Out_Of_Image_8 : 162|1@1+ (1,0) [0|1] "bool"  ACM
 SG_ OBJ_Top_Out_Of_Image_V_8 : 163|1@1+ (1,0) [0|1] "bool"  ACM
 SG_ OBJ_Bottom_Out_Of_Image_V_8 : 164|1@1+ (1,0) [0|1] "bool"  ACM
 SG_ OBJ_Lane_Assignment_8 : 165|3@1+ (1,0) [0|5] "ENUM"  ACM
 SG_ OBJ_Lane_Assignment_V_8 : 168|1@1+ (1,0) [0|1] "bool"  ACM
 SG_ OBJ_Age_Seconds_8 : 169|7@1+ (1,0) [0|100] "s"  ACM
 SG_ OBJ_Age_Seconds_V_8 : 176|1@1+ (1,0) [0|1] "bool"  ACM
 SG_ OBJ_Width_8 : 177|9@1+ (0.01,0) [0.4|2.95] "m"  ACM
 SG_ OBJ_Width_V_8 : 186|1@1+ (1,0) [0|1] "bool"  ACM
 SG_ OBJ_Width_STD_8 : 187|8@1+ (0.01,0) [0|2] "m"  ACM
 SG_ OBJ_Width_STD_V_8 : 195|1@1+ (1,0) [0|1] "bool"  ACM
 SG_ OBJ_Length_8 : 196|9@1+ (0.05,0) [1.2|21] "m"  ACM
 SG_ OBJ_Length_V_8 : 205|1@1+ (1,0) [0|1] "bool"  ACM
 SG_ OBJ_Length_STD_8 : 208|8@1+ (0.05,0) [0|10] "m"  ACM
 SG_ OBJ_Length_STD_V_8 : 216|1@1+ (1,0) [0|1] "bool"  ACM
 SG_ OBJ_Height_8 : 217|9@1+ (0.01,0) [0|2.95] "m"  ACM
 SG_ OBJ_Height_V_8 : 226|1@1+ (1,0) [0|1] "bool"  ACM
 SG_ OBJ_Height_STD_8 : 227|8@1+ (0.01,0) [0|2] "m"  ACM
 SG_ OBJ_Height_STD_V_8 : 235|1@1+ (1,0) [0|1] "bool"  ACM
 SG_ OBJ_Abs_Long_Velocity_8 : 240|12@1+ (0.05,-30) [-30|100] "MPS"  ACM
 SG_ OBJ_Abs_Long_Velocity_V_8 : 252|1@1+ (1,0) [0|1] "bool"  ACM
 SG_ OBJ_Abs_Long_Velocity_STD_8 : 253|11@1+ (0.05,0) [0|65] "MPS"  ACM
 SG_ OBJ_Abs_Long_Vel_STD_V_8 : 264|1@1+ (1,0) [0|1] "bool"  ACM
 SG_ OBJ_Abs_Lat_Velocity_8 : 272|11@1+ (0.05,-50) [-50|50] "MPS"  ACM
 SG_ OBJ_Abs_Lat_Velocity_V_8 : 283|1@1+ (1,0) [0|1] "bool"  ACM
 SG_ OBJ_Abs_Lat_Velocity_STD_8 : 284|10@1+ (0.05,0) [0|50] "MPS"  ACM
 SG_ OBJ_Abs_Lat_Vel_STD_V_8 : 294|1@1+ (1,0) [0|1] "bool"  ACM
 SG_ OBJ_Abs_Long_Acc_8 : 295|9@1+ (0.05,-10.3) [-10.3|7.3] "MPS2"  ACM
 SG_ OBJ_Abs_Long_Acc_V_8 : 304|1@1+ (1,0) [0|1] "bool"  ACM
 SG_ OBJ_Abs_Long_Acc_STD_8 : 305|8@1+ (0.05,0) [0|7.3] "MPS2"  ACM
 SG_ OBJ_Abs_Long_Acc_STD_V_8 : 313|1@1+ (1,0) [0|1] "bool"  ACM
 SG_ OBJ_Abs_Lat_Acc_8 : 314|9@1+ (0.05,-10.3) [-10.3|7.3] "MPS2"  ACM
 SG_ OBJ_Abs_Lat_Acc_V_8 : 323|1@1+ (1,0) [0|1] "bool"  ACM
 SG_ OBJ_Abs_Lat_Acc_STD_8 : 324|8@1+ (0.05,0) [0|7.3] "MPS2"  ACM
 SG_ OBJ_Abs_Lat_Acc_STD_V_8 : 332|1@1+ (1,0) [0|1] "bool"  ACM
 SG_ OBJ_Abs_Acceleration_8 : 336|9@1+ (0.05,-10.3) [-10.3|7.3] "MPS2"  ACM
 SG_ OBJ_Abs_Acceleration_V_8 : 345|1@1+ (1,0) [0|1] "bool"  ACM
 SG_ OBJ_Abs_Acc_STD_8 : 346|8@1+ (0.05,0) [0|7.3] "MPS2"  ACM
 SG_ OBJ_Abs_Acc_STD_V_8 : 354|1@1+ (1,0) [0|1] "bool"  ACM
 SG_ OBJ_Inv_TTC_8 : 355|11@1+ (0.01,-8) [-8|8] "INV(s)"  ACM
 SG_ OBJ_Inv_TTC_V_8 : 366|1@1+ (1,0) [0|1] "bool"  ACM
 SG_ OBJ_Inv_TTC_STD_8 : 368|11@1+ (0.01,0) [0|4] "INV(s)"  ACM
 SG_ OBJ_Inv_TTC_STD_V_8 : 379|1@1+ (1,0) [0|1] "bool"  ACM
 SG_ OBJ_Relative_Long_Acc_8 : 380|9@1+ (0.05,-10.3) [-10.3|7.3] "MPS2"  ACM
 SG_ OBJ_Relative_Long_Acc_V_8 : 389|1@1+ (1,0) [0|1] "bool"  ACM
 SG_ OBJ_Relative_Long_Acc_STD_8 : 390|8@1+ (0.05,0) [0|7.3] "MPS2"  ACM
 SG_ OBJ_Rel_Long_Acc_STD_V_8 : 398|1@1+ (1,0) [0|1] "bool"  ACM

BO_ 160 ICM_Object_Prot7_B: 64 MyECU
 SG_ ICM_Object_Prot7_B_Header : 0|16@1+ (1,0) [0|65535] ""  ACM
 SG_ OBJ_Relative_Long_Velocity_7 : 16|13@1+ (0.05,-120) [-120|130] "MPS"  ACM
 SG_ OBJ_Relative_Long_Velocity_V_7 : 29|1@1+ (1,0) [0|1] "bool"  ACM
 SG_ OBJ_Relative_Long_Vel_STD_7 : 30|12@1+ (0.05,0) [0|130] "MPS"  ACM
 SG_ OBJ_Rel_Long_Vel_STD_V_7 : 42|1@1+ (1,0) [0|1] "bool"  ACM
 SG_ OBJ_Relative_Lat_Velocity_7 : 48|11@1+ (0.05,-50) [-50|50] "MPS"  ACM
 SG_ OBJ_Relative_Lat_Velocity_V_7 : 59|1@1+ (1,0) [0|1] "bool"  ACM
 SG_ OBJ_Relative_Lat_Velocity_STD_7 : 60|10@1+ (0.05,0) [0|50] "MPS"  ACM
 SG_ OBJ_Rel_Lat_Vel_STD_V_7 : 70|1@1+ (1,0) [0|1] "bool"  ACM
 SG_ OBJ_Long_Distance_7 : 80|14@1+ (0.05,-200) [-200|250] "m"  ACM
 SG_ OBJ_Long_Distance_V_7 : 94|1@1+ (1,0) [0|1] "bool"  ACM
 SG_ OBJ_Long_Distance_STD_7 : 95|13@1+ (0.05,0) [0|250] "m"  ACM
 SG_ OBJ_Long_Distance_STD_V_7 : 108|1@1+ (1,0) [0|1] "bool"  ACM
 SG_ OBJ_Lat_Distance_7 : 112|12@1+ (0.05,-100) [-100|100] "m"  ACM
 SG_ OBJ_Lat_Distance_V_7 : 124|1@1+ (1,0) [0|1] "bool"  ACM
 SG_ OBJ_Lat_Distance_STD_7 : 125|11@1+ (0.05,0) [0|100] "m"  ACM
 SG_ OBJ_Lat_Distance_STD_V_7 : 136|1@1+ (1,0) [0|1] "bool"  ACM
 SG_ OBJ_Absolute_Speed_7 : 144|12@1+ (0.05,-65) [-65|65] "MPS"  ACM
 SG_ OBJ_Absolute_Speed_V_7 : 156|1@1+ (1,0) [0|1] "bool"  ACM
 SG_ OBJ_Absolute_Speed_STD_7 : 157|11@1+ (0.05,0) [0|65] "MPS"  ACM
 SG_ OBJ_Absolute_Speed_STD_V_7 : 168|1@1+ (1,0) [0|1] "bool"  ACM
 SG_ OBJ_Heading_7 : 176|10@1+ (0.01,-3.14) [-3.14|3.14] "rad"  ACM
 SG_ OBJ_Heading_V_7 : 186|1@1+ (1,0) [0|1] "bool"  ACM
 SG_ OBJ_Heading_STD_7 : 187|9@1+ (0.01,0) [0|3.14] "rad"  ACM
 SG_ OBJ_Heading_STD_V_7 : 196|1@1+ (1,0) [0|1] "bool"  ACM
 SG_ OBJ_Angle_Rate_STD_7 : 197|11@1+ (0.002,0) [0|2.2318] "RPS"  ACM
 SG_ OBJ_Angle_Rate_STD_V_7 : 208|1@1+ (1,0) [0|1] "bool"  ACM
 SG_ OBJ_Angle_Rate_7 : 209|12@1+ (0.002,-2.234) [-2.234|2.2318] "RPS"  ACM
 SG_ OBJ_Angle_Rate_V_7 : 221|1@1+ (1,0) [0|1] "bool"  ACM
 SG_ OBJ_Angle_Right_7 : 222|14@1+ (0.0002,-1.571) [-1.571|1.571] "rad "  ACM
 SG_ OBJ_Angle_Right_V_7 : 236|1@1+ (1,0) [0|1] "bool"  ACM
 SG_ OBJ_Angle_Right_STD_7 : 240|13@1+ (0.0002,0) [0|1.571] "rad "  ACM
 SG_ OBJ_Angle_Right_STD_V_7 : 253|1@1+ (1,0) [0|1] "bool"  ACM
 SG_ OBJ_Angle_Left_7 : 254|14@1+ (0.0002,-1.571) [-1.571|1.571] "rad "  ACM
 SG_ OBJ_Angle_Left_V_7 : 268|1@1+ (1,0) [0|1] "bool"  ACM
 SG_ OBJ_Angle_Left_STD_7 : 272|13@1+ (0.0002,0) [0|1.571] "rad"  ACM
 SG_ OBJ_Angle_Left_STD_V_7 : 285|1@1+ (1,0) [0|1] "bool"  ACM
 SG_ OBJ_Angle_Side_7 : 286|14@1+ (0.0002,-1.571) [-1.571|1.571] "rad"  ACM
 SG_ OBJ_Angle_Side_V_7 : 300|1@1+ (1,0) [0|1] "bool"  ACM
 SG_ OBJ_Angle_Side_STD_7 : 304|13@1+ (0.0002,0) [0|1.571] "rad"  ACM
 SG_ OBJ_Angle_Side_STD_V_7 : 317|1@1+ (1,0) [0|1] "bool"  ACM
 SG_ OBJ_Angle_Mid_V_7 : 318|1@1+ (1,0) [0|1] "bool"  ACM
 SG_ OBJ_Angle_Mid_7 : 319|14@1+ (0.0002,-1.571) [-1.571|1.571] "rad"  ACM
 SG_ OBJ_Angle_Mid_STD_7 : 336|13@1+ (0.0002,0) [0|1.571] "rad"  ACM
 SG_ OBJ_Angle_Mid_STD_V_7 : 349|1@1+ (1,0) [0|1] "bool"  ACM
 SG_ OBJ_Angle_Bottom_V_7 : 350|1@1+ (1,0) [0|1] "bool"  ACM
 SG_ OBJ_Angle_Bottom_7 : 351|14@1+ (0.0002,-1.571) [-1.571|1.571] "rad"  ACM
 SG_ OBJ_Angle_Bottom_STD_7 : 368|13@1+ (0.0002,0) [0|1.571] "rad"  ACM
 SG_ OBJ_Angle_Bottom_STD_V_7 : 381|1@1+ (1,0) [0|1] "bool"  ACM
 SG_ OBJ_Visibility_Side_V_7 : 382|1@1+ (1,0) [0|1] "bool"  ACM
 SG_ OBJ_Visibility_Side_7 : 383|2@1+ (1,0) [0|2] "ENUM"  ACM
 SG_ OBJ_Is_In_Drivable_Area_7 : 385|1@1+ (1,0) [0|1] "bool"  ACM
 SG_ OBJ_Is_In_Drivable_Area_V_7 : 386|1@1+ (1,0) [0|1] "bool"  ACM
 SG_ OBJ_Is_VeryClose_7 : 387|1@1+ (1,0) [0|1] "bool"  ACM
 SG_ OBJ_Is_VeryClose_V_7 : 388|1@1+ (1,0) [0|1] "bool"  ACM
 SG_ OBJ_Buffer_7 : 389|11@1+ (1,0) [0|0] "NA"  ACM

BO_ 159 ICM_Object_Prot7_A: 64 MyECU
 SG_ ICM_Object_Prot7_A_Header : 0|16@1+ (1,0) [0|65535] ""  ACM
 SG_ OBJ_CRC_7 : 16|32@1+ (1,0) [0|4294967295] "NA"  ACM
 SG_ OBJ_ID_7 : 48|8@1+ (1,0) [0|255] "NA"  ACM
 SG_ OBJ_Existence_Probability_7 : 56|8@1+ (0.01,0) [0|1] "NA"  ACM
 SG_ OBJ_Fusion_Source_7 : 64|16@1+ (1,0) [0|65535] "BITWIZE"  ACM
 SG_ OBJ_Triggered_SDM_7 : 80|2@1+ (1,0) [0|2] "ENUM"  ACM
 SG_ OBJ_Motion_Category_7 : 82|4@1+ (1,0) [0|13] "ENUM "  ACM
 SG_ OBJ_Moving_IN_Probability_7 : 86|7@1+ (0.01,0) [0|0] "NA"  ACM
 SG_ OBJ_Object_Age_7 : 93|11@1+ (1,0) [0|2047] "Frame"  ACM
 SG_ OBJ_Measuring_Status_7 : 104|3@1+ (1,0) [0|7] "BITWIZE"  ACM
 SG_ OBJ_Object_Class_7 : 107|4@1+ (1,0) [0|8] "ENUM"  ACM
 SG_ OBJ_Class_Probability_7 : 112|7@1+ (0.01,0) [0|1] "NA"  ACM
 SG_ OBJ_Car_Probability_7 : 119|7@1+ (0.01,0) [0|0] "NA"  ACM
 SG_ OBJ_Truck_Probability_7 : 126|7@1+ (0.01,0) [0|0] "NA"  ACM
 SG_ OBJ_Bike_Probability_7 : 133|7@1+ (0.01,0) [0|0] "NA"  ACM
 SG_ OBJ_Camera_Source_7 : 140|4@1+ (1,0) [0|15] "ENUM"  ACM
 SG_ OBJ_Motion_Status_7 : 144|3@1+ (1,0) [0|5] "ENUM "  ACM
 SG_ OBJ_Motion_Orientation_7 : 147|4@1+ (1,0) [0|13] "ENUM "  ACM
 SG_ OBJ_Has_Cut_Lane_7 : 151|1@1+ (1,0) [0|1] "bool"  ACM
 SG_ OBJ_Has_Cut_Path_7 : 152|1@1+ (1,0) [0|1] "bool"  ACM
 SG_ OBJ_Brake_Light_7 : 153|1@1+ (1,0) [0|1] "bool"  ACM
 SG_ OBJ_Turn_Indicator_Right_7 : 154|1@1+ (1,0) [0|1] "bool"  ACM
 SG_ OBJ_Turn_Indicator_Left_7 : 155|1@1+ (1,0) [0|1] "bool"  ACM
 SG_ OBJ_Light_Indicator_Validity_7 : 156|1@1+ (1,0) [0|1] "bool"  ACM
 SG_ OBJ_Right_Out_Of_Image_7 : 157|1@1+ (1,0) [0|1] "bool"  ACM
 SG_ OBJ_Left_Out_Of_Image_7 : 158|1@1+ (1,0) [0|1] "bool"  ACM
 SG_ OBJ_Right_Out_Of_Image_V_7 : 159|1@1+ (1,0) [0|1] "bool"  ACM
 SG_ OBJ_Left_Out_Of_Image_V_7 : 160|1@1+ (1,0) [0|1] "bool"  ACM
 SG_ OBJ_Top_Out_Of_Image_7 : 161|1@1+ (1,0) [0|1] "bool"  ACM
 SG_ OBJ_Bottom_Out_Of_Image_7 : 162|1@1+ (1,0) [0|1] "bool"  ACM
 SG_ OBJ_Top_Out_Of_Image_V_7 : 163|1@1+ (1,0) [0|1] "bool"  ACM
 SG_ OBJ_Bottom_Out_Of_Image_V_7 : 164|1@1+ (1,0) [0|1] "bool"  ACM
 SG_ OBJ_Lane_Assignment_7 : 165|3@1+ (1,0) [0|5] "ENUM"  ACM
 SG_ OBJ_Lane_Assignment_V_7 : 168|1@1+ (1,0) [0|1] "bool"  ACM
 SG_ OBJ_Age_Seconds_7 : 169|7@1+ (1,0) [0|100] "s"  ACM
 SG_ OBJ_Age_Seconds_V_7 : 176|1@1+ (1,0) [0|1] "bool"  ACM
 SG_ OBJ_Width_7 : 177|9@1+ (0.01,0) [0.4|2.95] "m"  ACM
 SG_ OBJ_Width_V_7 : 186|1@1+ (1,0) [0|1] "bool"  ACM
 SG_ OBJ_Width_STD_7 : 187|8@1+ (0.01,0) [0|2] "m"  ACM
 SG_ OBJ_Width_STD_V_7 : 195|1@1+ (1,0) [0|1] "bool"  ACM
 SG_ OBJ_Length_7 : 196|9@1+ (0.05,0) [1.2|21] "m"  ACM
 SG_ OBJ_Length_V_7 : 205|1@1+ (1,0) [0|1] "bool"  ACM
 SG_ OBJ_Length_STD_7 : 208|8@1+ (0.05,0) [0|10] "m"  ACM
 SG_ OBJ_Length_STD_V_7 : 216|1@1+ (1,0) [0|1] "bool"  ACM
 SG_ OBJ_Height_7 : 217|9@1+ (0.01,0) [0|2.95] "m"  ACM
 SG_ OBJ_Height_V_7 : 226|1@1+ (1,0) [0|1] "bool"  ACM
 SG_ OBJ_Height_STD_7 : 227|8@1+ (0.01,0) [0|2] "m"  ACM
 SG_ OBJ_Height_STD_V_7 : 235|1@1+ (1,0) [0|1] "bool"  ACM
 SG_ OBJ_Abs_Long_Velocity_7 : 240|12@1+ (0.05,-30) [-30|100] "MPS"  ACM
 SG_ OBJ_Abs_Long_Velocity_V_7 : 252|1@1+ (1,0) [0|1] "bool"  ACM
 SG_ OBJ_Abs_Long_Velocity_STD_7 : 253|11@1+ (0.05,0) [0|65] "MPS"  ACM
 SG_ OBJ_Abs_Long_Vel_STD_V_7 : 264|1@1+ (1,0) [0|1] "bool"  ACM
 SG_ OBJ_Abs_Lat_Velocity_7 : 272|11@1+ (0.05,-50) [-50|50] "MPS"  ACM
 SG_ OBJ_Abs_Lat_Velocity_V_7 : 283|1@1+ (1,0) [0|1] "bool"  ACM
 SG_ OBJ_Abs_Lat_Velocity_STD_7 : 284|10@1+ (0.05,0) [0|50] "MPS"  ACM
 SG_ OBJ_Abs_Lat_Vel_STD_V_7 : 294|1@1+ (1,0) [0|1] "bool"  ACM
 SG_ OBJ_Abs_Long_Acc_7 : 295|9@1+ (0.05,-10.3) [-10.3|7.3] "MPS2"  ACM
 SG_ OBJ_Abs_Long_Acc_V_7 : 304|1@1+ (1,0) [0|1] "bool"  ACM
 SG_ OBJ_Abs_Long_Acc_STD_7 : 305|8@1+ (0.05,0) [0|7.3] "MPS2"  ACM
 SG_ OBJ_Abs_Long_Acc_STD_V_7 : 313|1@1+ (1,0) [0|1] "bool"  ACM
 SG_ OBJ_Abs_Lat_Acc_7 : 314|9@1+ (0.05,-10.3) [-10.3|7.3] "MPS2"  ACM
 SG_ OBJ_Abs_Lat_Acc_V_7 : 323|1@1+ (1,0) [0|1] "bool"  ACM
 SG_ OBJ_Abs_Lat_Acc_STD_7 : 324|8@1+ (0.05,0) [0|7.3] "MPS2"  ACM
 SG_ OBJ_Abs_Lat_Acc_STD_V_7 : 332|1@1+ (1,0) [0|1] "bool"  ACM
 SG_ OBJ_Abs_Acceleration_7 : 336|9@1+ (0.05,-10.3) [-10.3|7.3] "MPS2"  ACM
 SG_ OBJ_Abs_Acceleration_V_7 : 345|1@1+ (1,0) [0|1] "bool"  ACM
 SG_ OBJ_Abs_Acc_STD_7 : 346|8@1+ (0.05,0) [0|7.3] "MPS2"  ACM
 SG_ OBJ_Abs_Acc_STD_V_7 : 354|1@1+ (1,0) [0|1] "bool"  ACM
 SG_ OBJ_Inv_TTC_7 : 355|11@1+ (0.01,-8) [-8|8] "INV(s)"  ACM
 SG_ OBJ_Inv_TTC_V_7 : 366|1@1+ (1,0) [0|1] "bool"  ACM
 SG_ OBJ_Inv_TTC_STD_7 : 368|11@1+ (0.01,0) [0|4] "INV(s)"  ACM
 SG_ OBJ_Inv_TTC_STD_V_7 : 379|1@1+ (1,0) [0|1] "bool"  ACM
 SG_ OBJ_Relative_Long_Acc_7 : 380|9@1+ (0.05,-10.3) [-10.3|7.3] "MPS2"  ACM
 SG_ OBJ_Relative_Long_Acc_V_7 : 389|1@1+ (1,0) [0|1] "bool"  ACM
 SG_ OBJ_Relative_Long_Acc_STD_7 : 390|8@1+ (0.05,0) [0|7.3] "MPS2"  ACM
 SG_ OBJ_Rel_Long_Acc_STD_V_7 : 398|1@1+ (1,0) [0|1] "bool"  ACM

BO_ 158 ICM_Object_Prot6_B: 64 MyECU
 SG_ ICM_Object_Prot6_B_Header : 0|16@1+ (1,0) [0|65535] ""  ACM
 SG_ OBJ_Relative_Long_Velocity_6 : 16|13@1+ (0.05,-120) [-120|130] "MPS"  ACM
 SG_ OBJ_Relative_Long_Velocity_V_6 : 29|1@1+ (1,0) [0|1] "bool"  ACM
 SG_ OBJ_Relative_Long_Vel_STD_6 : 30|12@1+ (0.05,0) [0|130] "MPS"  ACM
 SG_ OBJ_Rel_Long_Vel_STD_V_6 : 42|1@1+ (1,0) [0|1] "bool"  ACM
 SG_ OBJ_Relative_Lat_Velocity_6 : 48|11@1+ (0.05,-50) [-50|50] "MPS"  ACM
 SG_ OBJ_Relative_Lat_Velocity_V_6 : 59|1@1+ (1,0) [0|1] "bool"  ACM
 SG_ OBJ_Relative_Lat_Velocity_STD_6 : 60|10@1+ (0.05,0) [0|50] "MPS"  ACM
 SG_ OBJ_Rel_Lat_Vel_STD_V_6 : 70|1@1+ (1,0) [0|1] "bool"  ACM
 SG_ OBJ_Long_Distance_6 : 80|14@1+ (0.05,-200) [-200|250] "m"  ACM
 SG_ OBJ_Long_Distance_V_6 : 94|1@1+ (1,0) [0|1] "bool"  ACM
 SG_ OBJ_Long_Distance_STD_6 : 95|13@1+ (0.05,0) [0|250] "m"  ACM
 SG_ OBJ_Long_Distance_STD_V_6 : 108|1@1+ (1,0) [0|1] "bool"  ACM
 SG_ OBJ_Lat_Distance_6 : 112|12@1+ (0.05,-100) [-100|100] "m"  ACM
 SG_ OBJ_Lat_Distance_V_6 : 124|1@1+ (1,0) [0|1] "bool"  ACM
 SG_ OBJ_Lat_Distance_STD_6 : 125|11@1+ (0.05,0) [0|100] "m"  ACM
 SG_ OBJ_Lat_Distance_STD_V_6 : 136|1@1+ (1,0) [0|1] "bool"  ACM
 SG_ OBJ_Absolute_Speed_6 : 144|12@1+ (0.05,-65) [-65|65] "MPS"  ACM
 SG_ OBJ_Absolute_Speed_V_6 : 156|1@1+ (1,0) [0|1] "bool"  ACM
 SG_ OBJ_Absolute_Speed_STD_6 : 157|11@1+ (0.05,0) [0|65] "MPS"  ACM
 SG_ OBJ_Absolute_Speed_STD_V_6 : 168|1@1+ (1,0) [0|1] "bool"  ACM
 SG_ OBJ_Heading_6 : 176|10@1+ (0.01,-3.14) [-3.14|3.14] "rad"  ACM
 SG_ OBJ_Heading_V_6 : 186|1@1+ (1,0) [0|1] "bool"  ACM
 SG_ OBJ_Heading_STD_6 : 187|9@1+ (0.01,0) [0|3.14] "rad"  ACM
 SG_ OBJ_Heading_STD_V_6 : 196|1@1+ (1,0) [0|1] "bool"  ACM
 SG_ OBJ_Angle_Rate_STD_6 : 197|11@1+ (0.002,0) [0|2.2318] "RPS"  ACM
 SG_ OBJ_Angle_Rate_STD_V_6 : 208|1@1+ (1,0) [0|1] "bool"  ACM
 SG_ OBJ_Angle_Rate_6 : 209|12@1+ (0.002,-2.234) [-2.234|2.2318] "RPS"  ACM
 SG_ OBJ_Angle_Rate_V_6 : 221|1@1+ (1,0) [0|1] "bool"  ACM
 SG_ OBJ_Angle_Right_6 : 222|14@1+ (0.0002,-1.571) [-1.571|1.571] "rad "  ACM
 SG_ OBJ_Angle_Right_V_6 : 236|1@1+ (1,0) [0|1] "bool"  ACM
 SG_ OBJ_Angle_Right_STD_6 : 240|13@1+ (0.0002,0) [0|1.571] "rad "  ACM
 SG_ OBJ_Angle_Right_STD_V_6 : 253|1@1+ (1,0) [0|1] "bool"  ACM
 SG_ OBJ_Angle_Left_6 : 254|14@1+ (0.0002,-1.571) [-1.571|1.571] "rad "  ACM
 SG_ OBJ_Angle_Left_V_6 : 268|1@1+ (1,0) [0|1] "bool"  ACM
 SG_ OBJ_Angle_Left_STD_6 : 272|13@1+ (0.0002,0) [0|1.571] "rad"  ACM
 SG_ OBJ_Angle_Left_STD_V_6 : 285|1@1+ (1,0) [0|1] "bool"  ACM
 SG_ OBJ_Angle_Side_6 : 286|14@1+ (0.0002,-1.571) [-1.571|1.571] "rad"  ACM
 SG_ OBJ_Angle_Side_V_6 : 300|1@1+ (1,0) [0|1] "bool"  ACM
 SG_ OBJ_Angle_Side_STD_6 : 304|13@1+ (0.0002,0) [0|1.571] "rad"  ACM
 SG_ OBJ_Angle_Side_STD_V_6 : 317|1@1+ (1,0) [0|1] "bool"  ACM
 SG_ OBJ_Angle_Mid_V_6 : 318|1@1+ (1,0) [0|1] "bool"  ACM
 SG_ OBJ_Angle_Mid_6 : 319|14@1+ (0.0002,-1.571) [-1.571|1.571] "rad"  ACM
 SG_ OBJ_Angle_Mid_STD_6 : 336|13@1+ (0.0002,0) [0|1.571] "rad"  ACM
 SG_ OBJ_Angle_Mid_STD_V_6 : 349|1@1+ (1,0) [0|1] "bool"  ACM
 SG_ OBJ_Angle_Bottom_V_6 : 350|1@1+ (1,0) [0|1] "bool"  ACM
 SG_ OBJ_Angle_Bottom_6 : 351|14@1+ (0.0002,-1.571) [-1.571|1.571] "rad"  ACM
 SG_ OBJ_Angle_Bottom_STD_6 : 368|13@1+ (0.0002,0) [0|1.571] "rad"  ACM
 SG_ OBJ_Angle_Bottom_STD_V_6 : 381|1@1+ (1,0) [0|1] "bool"  ACM
 SG_ OBJ_Visibility_Side_V_6 : 382|1@1+ (1,0) [0|1] "bool"  ACM
 SG_ OBJ_Visibility_Side_6 : 383|2@1+ (1,0) [0|2] "ENUM"  ACM
 SG_ OBJ_Is_In_Drivable_Area_6 : 385|1@1+ (1,0) [0|1] "bool"  ACM
 SG_ OBJ_Is_In_Drivable_Area_V_6 : 386|1@1+ (1,0) [0|1] "bool"  ACM
 SG_ OBJ_Is_VeryClose_6 : 387|1@1+ (1,0) [0|1] "bool"  ACM
 SG_ OBJ_Is_VeryClose_V_6 : 388|1@1+ (1,0) [0|1] "bool"  ACM
 SG_ OBJ_Buffer_6 : 389|11@1+ (1,0) [0|0] "NA"  ACM

BO_ 157 ICM_Object_Prot6_A: 64 MyECU
 SG_ ICM_Object_Prot6_A_Header : 0|16@1+ (1,0) [0|65535] ""  ACM
 SG_ OBJ_CRC_6 : 16|32@1+ (1,0) [0|4294967295] "NA"  ACM
 SG_ OBJ_ID_6 : 48|8@1+ (1,0) [0|255] "NA"  ACM
 SG_ OBJ_Existence_Probability_6 : 56|8@1+ (0.01,0) [0|1] "NA"  ACM
 SG_ OBJ_Fusion_Source_6 : 64|16@1+ (1,0) [0|65535] "BITWIZE"  ACM
 SG_ OBJ_Triggered_SDM_6 : 80|2@1+ (1,0) [0|2] "ENUM"  ACM
 SG_ OBJ_Motion_Category_6 : 82|4@1+ (1,0) [0|13] "ENUM "  ACM
 SG_ OBJ_Moving_IN_Probability_6 : 86|7@1+ (0.01,0) [0|0] "NA"  ACM
 SG_ OBJ_Object_Age_6 : 93|11@1+ (1,0) [0|2047] "Frame"  ACM
 SG_ OBJ_Measuring_Status_6 : 104|3@1+ (1,0) [0|7] "BITWIZE"  ACM
 SG_ OBJ_Object_Class_6 : 107|4@1+ (1,0) [0|8] "ENUM"  ACM
 SG_ OBJ_Class_Probability_6 : 112|7@1+ (0.01,0) [0|1] "NA"  ACM
 SG_ OBJ_Car_Probability_6 : 119|7@1+ (0.01,0) [0|0] "NA"  ACM
 SG_ OBJ_Truck_Probability_6 : 126|7@1+ (0.01,0) [0|0] "NA"  ACM
 SG_ OBJ_Bike_Probability_6 : 133|7@1+ (0.01,0) [0|0] "NA"  ACM
 SG_ OBJ_Camera_Source_6 : 140|4@1+ (1,0) [0|15] "ENUM"  ACM
 SG_ OBJ_Motion_Status_6 : 144|3@1+ (1,0) [0|5] "ENUM "  ACM
 SG_ OBJ_Motion_Orientation_6 : 147|4@1+ (1,0) [0|13] "ENUM "  ACM
 SG_ OBJ_Has_Cut_Lane_6 : 151|1@1+ (1,0) [0|1] "bool"  ACM
 SG_ OBJ_Has_Cut_Path_6 : 152|1@1+ (1,0) [0|1] "bool"  ACM
 SG_ OBJ_Brake_Light_6 : 153|1@1+ (1,0) [0|1] "bool"  ACM
 SG_ OBJ_Turn_Indicator_Right_6 : 154|1@1+ (1,0) [0|1] "bool"  ACM
 SG_ OBJ_Turn_Indicator_Left_6 : 155|1@1+ (1,0) [0|1] "bool"  ACM
 SG_ OBJ_Light_Indicator_Validity_6 : 156|1@1+ (1,0) [0|1] "bool"  ACM
 SG_ OBJ_Right_Out_Of_Image_6 : 157|1@1+ (1,0) [0|1] "bool"  ACM
 SG_ OBJ_Left_Out_Of_Image_6 : 158|1@1+ (1,0) [0|1] "bool"  ACM
 SG_ OBJ_Right_Out_Of_Image_V_6 : 159|1@1+ (1,0) [0|1] "bool"  ACM
 SG_ OBJ_Left_Out_Of_Image_V_6 : 160|1@1+ (1,0) [0|1] "bool"  ACM
 SG_ OBJ_Top_Out_Of_Image_6 : 161|1@1+ (1,0) [0|1] "bool"  ACM
 SG_ OBJ_Bottom_Out_Of_Image_6 : 162|1@1+ (1,0) [0|1] "bool"  ACM
 SG_ OBJ_Top_Out_Of_Image_V_6 : 163|1@1+ (1,0) [0|1] "bool"  ACM
 SG_ OBJ_Bottom_Out_Of_Image_V_6 : 164|1@1+ (1,0) [0|1] "bool"  ACM
 SG_ OBJ_Lane_Assignment_6 : 165|3@1+ (1,0) [0|5] "ENUM"  ACM
 SG_ OBJ_Lane_Assignment_V_6 : 168|1@1+ (1,0) [0|1] "bool"  ACM
 SG_ OBJ_Age_Seconds_6 : 169|7@1+ (1,0) [0|100] "s"  ACM
 SG_ OBJ_Age_Seconds_V_6 : 176|1@1+ (1,0) [0|1] "bool"  ACM
 SG_ OBJ_Width_6 : 177|9@1+ (0.01,0) [0.4|2.95] "m"  ACM
 SG_ OBJ_Width_V_6 : 186|1@1+ (1,0) [0|1] "bool"  ACM
 SG_ OBJ_Width_STD_6 : 187|8@1+ (0.01,0) [0|2] "m"  ACM
 SG_ OBJ_Width_STD_V_6 : 195|1@1+ (1,0) [0|1] "bool"  ACM
 SG_ OBJ_Length_6 : 196|9@1+ (0.05,0) [1.2|21] "m"  ACM
 SG_ OBJ_Length_V_6 : 205|1@1+ (1,0) [0|1] "bool"  ACM
 SG_ OBJ_Length_STD_6 : 208|8@1+ (0.05,0) [0|10] "m"  ACM
 SG_ OBJ_Length_STD_V_6 : 216|1@1+ (1,0) [0|1] "bool"  ACM
 SG_ OBJ_Height_6 : 217|9@1+ (0.01,0) [0|2.95] "m"  ACM
 SG_ OBJ_Height_V_6 : 226|1@1+ (1,0) [0|1] "bool"  ACM
 SG_ OBJ_Height_STD_6 : 227|8@1+ (0.01,0) [0|2] "m"  ACM
 SG_ OBJ_Height_STD_V_6 : 235|1@1+ (1,0) [0|1] "bool"  ACM
 SG_ OBJ_Abs_Long_Velocity_6 : 240|12@1+ (0.05,-30) [-30|100] "MPS"  ACM
 SG_ OBJ_Abs_Long_Velocity_V_6 : 252|1@1+ (1,0) [0|1] "bool"  ACM
 SG_ OBJ_Abs_Long_Velocity_STD_6 : 253|11@1+ (0.05,0) [0|65] "MPS"  ACM
 SG_ OBJ_Abs_Long_Vel_STD_V_6 : 264|1@1+ (1,0) [0|1] "bool"  ACM
 SG_ OBJ_Abs_Lat_Velocity_6 : 272|11@1+ (0.05,-50) [-50|50] "MPS"  ACM
 SG_ OBJ_Abs_Lat_Velocity_V_6 : 283|1@1+ (1,0) [0|1] "bool"  ACM
 SG_ OBJ_Abs_Lat_Velocity_STD_6 : 284|10@1+ (0.05,0) [0|50] "MPS"  ACM
 SG_ OBJ_Abs_Lat_Vel_STD_V_6 : 294|1@1+ (1,0) [0|1] "bool"  ACM
 SG_ OBJ_Abs_Long_Acc_6 : 295|9@1+ (0.05,-10.3) [-10.3|7.3] "MPS2"  ACM
 SG_ OBJ_Abs_Long_Acc_V_6 : 304|1@1+ (1,0) [0|1] "bool"  ACM
 SG_ OBJ_Abs_Long_Acc_STD_6 : 305|8@1+ (0.05,0) [0|7.3] "MPS2"  ACM
 SG_ OBJ_Abs_Long_Acc_STD_V_6 : 313|1@1+ (1,0) [0|1] "bool"  ACM
 SG_ OBJ_Abs_Lat_Acc_6 : 314|9@1+ (0.05,-10.3) [-10.3|7.3] "MPS2"  ACM
 SG_ OBJ_Abs_Lat_Acc_V_6 : 323|1@1+ (1,0) [0|1] "bool"  ACM
 SG_ OBJ_Abs_Lat_Acc_STD_6 : 324|8@1+ (0.05,0) [0|7.3] "MPS2"  ACM
 SG_ OBJ_Abs_Lat_Acc_STD_V_6 : 332|1@1+ (1,0) [0|1] "bool"  ACM
 SG_ OBJ_Abs_Acceleration_6 : 336|9@1+ (0.05,-10.3) [-10.3|7.3] "MPS2"  ACM
 SG_ OBJ_Abs_Acceleration_V_6 : 345|1@1+ (1,0) [0|1] "bool"  ACM
 SG_ OBJ_Abs_Acc_STD_6 : 346|8@1+ (0.05,0) [0|7.3] "MPS2"  ACM
 SG_ OBJ_Abs_Acc_STD_V_6 : 354|1@1+ (1,0) [0|1] "bool"  ACM
 SG_ OBJ_Inv_TTC_6 : 355|11@1+ (0.01,-8) [-8|8] "INV(s)"  ACM
 SG_ OBJ_Inv_TTC_V_6 : 366|1@1+ (1,0) [0|1] "bool"  ACM
 SG_ OBJ_Inv_TTC_STD_6 : 368|11@1+ (0.01,0) [0|4] "INV(s)"  ACM
 SG_ OBJ_Inv_TTC_STD_V_6 : 379|1@1+ (1,0) [0|1] "bool"  ACM
 SG_ OBJ_Relative_Long_Acc_6 : 380|9@1+ (0.05,-10.3) [-10.3|7.3] "MPS2"  ACM
 SG_ OBJ_Relative_Long_Acc_V_6 : 389|1@1+ (1,0) [0|1] "bool"  ACM
 SG_ OBJ_Relative_Long_Acc_STD_6 : 390|8@1+ (0.05,0) [0|7.3] "MPS2"  ACM
 SG_ OBJ_Rel_Long_Acc_STD_V_6 : 398|1@1+ (1,0) [0|1] "bool"  ACM

BA_DEF_ BO_  "VFrameFormat" ENUM  "StandardCAN","ExtendedCAN","reserved","reserved","reserved","reserved","reserved","reserved","reserved","reserved","reserved","reserved","reserved","reserved","StandardCAN_FD","ExtendedCAN_FD";
BA_DEF_ BO_  "GenMsgSendType" ENUM  "Cyclic","NotUsed","NotUsed","NotUsed","NotUsed","NotUsed","NotUsed","NotUsed","NoMsgSendType";
BA_DEF_ SG_  "GenSigSendType" ENUM  "NotUsed","OnWrite","OnWriteWithRepetition","OnChange","OnChangeWithRepetition","IfActive","IfActiveWithRepeition","NoSigSendType";
BA_DEF_ BO_  "GenMsgCycleTime" INT 0 0;
BA_DEF_ BO_  "GenMsgILSupport" ENUM  "no","yes";
BA_DEF_ SG_  "GenSigStartValue" INT 0 0;
BA_DEF_DEF_  "VFrameFormat" "ExtendedCAN_FD";
BA_DEF_DEF_  "GenMsgSendType" "NoMsgSendType";
BA_DEF_DEF_  "GenSigSendType" "OnWrite";
BA_DEF_DEF_  "GenMsgCycleTime" 0;
BA_DEF_DEF_  "GenMsgILSupport" "yes";
BA_DEF_DEF_  "GenSigStartValue" 0;
BA_ "VFrameFormat" BO_ 176 14;
BA_ "VFrameFormat" BO_ 175 14;
BA_ "VFrameFormat" BO_ 174 14;
BA_ "VFrameFormat" BO_ 173 14;
BA_ "VFrameFormat" BO_ 172 14;
BA_ "VFrameFormat" BO_ 171 14;
BA_ "VFrameFormat" BO_ 170 14;
BA_ "VFrameFormat" BO_ 169 14;
BA_ "VFrameFormat" BO_ 168 14;
BA_ "VFrameFormat" BO_ 167 14;
BA_ "VFrameFormat" BO_ 166 14;
BA_ "VFrameFormat" BO_ 165 14;
BA_ "VFrameFormat" BO_ 164 14;
BA_ "VFrameFormat" BO_ 163 14;
BA_ "VFrameFormat" BO_ 162 14;
BA_ "VFrameFormat" BO_ 161 14;
BA_ "VFrameFormat" BO_ 160 14;
BA_ "VFrameFormat" BO_ 159 14;
BA_ "VFrameFormat" BO_ 158 14;
BA_ "VFrameFormat" BO_ 157 14;
BA_ "GenSigStartValue" SG_ 176 OBJ_Absolute_Speed_STD_15 1300;
BA_ "GenSigStartValue" SG_ 175 OBJ_Width_15 40;
BA_ "GenSigStartValue" SG_ 175 OBJ_Length_15 24;
BA_ "GenSigStartValue" SG_ 174 OBJ_Absolute_Speed_STD_14 1300;
BA_ "GenSigStartValue" SG_ 173 OBJ_Width_14 40;
BA_ "GenSigStartValue" SG_ 173 OBJ_Length_14 24;
BA_ "GenSigStartValue" SG_ 172 OBJ_Absolute_Speed_STD_13 1300;
BA_ "GenSigStartValue" SG_ 171 OBJ_Width_13 40;
BA_ "GenSigStartValue" SG_ 171 OBJ_Length_13 24;
BA_ "GenSigStartValue" SG_ 170 OBJ_Absolute_Speed_STD_12 1300;
BA_ "GenSigStartValue" SG_ 169 OBJ_Width_12 40;
BA_ "GenSigStartValue" SG_ 169 OBJ_Length_12 24;
BA_ "GenSigStartValue" SG_ 168 OBJ_Absolute_Speed_STD_11 1300;
BA_ "GenSigStartValue" SG_ 167 OBJ_Width_11 40;
BA_ "GenSigStartValue" SG_ 167 OBJ_Length_11 24;
BA_ "GenSigStartValue" SG_ 166 OBJ_Absolute_Speed_STD_10 1300;
BA_ "GenSigStartValue" SG_ 165 OBJ_Width_10 40;
BA_ "GenSigStartValue" SG_ 165 OBJ_Length_10 24;
BA_ "GenSigStartValue" SG_ 163 OBJ_Width_9 40;
BA_ "GenSigStartValue" SG_ 163 OBJ_Length_9 24;
BA_ "GenSigStartValue" SG_ 161 OBJ_Width_8 40;
BA_ "GenSigStartValue" SG_ 161 OBJ_Length_8 24;
BA_ "GenSigStartValue" SG_ 159 OBJ_Width_7 40;
BA_ "GenSigStartValue" SG_ 159 OBJ_Length_7 24;
BA_ "GenSigStartValue" SG_ 157 OBJ_Width_6 40;
BA_ "GenSigStartValue" SG_ 157 OBJ_Length_6 24;
VAL_ 176 OBJ_Relative_Long_Velocity_V_15 1 "VALID" 0 "INVALID" ;
VAL_ 176 OBJ_Rel_Long_Vel_STD_V_15 1 "VALID" 0 "INVALID" ;
VAL_ 176 OBJ_Relative_Lat_Velocity_V_15 1 "VALID" 0 "INVALID" ;
VAL_ 176 OBJ_Rel_Lat_Vel_STD_V_15 1 "VALID" 0 "INVALID" ;
VAL_ 176 OBJ_Long_Distance_V_15 1 "VALID" 0 "INVALID" ;
VAL_ 176 OBJ_Long_Distance_STD_V_15 1 "VALID" 0 "INVALID" ;
VAL_ 176 OBJ_Lat_Distance_V_15 1 "VALID" 0 "INVALID" ;
VAL_ 176 OBJ_Lat_Distance_STD_V_15 1 "VALID" 0 "INVALID" ;
VAL_ 176 OBJ_Absolute_Speed_V_15 1 "VALID" 0 "INVALID" ;
VAL_ 176 OBJ_Absolute_Speed_STD_V_15 1 "VALID" 0 "INVALID" ;
VAL_ 176 OBJ_Heading_V_15 1 "VALID" 0 "INVALID" ;
VAL_ 176 OBJ_Heading_STD_V_15 1 "VALID" 0 "INVALID" ;
VAL_ 176 OBJ_Angle_Rate_STD_V_15 1 "VALID" 0 "INVALID" ;
VAL_ 176 OBJ_Angle_Rate_V_15 1 "VALID" 0 "INVALID" ;
VAL_ 176 OBJ_Angle_Right_V_15 1 "VALID" 0 "INVALID" ;
VAL_ 176 OBJ_Angle_Right_STD_V_15 1 "VALID" 0 "INVALID" ;
VAL_ 176 OBJ_Angle_Left_V_15 1 "VALID" 0 "INVALID" ;
VAL_ 176 OBJ_Angle_Left_STD_V_15 1 "VALID" 0 "INVALID" ;
VAL_ 176 OBJ_Angle_Side_V_15 1 "VALID" 0 "INVALID" ;
VAL_ 176 OBJ_Angle_Side_STD_V_15 1 "VALID" 0 "INVALID" ;
VAL_ 176 OBJ_Angle_Mid_V_15 1 "VALID" 0 "INVALID" ;
VAL_ 176 OBJ_Angle_Mid_STD_V_15 1 "VALID" 0 "INVALID" ;
VAL_ 176 OBJ_Angle_Bottom_V_15 1 "VALID" 0 "INVALID" ;
VAL_ 176 OBJ_Angle_Bottom_STD_V_15 1 "VALID" 0 "INVALID" ;
VAL_ 176 OBJ_Visibility_Side_V_15 1 "VALID" 0 "INVALID" ;
VAL_ 176 OBJ_Visibility_Side_15 2 "REAR" 1 "FRONT" 0 "NOT_VISIBLE" ;
VAL_ 176 OBJ_Is_In_Drivable_Area_15 1 "TRUE" 0 "FALSE" ;
VAL_ 176 OBJ_Is_In_Drivable_Area_V_15 1 "VALID" 0 "INVALID" ;
VAL_ 176 OBJ_Is_VeryClose_15 1 "TRUE" 0 "FALSE" ;
VAL_ 176 OBJ_Is_VeryClose_V_15 1 "VALID" 0 "INVALID" ;
VAL_ 175 OBJ_Triggered_SDM_15 2 "NOT_TRIGGERED" 1 "TRIGGERED" 0 "NOT_AVAILABLE" ;
VAL_ 175 OBJ_Motion_Category_15 13 "ONCOMING" 12 "PRECEEDING" 11 "MOVING" 10 "RTAP" 9 "LTAP" 8 "CROSSING" 7 "MOVING_OUT" 6 "MOVING_IN" 5 "CLOSE_CUT_IN" 4 "PASSING_OUT" 3 "PASSING_IN" 2 "PASSING" 1 "UNDEFINED" 0 "INVALID" ;
VAL_ 175 OBJ_Measuring_Status_15 2 "(BIT_2)NOT_VALID_OR_VALID" 1 "(BIT_1)PREDICTED_OR_MEASURED" 0 "(BIT_0)OLD_OR_NEW" ;
VAL_ 175 OBJ_Object_Class_15 8 "UNCERTAIN_VCL" 7 "ANIMAL" 6 "GENERAL_OBJECT" 5 "PEDESTRIAN" 4 "BICYCLE" 3 "MOTOR_BIKE" 2 "TRUCK" 1 "CAR" 0 "INVALID" ;
VAL_ 175 OBJ_Camera_Source_15 11 "PARKING_RIGHT" 10 "PARKING_LEFT" 9 "PARKING_REAR" 8 "PARKING_FRONT" 7 "FRONT_CORNER_RIGHT" 6 "FRONT_CORNER_LEFT" 5 "REAR_CORNER_RIGHT" 4 "REAR_CORNER_LEFT" 3 "REAR" 2 "FRONT_FISHEYE" 1 "FRONT_NARROW" 0 "FRONT_MAIN" ;
VAL_ 175 OBJ_Motion_Status_15 5 "MOVING_SLOWLY" 4 "STOPPED" 3 "STATIONARY" 2 "MOVING" 1 "UNKNOWN" 0 "INVALID" ;
VAL_ 175 OBJ_Motion_Orientation_15 13 "UNKNOWN" 12 "PRECEEDING" 11 "DRIFTING_LEFT" 9 "CROSSING_LEFT" 7 "OC_DRIFTING_LEFT" 6 "ONCOMING" 5 "OC_DRIFTING_RIGHT" 3 "CROSSING_RIGHT" 1 "DRIFTING_RIGHT" 0 "INVALID" ;
VAL_ 175 OBJ_Has_Cut_Lane_15 1 "TRUE" 0 "FALSE" ;
VAL_ 175 OBJ_Has_Cut_Path_15 1 "TRUE" 0 "FALSE" ;
VAL_ 175 OBJ_Brake_Light_15 1 "TRUE" 0 "FALSE" ;
VAL_ 175 OBJ_Turn_Indicator_Right_15 1 "TRUE" 0 "FALSE" ;
VAL_ 175 OBJ_Turn_Indicator_Left_15 1 "TRUE" 0 "FALSE" ;
VAL_ 175 OBJ_Light_Indicator_Validity_15 1 "TRUE" 0 "FALSE" ;
VAL_ 175 OBJ_Right_Out_Of_Image_15 1 "TRUE" 0 "FALSE" ;
VAL_ 175 OBJ_Left_Out_Of_Image_15 1 "TRUE" 0 "FALSE" ;
VAL_ 175 OBJ_Right_Out_Of_Image_V_15 1 "TRUE" 0 "FALSE" ;
VAL_ 175 OBJ_Left_Out_Of_Image_V_15 1 "TRUE" 0 "FALSE" ;
VAL_ 175 OBJ_Top_Out_Of_Image_15 1 "TRUE" 0 "FALSE" ;
VAL_ 175 OBJ_Bottom_Out_Of_Image_15 1 "TRUE" 0 "FALSE" ;
VAL_ 175 OBJ_Top_Out_Of_Image_V_15 1 "VALID" 0 "INVALID" ;
VAL_ 175 OBJ_Bottom_Out_Of_Image_V_15 1 "VALID" 0 "INVALID" ;
VAL_ 175 OBJ_Lane_Assignment_15 5 "RIGHT_RIGHT" 4 "RIGHT" 3 "HOST" 2 "LEFT" 1 "LEFT_LEFT" 0 "UNKNOWN" ;
VAL_ 175 OBJ_Lane_Assignment_V_15 1 "VALID" 0 "INVALID" ;
VAL_ 175 OBJ_Age_Seconds_V_15 1 "VALID" 0 "INVALID" ;
VAL_ 175 OBJ_Width_V_15 1 "VALID" 0 "INVALID" ;
VAL_ 175 OBJ_Width_STD_V_15 1 "VALID" 0 "INVALID" ;
VAL_ 175 OBJ_Length_V_15 1 "VALID" 0 "INVALID" ;
VAL_ 175 OBJ_Length_STD_V_15 1 "VALID" 0 "INVALID" ;
VAL_ 175 OBJ_Height_V_15 1 "VALID" 0 "INVALID" ;
VAL_ 175 OBJ_Height_STD_V_15 1 "VALID" 0 "INVALID" ;
VAL_ 175 OBJ_Abs_Long_Velocity_V_15 1 "VALID" 0 "INVALID" ;
VAL_ 175 OBJ_Abs_Long_Vel_STD_V_15 1 "VALID" 0 "INVALID" ;
VAL_ 175 OBJ_Abs_Lat_Velocity_V_15 1 "VALID" 0 "INVALID" ;
VAL_ 175 OBJ_Abs_Lat_Vel_STD_V_15 1 "VALID" 0 "INVALID" ;
VAL_ 175 OBJ_Abs_Long_Acc_V_15 1 "VALID" 0 "INVALID" ;
VAL_ 175 OBJ_Abs_Long_Acc_STD_V_15 1 "VALID" 0 "INVALID" ;
VAL_ 175 OBJ_Abs_Lat_Acc_V_15 1 "VALID" 0 "INVALID" ;
VAL_ 175 OBJ_Abs_Lat_Acc_STD_V_15 1 "VALID" 0 "INVALID" ;
VAL_ 175 OBJ_Abs_Acceleration_V_15 1 "VALID" 0 "INVALID" ;
VAL_ 175 OBJ_Abs_Acc_STD_V_15 1 "VALID" 0 "INVALID" ;
VAL_ 175 OBJ_Inv_TTC_V_15 1 "VALID" 0 "INVALID" ;
VAL_ 175 OBJ_Inv_TTC_STD_V_15 1 "VALID" 0 "INVALID" ;
VAL_ 175 OBJ_Relative_Long_Acc_V_15 1 "VALID" 0 "INVALID" ;
VAL_ 175 OBJ_Rel_Long_Acc_STD_V_15 1 "VALID" 0 "INVALID" ;
VAL_ 174 OBJ_Relative_Long_Velocity_V_14 1 "VALID" 0 "INVALID" ;
VAL_ 174 OBJ_Rel_Long_Vel_STD_V_14 1 "VALID" 0 "INVALID" ;
VAL_ 174 OBJ_Relative_Lat_Velocity_V_14 1 "VALID" 0 "INVALID" ;
VAL_ 174 OBJ_Rel_Lat_Vel_STD_V_14 1 "VALID" 0 "INVALID" ;
VAL_ 174 OBJ_Long_Distance_V_14 1 "VALID" 0 "INVALID" ;
VAL_ 174 OBJ_Long_Distance_STD_V_14 1 "VALID" 0 "INVALID" ;
VAL_ 174 OBJ_Lat_Distance_V_14 1 "VALID" 0 "INVALID" ;
VAL_ 174 OBJ_Lat_Distance_STD_V_14 1 "VALID" 0 "INVALID" ;
VAL_ 174 OBJ_Absolute_Speed_V_14 1 "VALID" 0 "INVALID" ;
VAL_ 174 OBJ_Absolute_Speed_STD_V_14 1 "VALID" 0 "INVALID" ;
VAL_ 174 OBJ_Heading_V_14 1 "VALID" 0 "INVALID" ;
VAL_ 174 OBJ_Heading_STD_V_14 1 "VALID" 0 "INVALID" ;
VAL_ 174 OBJ_Angle_Rate_STD_V_14 1 "VALID" 0 "INVALID" ;
VAL_ 174 OBJ_Angle_Rate_V_14 1 "VALID" 0 "INVALID" ;
VAL_ 174 OBJ_Angle_Right_V_14 1 "VALID" 0 "INVALID" ;
VAL_ 174 OBJ_Angle_Right_STD_V_14 1 "VALID" 0 "INVALID" ;
VAL_ 174 OBJ_Angle_Left_V_14 1 "VALID" 0 "INVALID" ;
VAL_ 174 OBJ_Angle_Left_STD_V_14 1 "VALID" 0 "INVALID" ;
VAL_ 174 OBJ_Angle_Side_V_14 1 "VALID" 0 "INVALID" ;
VAL_ 174 OBJ_Angle_Side_STD_V_14 1 "VALID" 0 "INVALID" ;
VAL_ 174 OBJ_Angle_Mid_V_14 1 "VALID" 0 "INVALID" ;
VAL_ 174 OBJ_Angle_Mid_STD_V_14 1 "VALID" 0 "INVALID" ;
VAL_ 174 OBJ_Angle_Bottom_V_14 1 "VALID" 0 "INVALID" ;
VAL_ 174 OBJ_Angle_Bottom_STD_V_14 1 "VALID" 0 "INVALID" ;
VAL_ 174 OBJ_Visibility_Side_V_14 1 "VALID" 0 "INVALID" ;
VAL_ 174 OBJ_Visibility_Side_14 2 "REAR" 1 "FRONT" 0 "NOT_VISIBLE" ;
VAL_ 174 OBJ_Is_In_Drivable_Area_14 1 "TRUE" 0 "FALSE" ;
VAL_ 174 OBJ_Is_In_Drivable_Area_V_14 1 "VALID" 0 "INVALID" ;
VAL_ 174 OBJ_Is_VeryClose_14 1 "TRUE" 0 "FALSE" ;
VAL_ 174 OBJ_Is_VeryClose_V_14 1 "VALID" 0 "INVALID" ;
VAL_ 173 OBJ_Triggered_SDM_14 2 "NOT_TRIGGERED" 1 "TRIGGERED" 0 "NOT_AVAILABLE" ;
VAL_ 173 OBJ_Motion_Category_14 13 "ONCOMING" 12 "PRECEEDING" 11 "MOVING" 10 "RTAP" 9 "LTAP" 8 "CROSSING" 7 "MOVING_OUT" 6 "MOVING_IN" 5 "CLOSE_CUT_IN" 4 "PASSING_OUT" 3 "PASSING_IN" 2 "PASSING" 1 "UNDEFINED" 0 "INVALID" ;
VAL_ 173 OBJ_Measuring_Status_14 2 "(BIT_2)NOT_VALID_OR_VALID" 1 "(BIT_1)PREDICTED_OR_MEASURED" 0 "(BIT_0)OLD_OR_NEW" ;
VAL_ 173 OBJ_Object_Class_14 8 "UNCERTAIN_VCL" 7 "ANIMAL" 6 "GENERAL_OBJECT" 5 "PEDESTRIAN" 4 "BICYCLE" 3 "MOTOR_BIKE" 2 "TRUCK" 1 "CAR" 0 "INVALID" ;
VAL_ 173 OBJ_Camera_Source_14 11 "PARKING_RIGHT" 10 "PARKING_LEFT" 9 "PARKING_REAR" 8 "PARKING_FRONT" 7 "FRONT_CORNER_RIGHT" 6 "FRONT_CORNER_LEFT" 5 "REAR_CORNER_RIGHT" 4 "REAR_CORNER_LEFT" 3 "REAR" 2 "FRONT_FISHEYE" 1 "FRONT_NARROW" 0 "FRONT_MAIN" ;
VAL_ 173 OBJ_Motion_Status_14 5 "MOVING_SLOWLY" 4 "STOPPED" 3 "STATIONARY" 2 "MOVING" 1 "UNKNOWN" 0 "INVALID" ;
VAL_ 173 OBJ_Motion_Orientation_14 13 "UNKNOWN" 12 "PRECEEDING" 11 "DRIFTING_LEFT" 9 "CROSSING_LEFT" 7 "OC_DRIFTING_LEFT" 6 "ONCOMING" 5 "OC_DRIFTING_RIGHT" 3 "CROSSING_RIGHT" 1 "DRIFTING_RIGHT" 0 "INVALID" ;
VAL_ 173 OBJ_Has_Cut_Lane_14 1 "TRUE" 0 "FALSE" ;
VAL_ 173 OBJ_Has_Cut_Path_14 1 "TRUE" 0 "FALSE" ;
VAL_ 173 OBJ_Brake_Light_14 1 "TRUE" 0 "FALSE" ;
VAL_ 173 OBJ_Turn_Indicator_Right_14 1 "TRUE" 0 "FALSE" ;
VAL_ 173 OBJ_Turn_Indicator_Left_14 1 "TRUE" 0 "FALSE" ;
VAL_ 173 OBJ_Light_Indicator_Validity_14 1 "TRUE" 0 "FALSE" ;
VAL_ 173 OBJ_Right_Out_Of_Image_14 1 "TRUE" 0 "FALSE" ;
VAL_ 173 OBJ_Left_Out_Of_Image_14 1 "TRUE" 0 "FALSE" ;
VAL_ 173 OBJ_Right_Out_Of_Image_V_14 1 "TRUE" 0 "FALSE" ;
VAL_ 173 OBJ_Left_Out_Of_Image_V_14 1 "TRUE" 0 "FALSE" ;
VAL_ 173 OBJ_Top_Out_Of_Image_14 1 "TRUE" 0 "FALSE" ;
VAL_ 173 OBJ_Bottom_Out_Of_Image_14 1 "TRUE" 0 "FALSE" ;
VAL_ 173 OBJ_Top_Out_Of_Image_V_14 1 "VALID" 0 "INVALID" ;
VAL_ 173 OBJ_Bottom_Out_Of_Image_V_14 1 "VALID" 0 "INVALID" ;
VAL_ 173 OBJ_Lane_Assignment_14 5 "RIGHT_RIGHT" 4 "RIGHT" 3 "HOST" 2 "LEFT" 1 "LEFT_LEFT" 0 "UNKNOWN" ;
VAL_ 173 OBJ_Lane_Assignment_V_14 1 "VALID" 0 "INVALID" ;
VAL_ 173 OBJ_Age_Seconds_V_14 1 "VALID" 0 "INVALID" ;
VAL_ 173 OBJ_Width_V_14 1 "VALID" 0 "INVALID" ;
VAL_ 173 OBJ_Width_STD_V_14 1 "VALID" 0 "INVALID" ;
VAL_ 173 OBJ_Length_V_14 1 "VALID" 0 "INVALID" ;
VAL_ 173 OBJ_Length_STD_V_14 1 "VALID" 0 "INVALID" ;
VAL_ 173 OBJ_Height_V_14 1 "VALID" 0 "INVALID" ;
VAL_ 173 OBJ_Height_STD_V_14 1 "VALID" 0 "INVALID" ;
VAL_ 173 OBJ_Abs_Long_Velocity_V_14 1 "VALID" 0 "INVALID" ;
VAL_ 173 OBJ_Abs_Long_Vel_STD_V_14 1 "VALID" 0 "INVALID" ;
VAL_ 173 OBJ_Abs_Lat_Velocity_V_14 1 "VALID" 0 "INVALID" ;
VAL_ 173 OBJ_Abs_Lat_Vel_STD_V_14 1 "VALID" 0 "INVALID" ;
VAL_ 173 OBJ_Abs_Long_Acc_V_14 1 "VALID" 0 "INVALID" ;
VAL_ 173 OBJ_Abs_Long_Acc_STD_V_14 1 "VALID" 0 "INVALID" ;
VAL_ 173 OBJ_Abs_Lat_Acc_V_14 1 "VALID" 0 "INVALID" ;
VAL_ 173 OBJ_Abs_Lat_Acc_STD_V_14 1 "VALID" 0 "INVALID" ;
VAL_ 173 OBJ_Abs_Acceleration_V_14 1 "VALID" 0 "INVALID" ;
VAL_ 173 OBJ_Abs_Acc_STD_V_14 1 "VALID" 0 "INVALID" ;
VAL_ 173 OBJ_Inv_TTC_V_14 1 "VALID" 0 "INVALID" ;
VAL_ 173 OBJ_Inv_TTC_STD_V_14 1 "VALID" 0 "INVALID" ;
VAL_ 173 OBJ_Relative_Long_Acc_V_14 1 "VALID" 0 "INVALID" ;
VAL_ 173 OBJ_Rel_Long_Acc_STD_V_14 1 "VALID" 0 "INVALID" ;
VAL_ 172 OBJ_Relative_Long_Velocity_V_13 1 "VALID" 0 "INVALID" ;
VAL_ 172 OBJ_Rel_Long_Vel_STD_V_13 1 "VALID" 0 "INVALID" ;
VAL_ 172 OBJ_Relative_Lat_Velocity_V_13 1 "VALID" 0 "INVALID" ;
VAL_ 172 OBJ_Rel_Lat_Vel_STD_V_13 1 "VALID" 0 "INVALID" ;
VAL_ 172 OBJ_Long_Distance_V_13 1 "VALID" 0 "INVALID" ;
VAL_ 172 OBJ_Long_Distance_STD_V_13 1 "VALID" 0 "INVALID" ;
VAL_ 172 OBJ_Lat_Distance_V_13 1 "VALID" 0 "INVALID" ;
VAL_ 172 OBJ_Lat_Distance_STD_V_13 1 "VALID" 0 "INVALID" ;
VAL_ 172 OBJ_Absolute_Speed_V_13 1 "VALID" 0 "INVALID" ;
VAL_ 172 OBJ_Absolute_Speed_STD_V_13 1 "VALID" 0 "INVALID" ;
VAL_ 172 OBJ_Heading_V_13 1 "VALID" 0 "INVALID" ;
VAL_ 172 OBJ_Heading_STD_V_13 1 "VALID" 0 "INVALID" ;
VAL_ 172 OBJ_Angle_Rate_STD_V_13 1 "VALID" 0 "INVALID" ;
VAL_ 172 OBJ_Angle_Rate_V_13 1 "VALID" 0 "INVALID" ;
VAL_ 172 OBJ_Angle_Right_V_13 1 "VALID" 0 "INVALID" ;
VAL_ 172 OBJ_Angle_Right_STD_V_13 1 "VALID" 0 "INVALID" ;
VAL_ 172 OBJ_Angle_Left_V_13 1 "VALID" 0 "INVALID" ;
VAL_ 172 OBJ_Angle_Left_STD_V_13 1 "VALID" 0 "INVALID" ;
VAL_ 172 OBJ_Angle_Side_V_13 1 "VALID" 0 "INVALID" ;
VAL_ 172 OBJ_Angle_Side_STD_V_13 1 "VALID" 0 "INVALID" ;
VAL_ 172 OBJ_Angle_Mid_V_13 1 "VALID" 0 "INVALID" ;
VAL_ 172 OBJ_Angle_Mid_STD_V_13 1 "VALID" 0 "INVALID" ;
VAL_ 172 OBJ_Angle_Bottom_V_13 1 "VALID" 0 "INVALID" ;
VAL_ 172 OBJ_Angle_Bottom_STD_V_13 1 "VALID" 0 "INVALID" ;
VAL_ 172 OBJ_Visibility_Side_V_13 1 "VALID" 0 "INVALID" ;
VAL_ 172 OBJ_Visibility_Side_13 2 "REAR" 1 "FRONT" 0 "NOT_VISIBLE" ;
VAL_ 172 OBJ_Is_In_Drivable_Area_13 1 "TRUE" 0 "FALSE" ;
VAL_ 172 OBJ_Is_In_Drivable_Area_V_13 1 "VALID" 0 "INVALID" ;
VAL_ 172 OBJ_Is_VeryClose_13 1 "TRUE" 0 "FALSE" ;
VAL_ 172 OBJ_Is_VeryClose_V_13 1 "VALID" 0 "INVALID" ;
VAL_ 171 OBJ_Triggered_SDM_13 2 "NOT_TRIGGERED" 1 "TRIGGERED" 0 "NOT_AVAILABLE" ;
VAL_ 171 OBJ_Motion_Category_13 13 "ONCOMING" 12 "PRECEEDING" 11 "MOVING" 10 "RTAP" 9 "LTAP" 8 "CROSSING" 7 "MOVING_OUT" 6 "MOVING_IN" 5 "CLOSE_CUT_IN" 4 "PASSING_OUT" 3 "PASSING_IN" 2 "PASSING" 1 "UNDEFINED" 0 "INVALID" ;
VAL_ 171 OBJ_Measuring_Status_13 2 "(BIT_2)NOT_VALID_OR_VALID" 1 "(BIT_1)PREDICTED_OR_MEASURED" 0 "(BIT_0)OLD_OR_NEW" ;
VAL_ 171 OBJ_Object_Class_13 8 "UNCERTAIN_VCL" 7 "ANIMAL" 6 "GENERAL_OBJECT" 5 "PEDESTRIAN" 4 "BICYCLE" 3 "MOTOR_BIKE" 2 "TRUCK" 1 "CAR" 0 "INVALID" ;
VAL_ 171 OBJ_Camera_Source_13 11 "PARKING_RIGHT" 10 "PARKING_LEFT" 9 "PARKING_REAR" 8 "PARKING_FRONT" 7 "FRONT_CORNER_RIGHT" 6 "FRONT_CORNER_LEFT" 5 "REAR_CORNER_RIGHT" 4 "REAR_CORNER_LEFT" 3 "REAR" 2 "FRONT_FISHEYE" 1 "FRONT_NARROW" 0 "FRONT_MAIN" ;
VAL_ 171 OBJ_Motion_Status_13 5 "MOVING_SLOWLY" 4 "STOPPED" 3 "STATIONARY" 2 "MOVING" 1 "UNKNOWN" 0 "INVALID" ;
VAL_ 171 OBJ_Motion_Orientation_13 13 "UNKNOWN" 12 "PRECEEDING" 11 "DRIFTING_LEFT" 9 "CROSSING_LEFT" 7 "OC_DRIFTING_LEFT" 6 "ONCOMING" 5 "OC_DRIFTING_RIGHT" 3 "CROSSING_RIGHT" 1 "DRIFTING_RIGHT" 0 "INVALID" ;
VAL_ 171 OBJ_Has_Cut_Lane_13 1 "TRUE" 0 "FALSE" ;
VAL_ 171 OBJ_Has_Cut_Path_13 1 "TRUE" 0 "FALSE" ;
VAL_ 171 OBJ_Brake_Light_13 1 "TRUE" 0 "FALSE" ;
VAL_ 171 OBJ_Turn_Indicator_Right_13 1 "TRUE" 0 "FALSE" ;
VAL_ 171 OBJ_Turn_Indicator_Left_13 1 "TRUE" 0 "FALSE" ;
VAL_ 171 OBJ_Light_Indicator_Validity_13 1 "TRUE" 0 "FALSE" ;
VAL_ 171 OBJ_Right_Out_Of_Image_13 1 "TRUE" 0 "FALSE" ;
VAL_ 171 OBJ_Left_Out_Of_Image_13 1 "TRUE" 0 "FALSE" ;
VAL_ 171 OBJ_Right_Out_Of_Image_V_13 1 "TRUE" 0 "FALSE" ;
VAL_ 171 OBJ_Left_Out_Of_Image_V_13 1 "TRUE" 0 "FALSE" ;
VAL_ 171 OBJ_Top_Out_Of_Image_13 1 "TRUE" 0 "FALSE" ;
VAL_ 171 OBJ_Bottom_Out_Of_Image_13 1 "TRUE" 0 "FALSE" ;
VAL_ 171 OBJ_Top_Out_Of_Image_V_13 1 "VALID" 0 "INVALID" ;
VAL_ 171 OBJ_Bottom_Out_Of_Image_V_13 1 "VALID" 0 "INVALID" ;
VAL_ 171 OBJ_Lane_Assignment_13 5 "RIGHT_RIGHT" 4 "RIGHT" 3 "HOST" 2 "LEFT" 1 "LEFT_LEFT" 0 "UNKNOWN" ;
VAL_ 171 OBJ_Lane_Assignment_V_13 1 "VALID" 0 "INVALID" ;
VAL_ 171 OBJ_Age_Seconds_V_13 1 "VALID" 0 "INVALID" ;
VAL_ 171 OBJ_Width_V_13 1 "VALID" 0 "INVALID" ;
VAL_ 171 OBJ_Width_STD_V_13 1 "VALID" 0 "INVALID" ;
VAL_ 171 OBJ_Length_V_13 1 "VALID" 0 "INVALID" ;
VAL_ 171 OBJ_Length_STD_V_13 1 "VALID" 0 "INVALID" ;
VAL_ 171 OBJ_Height_V_13 1 "VALID" 0 "INVALID" ;
VAL_ 171 OBJ_Height_STD_V_13 1 "VALID" 0 "INVALID" ;
VAL_ 171 OBJ_Abs_Long_Velocity_V_13 1 "VALID" 0 "INVALID" ;
VAL_ 171 OBJ_Abs_Long_Vel_STD_V_13 1 "VALID" 0 "INVALID" ;
VAL_ 171 OBJ_Abs_Lat_Velocity_V_13 1 "VALID" 0 "INVALID" ;
VAL_ 171 OBJ_Abs_Lat_Vel_STD_V_13 1 "VALID" 0 "INVALID" ;
VAL_ 171 OBJ_Abs_Long_Acc_V_13 1 "VALID" 0 "INVALID" ;
VAL_ 171 OBJ_Abs_Long_Acc_STD_V_13 1 "VALID" 0 "INVALID" ;
VAL_ 171 OBJ_Abs_Lat_Acc_V_13 1 "VALID" 0 "INVALID" ;
VAL_ 171 OBJ_Abs_Lat_Acc_STD_V_13 1 "VALID" 0 "INVALID" ;
VAL_ 171 OBJ_Abs_Acceleration_V_13 1 "VALID" 0 "INVALID" ;
VAL_ 171 OBJ_Abs_Acc_STD_V_13 1 "VALID" 0 "INVALID" ;
VAL_ 171 OBJ_Inv_TTC_V_13 1 "VALID" 0 "INVALID" ;
VAL_ 171 OBJ_Inv_TTC_STD_V_13 1 "VALID" 0 "INVALID" ;
VAL_ 171 OBJ_Relative_Long_Acc_V_13 1 "VALID" 0 "INVALID" ;
VAL_ 171 OBJ_Rel_Long_Acc_STD_V_13 1 "VALID" 0 "INVALID" ;
VAL_ 170 OBJ_Relative_Long_Velocity_V_12 1 "VALID" 0 "INVALID" ;
VAL_ 170 OBJ_Rel_Long_Vel_STD_V_12 1 "VALID" 0 "INVALID" ;
VAL_ 170 OBJ_Relative_Lat_Velocity_V_12 1 "VALID" 0 "INVALID" ;
VAL_ 170 OBJ_Rel_Lat_Vel_STD_V_12 1 "VALID" 0 "INVALID" ;
VAL_ 170 OBJ_Long_Distance_V_12 1 "VALID" 0 "INVALID" ;
VAL_ 170 OBJ_Long_Distance_STD_V_12 1 "VALID" 0 "INVALID" ;
VAL_ 170 OBJ_Lat_Distance_V_12 1 "VALID" 0 "INVALID" ;
VAL_ 170 OBJ_Lat_Distance_STD_V_12 1 "VALID" 0 "INVALID" ;
VAL_ 170 OBJ_Absolute_Speed_V_12 1 "VALID" 0 "INVALID" ;
VAL_ 170 OBJ_Absolute_Speed_STD_V_12 1 "VALID" 0 "INVALID" ;
VAL_ 170 OBJ_Heading_V_12 1 "VALID" 0 "INVALID" ;
VAL_ 170 OBJ_Heading_STD_V_12 1 "VALID" 0 "INVALID" ;
VAL_ 170 OBJ_Angle_Rate_STD_V_12 1 "VALID" 0 "INVALID" ;
VAL_ 170 OBJ_Angle_Rate_V_12 1 "VALID" 0 "INVALID" ;
VAL_ 170 OBJ_Angle_Right_V_12 1 "VALID" 0 "INVALID" ;
VAL_ 170 OBJ_Angle_Right_STD_V_12 1 "VALID" 0 "INVALID" ;
VAL_ 170 OBJ_Angle_Left_V_12 1 "VALID" 0 "INVALID" ;
VAL_ 170 OBJ_Angle_Left_STD_V_12 1 "VALID" 0 "INVALID" ;
VAL_ 170 OBJ_Angle_Side_V_12 1 "VALID" 0 "INVALID" ;
VAL_ 170 OBJ_Angle_Side_STD_V_12 1 "VALID" 0 "INVALID" ;
VAL_ 170 OBJ_Angle_Mid_V_12 1 "VALID" 0 "INVALID" ;
VAL_ 170 OBJ_Angle_Mid_STD_V_12 1 "VALID" 0 "INVALID" ;
VAL_ 170 OBJ_Angle_Bottom_V_12 1 "VALID" 0 "INVALID" ;
VAL_ 170 OBJ_Angle_Bottom_STD_V_12 1 "VALID" 0 "INVALID" ;
VAL_ 170 OBJ_Visibility_Side_V_12 1 "VALID" 0 "INVALID" ;
VAL_ 170 OBJ_Visibility_Side_12 2 "REAR" 1 "FRONT" 0 "NOT_VISIBLE" ;
VAL_ 170 OBJ_Is_In_Drivable_Area_12 1 "TRUE" 0 "FALSE" ;
VAL_ 170 OBJ_Is_In_Drivable_Area_V_12 1 "VALID" 0 "INVALID" ;
VAL_ 170 OBJ_Is_VeryClose_12 1 "TRUE" 0 "FALSE" ;
VAL_ 170 OBJ_Is_VeryClose_V_12 1 "VALID" 0 "INVALID" ;
VAL_ 169 OBJ_Triggered_SDM_12 2 "NOT_TRIGGERED" 1 "TRIGGERED" 0 "NOT_AVAILABLE" ;
VAL_ 169 OBJ_Motion_Category_12 13 "ONCOMING" 12 "PRECEEDING" 11 "MOVING" 10 "RTAP" 9 "LTAP" 8 "CROSSING" 7 "MOVING_OUT" 6 "MOVING_IN" 5 "CLOSE_CUT_IN" 4 "PASSING_OUT" 3 "PASSING_IN" 2 "PASSING" 1 "UNDEFINED" 0 "INVALID" ;
VAL_ 169 OBJ_Measuring_Status_12 2 "(BIT_2)NOT_VALID_OR_VALID" 1 "(BIT_1)PREDICTED_OR_MEASURED" 0 "(BIT_0)OLD_OR_NEW" ;
VAL_ 169 OBJ_Object_Class_12 8 "UNCERTAIN_VCL" 7 "ANIMAL" 6 "GENERAL_OBJECT" 5 "PEDESTRIAN" 4 "BICYCLE" 3 "MOTOR_BIKE" 2 "TRUCK" 1 "CAR" 0 "INVALID" ;
VAL_ 169 OBJ_Camera_Source_12 11 "PARKING_RIGHT" 10 "PARKING_LEFT" 9 "PARKING_REAR" 8 "PARKING_FRONT" 7 "FRONT_CORNER_RIGHT" 6 "FRONT_CORNER_LEFT" 5 "REAR_CORNER_RIGHT" 4 "REAR_CORNER_LEFT" 3 "REAR" 2 "FRONT_FISHEYE" 1 "FRONT_NARROW" 0 "FRONT_MAIN" ;
VAL_ 169 OBJ_Motion_Status_12 5 "MOVING_SLOWLY" 4 "STOPPED" 3 "STATIONARY" 2 "MOVING" 1 "UNKNOWN" 0 "INVALID" ;
VAL_ 169 OBJ_Motion_Orientation_12 13 "UNKNOWN" 12 "PRECEEDING" 11 "DRIFTING_LEFT" 9 "CROSSING_LEFT" 7 "OC_DRIFTING_LEFT" 6 "ONCOMING" 5 "OC_DRIFTING_RIGHT" 3 "CROSSING_RIGHT" 1 "DRIFTING_RIGHT" 0 "INVALID" ;
VAL_ 169 OBJ_Has_Cut_Lane_12 1 "TRUE" 0 "FALSE" ;
VAL_ 169 OBJ_Has_Cut_Path_12 1 "TRUE" 0 "FALSE" ;
VAL_ 169 OBJ_Brake_Light_12 1 "TRUE" 0 "FALSE" ;
VAL_ 169 OBJ_Turn_Indicator_Right_12 1 "TRUE" 0 "FALSE" ;
VAL_ 169 OBJ_Turn_Indicator_Left_12 1 "TRUE" 0 "FALSE" ;
VAL_ 169 OBJ_Light_Indicator_Validity_12 1 "TRUE" 0 "FALSE" ;
VAL_ 169 OBJ_Right_Out_Of_Image_12 1 "TRUE" 0 "FALSE" ;
VAL_ 169 OBJ_Left_Out_Of_Image_12 1 "TRUE" 0 "FALSE" ;
VAL_ 169 OBJ_Right_Out_Of_Image_V_12 1 "TRUE" 0 "FALSE" ;
VAL_ 169 OBJ_Left_Out_Of_Image_V_12 1 "TRUE" 0 "FALSE" ;
VAL_ 169 OBJ_Top_Out_Of_Image_12 1 "TRUE" 0 "FALSE" ;
VAL_ 169 OBJ_Bottom_Out_Of_Image_12 1 "TRUE" 0 "FALSE" ;
VAL_ 169 OBJ_Top_Out_Of_Image_V_12 1 "VALID" 0 "INVALID" ;
VAL_ 169 OBJ_Bottom_Out_Of_Image_V_12 1 "VALID" 0 "INVALID" ;
VAL_ 169 OBJ_Lane_Assignment_12 5 "RIGHT_RIGHT" 4 "RIGHT" 3 "HOST" 2 "LEFT" 1 "LEFT_LEFT" 0 "UNKNOWN" ;
VAL_ 169 OBJ_Lane_Assignment_V_12 1 "VALID" 0 "INVALID" ;
VAL_ 169 OBJ_Age_Seconds_V_12 1 "VALID" 0 "INVALID" ;
VAL_ 169 OBJ_Width_V_12 1 "VALID" 0 "INVALID" ;
VAL_ 169 OBJ_Width_STD_V_12 1 "VALID" 0 "INVALID" ;
VAL_ 169 OBJ_Length_V_12 1 "VALID" 0 "INVALID" ;
VAL_ 169 OBJ_Length_STD_V_12 1 "VALID" 0 "INVALID" ;
VAL_ 169 OBJ_Height_V_12 1 "VALID" 0 "INVALID" ;
VAL_ 169 OBJ_Height_STD_V_12 1 "VALID" 0 "INVALID" ;
VAL_ 169 OBJ_Abs_Long_Velocity_V_12 1 "VALID" 0 "INVALID" ;
VAL_ 169 OBJ_Abs_Long_Vel_STD_V_12 1 "VALID" 0 "INVALID" ;
VAL_ 169 OBJ_Abs_Lat_Velocity_V_12 1 "VALID" 0 "INVALID" ;
VAL_ 169 OBJ_Abs_Lat_Vel_STD_V_12 1 "VALID" 0 "INVALID" ;
VAL_ 169 OBJ_Abs_Long_Acc_V_12 1 "VALID" 0 "INVALID" ;
VAL_ 169 OBJ_Abs_Long_Acc_STD_V_12 1 "VALID" 0 "INVALID" ;
VAL_ 169 OBJ_Abs_Lat_Acc_V_12 1 "VALID" 0 "INVALID" ;
VAL_ 169 OBJ_Abs_Lat_Acc_STD_V_12 1 "VALID" 0 "INVALID" ;
VAL_ 169 OBJ_Abs_Acceleration_V_12 1 "VALID" 0 "INVALID" ;
VAL_ 169 OBJ_Abs_Acc_STD_V_12 1 "VALID" 0 "INVALID" ;
VAL_ 169 OBJ_Inv_TTC_V_12 1 "VALID" 0 "INVALID" ;
VAL_ 169 OBJ_Inv_TTC_STD_V_12 1 "VALID" 0 "INVALID" ;
VAL_ 169 OBJ_Relative_Long_Acc_V_12 1 "VALID" 0 "INVALID" ;
VAL_ 169 OBJ_Rel_Long_Acc_STD_V_12 1 "VALID" 0 "INVALID" ;
VAL_ 168 OBJ_Relative_Long_Velocity_V_11 1 "VALID" 0 "INVALID" ;
VAL_ 168 OBJ_Rel_Long_Vel_STD_V_11 1 "VALID" 0 "INVALID" ;
VAL_ 168 OBJ_Relative_Lat_Velocity_V_11 1 "VALID" 0 "INVALID" ;
VAL_ 168 OBJ_Rel_Lat_Vel_STD_V_11 1 "VALID" 0 "INVALID" ;
VAL_ 168 OBJ_Long_Distance_V_11 1 "VALID" 0 "INVALID" ;
VAL_ 168 OBJ_Long_Distance_STD_V_11 1 "VALID" 0 "INVALID" ;
VAL_ 168 OBJ_Lat_Distance_V_11 1 "VALID" 0 "INVALID" ;
VAL_ 168 OBJ_Lat_Distance_STD_V_11 1 "VALID" 0 "INVALID" ;
VAL_ 168 OBJ_Absolute_Speed_V_11 1 "VALID" 0 "INVALID" ;
VAL_ 168 OBJ_Absolute_Speed_STD_V_11 1 "VALID" 0 "INVALID" ;
VAL_ 168 OBJ_Heading_V_11 1 "VALID" 0 "INVALID" ;
VAL_ 168 OBJ_Heading_STD_V_11 1 "VALID" 0 "INVALID" ;
VAL_ 168 OBJ_Angle_Rate_STD_V_11 1 "VALID" 0 "INVALID" ;
VAL_ 168 OBJ_Angle_Rate_V_11 1 "VALID" 0 "INVALID" ;
VAL_ 168 OBJ_Angle_Right_V_11 1 "VALID" 0 "INVALID" ;
VAL_ 168 OBJ_Angle_Right_STD_V_11 1 "VALID" 0 "INVALID" ;
VAL_ 168 OBJ_Angle_Left_V_11 1 "VALID" 0 "INVALID" ;
VAL_ 168 OBJ_Angle_Left_STD_V_11 1 "VALID" 0 "INVALID" ;
VAL_ 168 OBJ_Angle_Side_V_11 1 "VALID" 0 "INVALID" ;
VAL_ 168 OBJ_Angle_Side_STD_V_11 1 "VALID" 0 "INVALID" ;
VAL_ 168 OBJ_Angle_Mid_V_11 1 "VALID" 0 "INVALID" ;
VAL_ 168 OBJ_Angle_Mid_STD_V_11 1 "VALID" 0 "INVALID" ;
VAL_ 168 OBJ_Angle_Bottom_V_11 1 "VALID" 0 "INVALID" ;
VAL_ 168 OBJ_Angle_Bottom_STD_V_11 1 "VALID" 0 "INVALID" ;
VAL_ 168 OBJ_Visibility_Side_V_11 1 "VALID" 0 "INVALID" ;
VAL_ 168 OBJ_Visibility_Side_11 2 "REAR" 1 "FRONT" 0 "NOT_VISIBLE" ;
VAL_ 168 OBJ_Is_In_Drivable_Area_11 1 "TRUE" 0 "FALSE" ;
VAL_ 168 OBJ_Is_In_Drivable_Area_V_11 1 "VALID" 0 "INVALID" ;
VAL_ 168 OBJ_Is_VeryClose_11 1 "TRUE" 0 "FALSE" ;
VAL_ 168 OBJ_Is_VeryClose_V_11 1 "VALID" 0 "INVALID" ;
VAL_ 167 OBJ_Triggered_SDM_11 2 "NOT_TRIGGERED" 1 "TRIGGERED" 0 "NOT_AVAILABLE" ;
VAL_ 167 OBJ_Motion_Category_11 13 "ONCOMING" 12 "PRECEEDING" 11 "MOVING" 10 "RTAP" 9 "LTAP" 8 "CROSSING" 7 "MOVING_OUT" 6 "MOVING_IN" 5 "CLOSE_CUT_IN" 4 "PASSING_OUT" 3 "PASSING_IN" 2 "PASSING" 1 "UNDEFINED" 0 "INVALID" ;
VAL_ 167 OBJ_Measuring_Status_11 2 "(BIT_2)NOT_VALID_OR_VALID" 1 "(BIT_1)PREDICTED_OR_MEASURED" 0 "(BIT_0)OLD_OR_NEW" ;
VAL_ 167 OBJ_Object_Class_11 8 "UNCERTAIN_VCL" 7 "ANIMAL" 6 "GENERAL_OBJECT" 5 "PEDESTRIAN" 4 "BICYCLE" 3 "MOTOR_BIKE" 2 "TRUCK" 1 "CAR" 0 "INVALID" ;
VAL_ 167 OBJ_Camera_Source_11 11 "PARKING_RIGHT" 10 "PARKING_LEFT" 9 "PARKING_REAR" 8 "PARKING_FRONT" 7 "FRONT_CORNER_RIGHT" 6 "FRONT_CORNER_LEFT" 5 "REAR_CORNER_RIGHT" 4 "REAR_CORNER_LEFT" 3 "REAR" 2 "FRONT_FISHEYE" 1 "FRONT_NARROW" 0 "FRONT_MAIN" ;
VAL_ 167 OBJ_Motion_Status_11 5 "MOVING_SLOWLY" 4 "STOPPED" 3 "STATIONARY" 2 "MOVING" 1 "UNKNOWN" 0 "INVALID" ;
VAL_ 167 OBJ_Motion_Orientation_11 13 "UNKNOWN" 12 "PRECEEDING" 11 "DRIFTING_LEFT" 9 "CROSSING_LEFT" 7 "OC_DRIFTING_LEFT" 6 "ONCOMING" 5 "OC_DRIFTING_RIGHT" 3 "CROSSING_RIGHT" 1 "DRIFTING_RIGHT" 0 "INVALID" ;
VAL_ 167 OBJ_Has_Cut_Lane_11 1 "TRUE" 0 "FALSE" ;
VAL_ 167 OBJ_Has_Cut_Path_11 1 "TRUE" 0 "FALSE" ;
VAL_ 167 OBJ_Brake_Light_11 1 "TRUE" 0 "FALSE" ;
VAL_ 167 OBJ_Turn_Indicator_Right_11 1 "TRUE" 0 "FALSE" ;
VAL_ 167 OBJ_Turn_Indicator_Left_11 1 "TRUE" 0 "FALSE" ;
VAL_ 167 OBJ_Light_Indicator_Validity_11 1 "TRUE" 0 "FALSE" ;
VAL_ 167 OBJ_Right_Out_Of_Image_11 1 "TRUE" 0 "FALSE" ;
VAL_ 167 OBJ_Left_Out_Of_Image_11 1 "TRUE" 0 "FALSE" ;
VAL_ 167 OBJ_Right_Out_Of_Image_V_11 1 "TRUE" 0 "FALSE" ;
VAL_ 167 OBJ_Left_Out_Of_Image_V_11 1 "TRUE" 0 "FALSE" ;
VAL_ 167 OBJ_Top_Out_Of_Image_11 1 "TRUE" 0 "FALSE" ;
VAL_ 167 OBJ_Bottom_Out_Of_Image_11 1 "TRUE" 0 "FALSE" ;
VAL_ 167 OBJ_Top_Out_Of_Image_V_11 1 "VALID" 0 "INVALID" ;
VAL_ 167 OBJ_Bottom_Out_Of_Image_V_11 1 "VALID" 0 "INVALID" ;
VAL_ 167 OBJ_Lane_Assignment_11 5 "RIGHT_RIGHT" 4 "RIGHT" 3 "HOST" 2 "LEFT" 1 "LEFT_LEFT" 0 "UNKNOWN" ;
VAL_ 167 OBJ_Lane_Assignment_V_11 1 "VALID" 0 "INVALID" ;
VAL_ 167 OBJ_Age_Seconds_V_11 1 "VALID" 0 "INVALID" ;
VAL_ 167 OBJ_Width_V_11 1 "VALID" 0 "INVALID" ;
VAL_ 167 OBJ_Width_STD_V_11 1 "VALID" 0 "INVALID" ;
VAL_ 167 OBJ_Length_V_11 1 "VALID" 0 "INVALID" ;
VAL_ 167 OBJ_Length_STD_V_11 1 "VALID" 0 "INVALID" ;
VAL_ 167 OBJ_Height_V_11 1 "VALID" 0 "INVALID" ;
VAL_ 167 OBJ_Height_STD_V_11 1 "VALID" 0 "INVALID" ;
VAL_ 167 OBJ_Abs_Long_Velocity_V_11 1 "VALID" 0 "INVALID" ;
VAL_ 167 OBJ_Abs_Long_Vel_STD_V_11 1 "VALID" 0 "INVALID" ;
VAL_ 167 OBJ_Abs_Lat_Velocity_V_11 1 "VALID" 0 "INVALID" ;
VAL_ 167 OBJ_Abs_Lat_Vel_STD_V_11 1 "VALID" 0 "INVALID" ;
VAL_ 167 OBJ_Abs_Long_Acc_V_11 1 "VALID" 0 "INVALID" ;
VAL_ 167 OBJ_Abs_Long_Acc_STD_V_11 1 "VALID" 0 "INVALID" ;
VAL_ 167 OBJ_Abs_Lat_Acc_V_11 1 "VALID" 0 "INVALID" ;
VAL_ 167 OBJ_Abs_Lat_Acc_STD_V_11 1 "VALID" 0 "INVALID" ;
VAL_ 167 OBJ_Abs_Acceleration_V_11 1 "VALID" 0 "INVALID" ;
VAL_ 167 OBJ_Abs_Acc_STD_V_11 1 "VALID" 0 "INVALID" ;
VAL_ 167 OBJ_Inv_TTC_V_11 1 "VALID" 0 "INVALID" ;
VAL_ 167 OBJ_Inv_TTC_STD_V_11 1 "VALID" 0 "INVALID" ;
VAL_ 167 OBJ_Relative_Long_Acc_V_11 1 "VALID" 0 "INVALID" ;
VAL_ 167 OBJ_Rel_Long_Acc_STD_V_11 1 "VALID" 0 "INVALID" ;
VAL_ 166 OBJ_Relative_Long_Velocity_V_10 1 "VALID" 0 "INVALID" ;
VAL_ 166 OBJ_Rel_Long_Vel_STD_V_10 1 "VALID" 0 "INVALID" ;
VAL_ 166 OBJ_Relative_Lat_Velocity_V_10 1 "VALID" 0 "INVALID" ;
VAL_ 166 OBJ_Rel_Lat_Vel_STD_V_10 1 "VALID" 0 "INVALID" ;
VAL_ 166 OBJ_Long_Distance_V_10 1 "VALID" 0 "INVALID" ;
VAL_ 166 OBJ_Long_Distance_STD_V_10 1 "VALID" 0 "INVALID" ;
VAL_ 166 OBJ_Lat_Distance_V_10 1 "VALID" 0 "INVALID" ;
VAL_ 166 OBJ_Lat_Distance_STD_V_10 1 "VALID" 0 "INVALID" ;
VAL_ 166 OBJ_Absolute_Speed_V_10 1 "VALID" 0 "INVALID" ;
VAL_ 166 OBJ_Absolute_Speed_STD_V_10 1 "VALID" 0 "INVALID" ;
VAL_ 166 OBJ_Heading_V_10 1 "VALID" 0 "INVALID" ;
VAL_ 166 OBJ_Heading_STD_V_10 1 "VALID" 0 "INVALID" ;
VAL_ 166 OBJ_Angle_Rate_STD_V_10 1 "VALID" 0 "INVALID" ;
VAL_ 166 OBJ_Angle_Rate_V_10 1 "VALID" 0 "INVALID" ;
VAL_ 166 OBJ_Angle_Right_V_10 1 "VALID" 0 "INVALID" ;
VAL_ 166 OBJ_Angle_Right_STD_V_10 1 "VALID" 0 "INVALID" ;
VAL_ 166 OBJ_Angle_Left_V_10 1 "VALID" 0 "INVALID" ;
VAL_ 166 OBJ_Angle_Left_STD_V_10 1 "VALID" 0 "INVALID" ;
VAL_ 166 OBJ_Angle_Side_V_10 1 "VALID" 0 "INVALID" ;
VAL_ 166 OBJ_Angle_Side_STD_V_10 1 "VALID" 0 "INVALID" ;
VAL_ 166 OBJ_Angle_Mid_V_10 1 "VALID" 0 "INVALID" ;
VAL_ 166 OBJ_Angle_Mid_STD_V_10 1 "VALID" 0 "INVALID" ;
VAL_ 166 OBJ_Angle_Bottom_V_10 1 "VALID" 0 "INVALID" ;
VAL_ 166 OBJ_Angle_Bottom_STD_V_10 1 "VALID" 0 "INVALID" ;
VAL_ 166 OBJ_Visibility_Side_V_10 1 "VALID" 0 "INVALID" ;
VAL_ 166 OBJ_Visibility_Side_10 2 "REAR" 1 "FRONT" 0 "NOT_VISIBLE" ;
VAL_ 166 OBJ_Is_In_Drivable_Area_10 1 "TRUE" 0 "FALSE" ;
VAL_ 166 OBJ_Is_In_Drivable_Area_V_10 1 "VALID" 0 "INVALID" ;
VAL_ 166 OBJ_Is_VeryClose_10 1 "TRUE" 0 "FALSE" ;
VAL_ 166 OBJ_Is_VeryClose_V_10 1 "VALID" 0 "INVALID" ;
VAL_ 165 OBJ_Triggered_SDM_10 2 "NOT_TRIGGERED" 1 "TRIGGERED" 0 "NOT_AVAILABLE" ;
VAL_ 165 OBJ_Motion_Category_10 13 "ONCOMING" 12 "PRECEEDING" 11 "MOVING" 10 "RTAP" 9 "LTAP" 8 "CROSSING" 7 "MOVING_OUT" 6 "MOVING_IN" 5 "CLOSE_CUT_IN" 4 "PASSING_OUT" 3 "PASSING_IN" 2 "PASSING" 1 "UNDEFINED" 0 "INVALID" ;
VAL_ 165 OBJ_Measuring_Status_10 2 "(BIT_2)NOT_VALID_OR_VALID" 1 "(BIT_1)PREDICTED_OR_MEASURED" 0 "(BIT_0)OLD_OR_NEW" ;
VAL_ 165 OBJ_Object_Class_10 8 "UNCERTAIN_VCL" 7 "ANIMAL" 6 "GENERAL_OBJECT" 5 "PEDESTRIAN" 4 "BICYCLE" 3 "MOTOR_BIKE" 2 "TRUCK" 1 "CAR" 0 "INVALID" ;
VAL_ 165 OBJ_Camera_Source_10 11 "PARKING_RIGHT" 10 "PARKING_LEFT" 9 "PARKING_REAR" 8 "PARKING_FRONT" 7 "FRONT_CORNER_RIGHT" 6 "FRONT_CORNER_LEFT" 5 "REAR_CORNER_RIGHT" 4 "REAR_CORNER_LEFT" 3 "REAR" 2 "FRONT_FISHEYE" 1 "FRONT_NARROW" 0 "FRONT_MAIN" ;
VAL_ 165 OBJ_Motion_Status_10 5 "MOVING_SLOWLY" 4 "STOPPED" 3 "STATIONARY" 2 "MOVING" 1 "UNKNOWN" 0 "INVALID" ;
VAL_ 165 OBJ_Motion_Orientation_10 13 "UNKNOWN" 12 "PRECEEDING" 11 "DRIFTING_LEFT" 9 "CROSSING_LEFT" 7 "OC_DRIFTING_LEFT" 6 "ONCOMING" 5 "OC_DRIFTING_RIGHT" 3 "CROSSING_RIGHT" 1 "DRIFTING_RIGHT" 0 "INVALID" ;
VAL_ 165 OBJ_Has_Cut_Lane_10 1 "TRUE" 0 "FALSE" ;
VAL_ 165 OBJ_Has_Cut_Path_10 1 "TRUE" 0 "FALSE" ;
VAL_ 165 OBJ_Brake_Light_10 1 "TRUE" 0 "FALSE" ;
VAL_ 165 OBJ_Turn_Indicator_Right_10 1 "TRUE" 0 "FALSE" ;
VAL_ 165 OBJ_Turn_Indicator_Left_10 1 "TRUE" 0 "FALSE" ;
VAL_ 165 OBJ_Light_Indicator_Validity_10 1 "TRUE" 0 "FALSE" ;
VAL_ 165 OBJ_Right_Out_Of_Image_10 1 "TRUE" 0 "FALSE" ;
VAL_ 165 OBJ_Left_Out_Of_Image_10 1 "TRUE" 0 "FALSE" ;
VAL_ 165 OBJ_Right_Out_Of_Image_V_10 1 "TRUE" 0 "FALSE" ;
VAL_ 165 OBJ_Left_Out_Of_Image_V_10 1 "TRUE" 0 "FALSE" ;
VAL_ 165 OBJ_Top_Out_Of_Image_10 1 "TRUE" 0 "FALSE" ;
VAL_ 165 OBJ_Bottom_Out_Of_Image_10 1 "TRUE" 0 "FALSE" ;
VAL_ 165 OBJ_Top_Out_Of_Image_V_10 1 "VALID" 0 "INVALID" ;
VAL_ 165 OBJ_Bottom_Out_Of_Image_V_10 1 "VALID" 0 "INVALID" ;
VAL_ 165 OBJ_Lane_Assignment_10 5 "RIGHT_RIGHT" 4 "RIGHT" 3 "HOST" 2 "LEFT" 1 "LEFT_LEFT" 0 "UNKNOWN" ;
VAL_ 165 OBJ_Lane_Assignment_V_10 1 "VALID" 0 "INVALID" ;
VAL_ 165 OBJ_Age_Seconds_V_10 1 "VALID" 0 "INVALID" ;
VAL_ 165 OBJ_Width_V_10 1 "VALID" 0 "INVALID" ;
VAL_ 165 OBJ_Width_STD_V_10 1 "VALID" 0 "INVALID" ;
VAL_ 165 OBJ_Length_V_10 1 "VALID" 0 "INVALID" ;
VAL_ 165 OBJ_Length_STD_V_10 1 "VALID" 0 "INVALID" ;
VAL_ 165 OBJ_Height_V_10 1 "VALID" 0 "INVALID" ;
VAL_ 165 OBJ_Height_STD_V_10 1 "VALID" 0 "INVALID" ;
VAL_ 165 OBJ_Abs_Long_Velocity_V_10 1 "VALID" 0 "INVALID" ;
VAL_ 165 OBJ_Abs_Long_Vel_STD_V_10 1 "VALID" 0 "INVALID" ;
VAL_ 165 OBJ_Abs_Lat_Velocity_V_10 1 "VALID" 0 "INVALID" ;
VAL_ 165 OBJ_Abs_Lat_Vel_STD_V_10 1 "VALID" 0 "INVALID" ;
VAL_ 165 OBJ_Abs_Long_Acc_V_10 1 "VALID" 0 "INVALID" ;
VAL_ 165 OBJ_Abs_Long_Acc_STD_V_10 1 "VALID" 0 "INVALID" ;
VAL_ 165 OBJ_Abs_Lat_Acc_V_10 1 "VALID" 0 "INVALID" ;
VAL_ 165 OBJ_Abs_Lat_Acc_STD_V_10 1 "VALID" 0 "INVALID" ;
VAL_ 165 OBJ_Abs_Acceleration_V_10 1 "VALID" 0 "INVALID" ;
VAL_ 165 OBJ_Abs_Acc_STD_V_10 1 "VALID" 0 "INVALID" ;
VAL_ 165 OBJ_Inv_TTC_V_10 1 "VALID" 0 "INVALID" ;
VAL_ 165 OBJ_Inv_TTC_STD_V_10 1 "VALID" 0 "INVALID" ;
VAL_ 165 OBJ_Relative_Long_Acc_V_10 1 "VALID" 0 "INVALID" ;
VAL_ 165 OBJ_Rel_Long_Acc_STD_V_10 1 "VALID" 0 "INVALID" ;
VAL_ 164 OBJ_Relative_Long_Velocity_V_9 1 "VALID" 0 "INVALID" ;
VAL_ 164 OBJ_Rel_Long_Vel_STD_V_9 1 "VALID" 0 "INVALID" ;
VAL_ 164 OBJ_Relative_Lat_Velocity_V_9 1 "VALID" 0 "INVALID" ;
VAL_ 164 OBJ_Rel_Lat_Vel_STD_V_9 1 "VALID" 0 "INVALID" ;
VAL_ 164 OBJ_Long_Distance_V_9 1 "VALID" 0 "INVALID" ;
VAL_ 164 OBJ_Long_Distance_STD_V_9 1 "VALID" 0 "INVALID" ;
VAL_ 164 OBJ_Lat_Distance_V_9 1 "VALID" 0 "INVALID" ;
VAL_ 164 OBJ_Lat_Distance_STD_V_9 1 "VALID" 0 "INVALID" ;
VAL_ 164 OBJ_Absolute_Speed_V_9 1 "VALID" 0 "INVALID" ;
VAL_ 164 OBJ_Absolute_Speed_STD_V_9 1 "VALID" 0 "INVALID" ;
VAL_ 164 OBJ_Heading_V_9 1 "VALID" 0 "INVALID" ;
VAL_ 164 OBJ_Heading_STD_V_9 1 "VALID" 0 "INVALID" ;
VAL_ 164 OBJ_Angle_Rate_STD_V_9 1 "VALID" 0 "INVALID" ;
VAL_ 164 OBJ_Angle_Rate_V_9 1 "VALID" 0 "INVALID" ;
VAL_ 164 OBJ_Angle_Right_V_9 1 "VALID" 0 "INVALID" ;
VAL_ 164 OBJ_Angle_Right_STD_V_9 1 "VALID" 0 "INVALID" ;
VAL_ 164 OBJ_Angle_Left_V_9 1 "VALID" 0 "INVALID" ;
VAL_ 164 OBJ_Angle_Left_STD_V_9 1 "VALID" 0 "INVALID" ;
VAL_ 164 OBJ_Angle_Side_V_9 1 "VALID" 0 "INVALID" ;
VAL_ 164 OBJ_Angle_Side_STD_V_9 1 "VALID" 0 "INVALID" ;
VAL_ 164 OBJ_Angle_Mid_V_9 1 "VALID" 0 "INVALID" ;
VAL_ 164 OBJ_Angle_Mid_STD_V_9 1 "VALID" 0 "INVALID" ;
VAL_ 164 OBJ_Angle_Bottom_V_9 1 "VALID" 0 "INVALID" ;
VAL_ 164 OBJ_Angle_Bottom_STD_V_9 1 "VALID" 0 "INVALID" ;
VAL_ 164 OBJ_Visibility_Side_V_9 1 "VALID" 0 "INVALID" ;
VAL_ 164 OBJ_Visibility_Side_9 2 "REAR" 1 "FRONT" 0 "NOT_VISIBLE" ;
VAL_ 164 OBJ_Is_In_Drivable_Area_9 1 "TRUE" 0 "FALSE" ;
VAL_ 164 OBJ_Is_In_Drivable_Area_V_9 1 "VALID" 0 "INVALID" ;
VAL_ 164 OBJ_Is_VeryClose_9 1 "TRUE" 0 "FALSE" ;
VAL_ 164 OBJ_Is_VeryClose_V_9 1 "VALID" 0 "INVALID" ;
VAL_ 163 OBJ_Triggered_SDM_9 2 "NOT_TRIGGERED" 1 "TRIGGERED" 0 "NOT_AVAILABLE" ;
VAL_ 163 OBJ_Motion_Category_9 13 "ONCOMING" 12 "PRECEEDING" 11 "MOVING" 10 "RTAP" 9 "LTAP" 8 "CROSSING" 7 "MOVING_OUT" 6 "MOVING_IN" 5 "CLOSE_CUT_IN" 4 "PASSING_OUT" 3 "PASSING_IN" 2 "PASSING" 1 "UNDEFINED" 0 "INVALID" ;
VAL_ 163 OBJ_Measuring_Status_9 2 "(BIT_2)NOT_VALID_OR_VALID" 1 "(BIT_1)PREDICTED_OR_MEASURED" 0 "(BIT_0)OLD_OR_NEW" ;
VAL_ 163 OBJ_Object_Class_9 8 "UNCERTAIN_VCL" 7 "ANIMAL" 6 "GENERAL_OBJECT" 5 "PEDESTRIAN" 4 "BICYCLE" 3 "MOTOR_BIKE" 2 "TRUCK" 1 "CAR" 0 "INVALID" ;
VAL_ 163 OBJ_Camera_Source_9 11 "PARKING_RIGHT" 10 "PARKING_LEFT" 9 "PARKING_REAR" 8 "PARKING_FRONT" 7 "FRONT_CORNER_RIGHT" 6 "FRONT_CORNER_LEFT" 5 "REAR_CORNER_RIGHT" 4 "REAR_CORNER_LEFT" 3 "REAR" 2 "FRONT_FISHEYE" 1 "FRONT_NARROW" 0 "FRONT_MAIN" ;
VAL_ 163 OBJ_Motion_Status_9 5 "MOVING_SLOWLY" 4 "STOPPED" 3 "STATIONARY" 2 "MOVING" 1 "UNKNOWN" 0 "INVALID" ;
VAL_ 163 OBJ_Motion_Orientation_9 13 "UNKNOWN" 12 "PRECEEDING" 11 "DRIFTING_LEFT" 9 "CROSSING_LEFT" 7 "OC_DRIFTING_LEFT" 6 "ONCOMING" 5 "OC_DRIFTING_RIGHT" 3 "CROSSING_RIGHT" 1 "DRIFTING_RIGHT" 0 "INVALID" ;
VAL_ 163 OBJ_Has_Cut_Lane_9 1 "TRUE" 0 "FALSE" ;
VAL_ 163 OBJ_Has_Cut_Path_9 1 "TRUE" 0 "FALSE" ;
VAL_ 163 OBJ_Brake_Light_9 1 "TRUE" 0 "FALSE" ;
VAL_ 163 OBJ_Turn_Indicator_Right_9 1 "TRUE" 0 "FALSE" ;
VAL_ 163 OBJ_Turn_Indicator_Left_9 1 "TRUE" 0 "FALSE" ;
VAL_ 163 OBJ_Light_Indicator_Validity_9 1 "TRUE" 0 "FALSE" ;
VAL_ 163 OBJ_Right_Out_Of_Image_9 1 "TRUE" 0 "FALSE" ;
VAL_ 163 OBJ_Left_Out_Of_Image_9 1 "TRUE" 0 "FALSE" ;
VAL_ 163 OBJ_Right_Out_Of_Image_V_9 1 "TRUE" 0 "FALSE" ;
VAL_ 163 OBJ_Left_Out_Of_Image_V_9 1 "TRUE" 0 "FALSE" ;
VAL_ 163 OBJ_Top_Out_Of_Image_9 1 "TRUE" 0 "FALSE" ;
VAL_ 163 OBJ_Bottom_Out_Of_Image_9 1 "TRUE" 0 "FALSE" ;
VAL_ 163 OBJ_Top_Out_Of_Image_V_9 1 "VALID" 0 "INVALID" ;
VAL_ 163 OBJ_Bottom_Out_Of_Image_V_9 1 "VALID" 0 "INVALID" ;
VAL_ 163 OBJ_Lane_Assignment_9 5 "RIGHT_RIGHT" 4 "RIGHT" 3 "HOST" 2 "LEFT" 1 "LEFT_LEFT" 0 "UNKNOWN" ;
VAL_ 163 OBJ_Lane_Assignment_V_9 1 "VALID" 0 "INVALID" ;
VAL_ 163 OBJ_Age_Seconds_V_9 1 "VALID" 0 "INVALID" ;
VAL_ 163 OBJ_Width_V_9 1 "VALID" 0 "INVALID" ;
VAL_ 163 OBJ_Width_STD_V_9 1 "VALID" 0 "INVALID" ;
VAL_ 163 OBJ_Length_V_9 1 "VALID" 0 "INVALID" ;
VAL_ 163 OBJ_Length_STD_V_9 1 "VALID" 0 "INVALID" ;
VAL_ 163 OBJ_Height_V_9 1 "VALID" 0 "INVALID" ;
VAL_ 163 OBJ_Height_STD_V_9 1 "VALID" 0 "INVALID" ;
VAL_ 163 OBJ_Abs_Long_Velocity_V_9 1 "VALID" 0 "INVALID" ;
VAL_ 163 OBJ_Abs_Long_Vel_STD_V_9 1 "VALID" 0 "INVALID" ;
VAL_ 163 OBJ_Abs_Lat_Velocity_V_9 1 "VALID" 0 "INVALID" ;
VAL_ 163 OBJ_Abs_Lat_Vel_STD_V_9 1 "VALID" 0 "INVALID" ;
VAL_ 163 OBJ_Abs_Long_Acc_V_9 1 "VALID" 0 "INVALID" ;
VAL_ 163 OBJ_Abs_Long_Acc_STD_V_9 1 "VALID" 0 "INVALID" ;
VAL_ 163 OBJ_Abs_Lat_Acc_V_9 1 "VALID" 0 "INVALID" ;
VAL_ 163 OBJ_Abs_Lat_Acc_STD_V_9 1 "VALID" 0 "INVALID" ;
VAL_ 163 OBJ_Abs_Acceleration_V_9 1 "VALID" 0 "INVALID" ;
VAL_ 163 OBJ_Abs_Acc_STD_V_9 1 "VALID" 0 "INVALID" ;
VAL_ 163 OBJ_Inv_TTC_V_9 1 "VALID" 0 "INVALID" ;
VAL_ 163 OBJ_Inv_TTC_STD_V_9 1 "VALID" 0 "INVALID" ;
VAL_ 163 OBJ_Relative_Long_Acc_V_9 1 "VALID" 0 "INVALID" ;
VAL_ 163 OBJ_Rel_Long_Acc_STD_V_9 1 "VALID" 0 "INVALID" ;
VAL_ 162 OBJ_Relative_Long_Velocity_V_8 1 "VALID" 0 "INVALID" ;
VAL_ 162 OBJ_Rel_Long_Vel_STD_V_8 1 "VALID" 0 "INVALID" ;
VAL_ 162 OBJ_Relative_Lat_Velocity_V_8 1 "VALID" 0 "INVALID" ;
VAL_ 162 OBJ_Rel_Lat_Vel_STD_V_8 1 "VALID" 0 "INVALID" ;
VAL_ 162 OBJ_Long_Distance_V_8 1 "VALID" 0 "INVALID" ;
VAL_ 162 OBJ_Long_Distance_STD_V_8 1 "VALID" 0 "INVALID" ;
VAL_ 162 OBJ_Lat_Distance_V_8 1 "VALID" 0 "INVALID" ;
VAL_ 162 OBJ_Lat_Distance_STD_V_8 1 "VALID" 0 "INVALID" ;
VAL_ 162 OBJ_Absolute_Speed_V_8 1 "VALID" 0 "INVALID" ;
VAL_ 162 OBJ_Absolute_Speed_STD_V_8 1 "VALID" 0 "INVALID" ;
VAL_ 162 OBJ_Heading_V_8 1 "VALID" 0 "INVALID" ;
VAL_ 162 OBJ_Heading_STD_V_8 1 "VALID" 0 "INVALID" ;
VAL_ 162 OBJ_Angle_Rate_STD_V_8 1 "VALID" 0 "INVALID" ;
VAL_ 162 OBJ_Angle_Rate_V_8 1 "VALID" 0 "INVALID" ;
VAL_ 162 OBJ_Angle_Right_V_8 1 "VALID" 0 "INVALID" ;
VAL_ 162 OBJ_Angle_Right_STD_V_8 1 "VALID" 0 "INVALID" ;
VAL_ 162 OBJ_Angle_Left_V_8 1 "VALID" 0 "INVALID" ;
VAL_ 162 OBJ_Angle_Left_STD_V_8 1 "VALID" 0 "INVALID" ;
VAL_ 162 OBJ_Angle_Side_V_8 1 "VALID" 0 "INVALID" ;
VAL_ 162 OBJ_Angle_Side_STD_V_8 1 "VALID" 0 "INVALID" ;
VAL_ 162 OBJ_Angle_Mid_V_8 1 "VALID" 0 "INVALID" ;
VAL_ 162 OBJ_Angle_Mid_STD_V_8 1 "VALID" 0 "INVALID" ;
VAL_ 162 OBJ_Angle_Bottom_V_8 1 "VALID" 0 "INVALID" ;
VAL_ 162 OBJ_Angle_Bottom_STD_V_8 1 "VALID" 0 "INVALID" ;
VAL_ 162 OBJ_Visibility_Side_V_8 1 "VALID" 0 "INVALID" ;
VAL_ 162 OBJ_Visibility_Side_8 2 "REAR" 1 "FRONT" 0 "NOT_VISIBLE" ;
VAL_ 162 OBJ_Is_In_Drivable_Area_8 1 "TRUE" 0 "FALSE" ;
VAL_ 162 OBJ_Is_In_Drivable_Area_V_8 1 "VALID" 0 "INVALID" ;
VAL_ 162 OBJ_Is_VeryClose_8 1 "TRUE" 0 "FALSE" ;
VAL_ 162 OBJ_Is_VeryClose_V_8 1 "VALID" 0 "INVALID" ;
VAL_ 161 OBJ_Triggered_SDM_8 2 "NOT_TRIGGERED" 1 "TRIGGERED" 0 "NOT_AVAILABLE" ;
VAL_ 161 OBJ_Motion_Category_8 13 "ONCOMING" 12 "PRECEEDING" 11 "MOVING" 10 "RTAP" 9 "LTAP" 8 "CROSSING" 7 "MOVING_OUT" 6 "MOVING_IN" 5 "CLOSE_CUT_IN" 4 "PASSING_OUT" 3 "PASSING_IN" 2 "PASSING" 1 "UNDEFINED" 0 "INVALID" ;
VAL_ 161 OBJ_Measuring_Status_8 2 "(BIT_2)NOT_VALID_OR_VALID" 1 "(BIT_1)PREDICTED_OR_MEASURED" 0 "(BIT_0)OLD_OR_NEW" ;
VAL_ 161 OBJ_Object_Class_8 8 "UNCERTAIN_VCL" 7 "ANIMAL" 6 "GENERAL_OBJECT" 5 "PEDESTRIAN" 4 "BICYCLE" 3 "MOTOR_BIKE" 2 "TRUCK" 1 "CAR" 0 "INVALID" ;
VAL_ 161 OBJ_Camera_Source_8 11 "PARKING_RIGHT" 10 "PARKING_LEFT" 9 "PARKING_REAR" 8 "PARKING_FRONT" 7 "FRONT_CORNER_RIGHT" 6 "FRONT_CORNER_LEFT" 5 "REAR_CORNER_RIGHT" 4 "REAR_CORNER_LEFT" 3 "REAR" 2 "FRONT_FISHEYE" 1 "FRONT_NARROW" 0 "FRONT_MAIN" ;
VAL_ 161 OBJ_Motion_Status_8 5 "MOVING_SLOWLY" 4 "STOPPED" 3 "STATIONARY" 2 "MOVING" 1 "UNKNOWN" 0 "INVALID" ;
VAL_ 161 OBJ_Motion_Orientation_8 13 "UNKNOWN" 12 "PRECEEDING" 11 "DRIFTING_LEFT" 9 "CROSSING_LEFT" 7 "OC_DRIFTING_LEFT" 6 "ONCOMING" 5 "OC_DRIFTING_RIGHT" 3 "CROSSING_RIGHT" 1 "DRIFTING_RIGHT" 0 "INVALID" ;
VAL_ 161 OBJ_Has_Cut_Lane_8 1 "TRUE" 0 "FALSE" ;
VAL_ 161 OBJ_Has_Cut_Path_8 1 "TRUE" 0 "FALSE" ;
VAL_ 161 OBJ_Brake_Light_8 1 "TRUE" 0 "FALSE" ;
VAL_ 161 OBJ_Turn_Indicator_Right_8 1 "TRUE" 0 "FALSE" ;
VAL_ 161 OBJ_Turn_Indicator_Left_8 1 "TRUE" 0 "FALSE" ;
VAL_ 161 OBJ_Light_Indicator_Validity_8 1 "TRUE" 0 "FALSE" ;
VAL_ 161 OBJ_Right_Out_Of_Image_8 1 "TRUE" 0 "FALSE" ;
VAL_ 161 OBJ_Left_Out_Of_Image_8 1 "TRUE" 0 "FALSE" ;
VAL_ 161 OBJ_Right_Out_Of_Image_V_8 1 "TRUE" 0 "FALSE" ;
VAL_ 161 OBJ_Left_Out_Of_Image_V_8 1 "TRUE" 0 "FALSE" ;
VAL_ 161 OBJ_Top_Out_Of_Image_8 1 "TRUE" 0 "FALSE" ;
VAL_ 161 OBJ_Bottom_Out_Of_Image_8 1 "TRUE" 0 "FALSE" ;
VAL_ 161 OBJ_Top_Out_Of_Image_V_8 1 "VALID" 0 "INVALID" ;
VAL_ 161 OBJ_Bottom_Out_Of_Image_V_8 1 "VALID" 0 "INVALID" ;
VAL_ 161 OBJ_Lane_Assignment_8 5 "RIGHT_RIGHT" 4 "RIGHT" 3 "HOST" 2 "LEFT" 1 "LEFT_LEFT" 0 "UNKNOWN" ;
VAL_ 161 OBJ_Lane_Assignment_V_8 1 "VALID" 0 "INVALID" ;
VAL_ 161 OBJ_Age_Seconds_V_8 1 "VALID" 0 "INVALID" ;
VAL_ 161 OBJ_Width_V_8 1 "VALID" 0 "INVALID" ;
VAL_ 161 OBJ_Width_STD_V_8 1 "VALID" 0 "INVALID" ;
VAL_ 161 OBJ_Length_V_8 1 "VALID" 0 "INVALID" ;
VAL_ 161 OBJ_Length_STD_V_8 1 "VALID" 0 "INVALID" ;
VAL_ 161 OBJ_Height_V_8 1 "VALID" 0 "INVALID" ;
VAL_ 161 OBJ_Height_STD_V_8 1 "VALID" 0 "INVALID" ;
VAL_ 161 OBJ_Abs_Long_Velocity_V_8 1 "VALID" 0 "INVALID" ;
VAL_ 161 OBJ_Abs_Long_Vel_STD_V_8 1 "VALID" 0 "INVALID" ;
VAL_ 161 OBJ_Abs_Lat_Velocity_V_8 1 "VALID" 0 "INVALID" ;
VAL_ 161 OBJ_Abs_Lat_Vel_STD_V_8 1 "VALID" 0 "INVALID" ;
VAL_ 161 OBJ_Abs_Long_Acc_V_8 1 "VALID" 0 "INVALID" ;
VAL_ 161 OBJ_Abs_Long_Acc_STD_V_8 1 "VALID" 0 "INVALID" ;
VAL_ 161 OBJ_Abs_Lat_Acc_V_8 1 "VALID" 0 "INVALID" ;
VAL_ 161 OBJ_Abs_Lat_Acc_STD_V_8 1 "VALID" 0 "INVALID" ;
VAL_ 161 OBJ_Abs_Acceleration_V_8 1 "VALID" 0 "INVALID" ;
VAL_ 161 OBJ_Abs_Acc_STD_V_8 1 "VALID" 0 "INVALID" ;
VAL_ 161 OBJ_Inv_TTC_V_8 1 "VALID" 0 "INVALID" ;
VAL_ 161 OBJ_Inv_TTC_STD_V_8 1 "VALID" 0 "INVALID" ;
VAL_ 161 OBJ_Relative_Long_Acc_V_8 1 "VALID" 0 "INVALID" ;
VAL_ 161 OBJ_Rel_Long_Acc_STD_V_8 1 "VALID" 0 "INVALID" ;
VAL_ 160 OBJ_Relative_Long_Velocity_V_7 1 "VALID" 0 "INVALID" ;
VAL_ 160 OBJ_Rel_Long_Vel_STD_V_7 1 "VALID" 0 "INVALID" ;
VAL_ 160 OBJ_Relative_Lat_Velocity_V_7 1 "VALID" 0 "INVALID" ;
VAL_ 160 OBJ_Rel_Lat_Vel_STD_V_7 1 "VALID" 0 "INVALID" ;
VAL_ 160 OBJ_Long_Distance_V_7 1 "VALID" 0 "INVALID" ;
VAL_ 160 OBJ_Long_Distance_STD_V_7 1 "VALID" 0 "INVALID" ;
VAL_ 160 OBJ_Lat_Distance_V_7 1 "VALID" 0 "INVALID" ;
VAL_ 160 OBJ_Lat_Distance_STD_V_7 1 "VALID" 0 "INVALID" ;
VAL_ 160 OBJ_Absolute_Speed_V_7 1 "VALID" 0 "INVALID" ;
VAL_ 160 OBJ_Absolute_Speed_STD_V_7 1 "VALID" 0 "INVALID" ;
VAL_ 160 OBJ_Heading_V_7 1 "VALID" 0 "INVALID" ;
VAL_ 160 OBJ_Heading_STD_V_7 1 "VALID" 0 "INVALID" ;
VAL_ 160 OBJ_Angle_Rate_STD_V_7 1 "VALID" 0 "INVALID" ;
VAL_ 160 OBJ_Angle_Rate_V_7 1 "VALID" 0 "INVALID" ;
VAL_ 160 OBJ_Angle_Right_V_7 1 "VALID" 0 "INVALID" ;
VAL_ 160 OBJ_Angle_Right_STD_V_7 1 "VALID" 0 "INVALID" ;
VAL_ 160 OBJ_Angle_Left_V_7 1 "VALID" 0 "INVALID" ;
VAL_ 160 OBJ_Angle_Left_STD_V_7 1 "VALID" 0 "INVALID" ;
VAL_ 160 OBJ_Angle_Side_V_7 1 "VALID" 0 "INVALID" ;
VAL_ 160 OBJ_Angle_Side_STD_V_7 1 "VALID" 0 "INVALID" ;
VAL_ 160 OBJ_Angle_Mid_V_7 1 "VALID" 0 "INVALID" ;
VAL_ 160 OBJ_Angle_Mid_STD_V_7 1 "VALID" 0 "INVALID" ;
VAL_ 160 OBJ_Angle_Bottom_V_7 1 "VALID" 0 "INVALID" ;
VAL_ 160 OBJ_Angle_Bottom_STD_V_7 1 "VALID" 0 "INVALID" ;
VAL_ 160 OBJ_Visibility_Side_V_7 1 "VALID" 0 "INVALID" ;
VAL_ 160 OBJ_Visibility_Side_7 2 "REAR" 1 "FRONT" 0 "NOT_VISIBLE" ;
VAL_ 160 OBJ_Is_In_Drivable_Area_7 1 "TRUE" 0 "FALSE" ;
VAL_ 160 OBJ_Is_In_Drivable_Area_V_7 1 "VALID" 0 "INVALID" ;
VAL_ 160 OBJ_Is_VeryClose_7 1 "TRUE" 0 "FALSE" ;
VAL_ 160 OBJ_Is_VeryClose_V_7 1 "VALID" 0 "INVALID" ;
VAL_ 159 OBJ_Triggered_SDM_7 2 "NOT_TRIGGERED" 1 "TRIGGERED" 0 "NOT_AVAILABLE" ;
VAL_ 159 OBJ_Motion_Category_7 13 "ONCOMING" 12 "PRECEEDING" 11 "MOVING" 10 "RTAP" 9 "LTAP" 8 "CROSSING" 7 "MOVING_OUT" 6 "MOVING_IN" 5 "CLOSE_CUT_IN" 4 "PASSING_OUT" 3 "PASSING_IN" 2 "PASSING" 1 "UNDEFINED" 0 "INVALID" ;
VAL_ 159 OBJ_Measuring_Status_7 2 "(BIT_2)NOT_VALID_OR_VALID" 1 "(BIT_1)PREDICTED_OR_MEASURED" 0 "(BIT_0)OLD_OR_NEW" ;
VAL_ 159 OBJ_Object_Class_7 8 "UNCERTAIN_VCL" 7 "ANIMAL" 6 "GENERAL_OBJECT" 5 "PEDESTRIAN" 4 "BICYCLE" 3 "MOTOR_BIKE" 2 "TRUCK" 1 "CAR" 0 "INVALID" ;
VAL_ 159 OBJ_Camera_Source_7 11 "PARKING_RIGHT" 10 "PARKING_LEFT" 9 "PARKING_REAR" 8 "PARKING_FRONT" 7 "FRONT_CORNER_RIGHT" 6 "FRONT_CORNER_LEFT" 5 "REAR_CORNER_RIGHT" 4 "REAR_CORNER_LEFT" 3 "REAR" 2 "FRONT_FISHEYE" 1 "FRONT_NARROW" 0 "FRONT_MAIN" ;
VAL_ 159 OBJ_Motion_Status_7 5 "MOVING_SLOWLY" 4 "STOPPED" 3 "STATIONARY" 2 "MOVING" 1 "UNKNOWN" 0 "INVALID" ;
VAL_ 159 OBJ_Motion_Orientation_7 13 "UNKNOWN" 12 "PRECEEDING" 11 "DRIFTING_LEFT" 9 "CROSSING_LEFT" 7 "OC_DRIFTING_LEFT" 6 "ONCOMING" 5 "OC_DRIFTING_RIGHT" 3 "CROSSING_RIGHT" 1 "DRIFTING_RIGHT" 0 "INVALID" ;
VAL_ 159 OBJ_Has_Cut_Lane_7 1 "TRUE" 0 "FALSE" ;
VAL_ 159 OBJ_Has_Cut_Path_7 1 "TRUE" 0 "FALSE" ;
VAL_ 159 OBJ_Brake_Light_7 1 "TRUE" 0 "FALSE" ;
VAL_ 159 OBJ_Turn_Indicator_Right_7 1 "TRUE" 0 "FALSE" ;
VAL_ 159 OBJ_Turn_Indicator_Left_7 1 "TRUE" 0 "FALSE" ;
VAL_ 159 OBJ_Light_Indicator_Validity_7 1 "TRUE" 0 "FALSE" ;
VAL_ 159 OBJ_Right_Out_Of_Image_7 1 "TRUE" 0 "FALSE" ;
VAL_ 159 OBJ_Left_Out_Of_Image_7 1 "TRUE" 0 "FALSE" ;
VAL_ 159 OBJ_Right_Out_Of_Image_V_7 1 "TRUE" 0 "FALSE" ;
VAL_ 159 OBJ_Left_Out_Of_Image_V_7 1 "TRUE" 0 "FALSE" ;
VAL_ 159 OBJ_Top_Out_Of_Image_7 1 "TRUE" 0 "FALSE" ;
VAL_ 159 OBJ_Bottom_Out_Of_Image_7 1 "TRUE" 0 "FALSE" ;
VAL_ 159 OBJ_Top_Out_Of_Image_V_7 1 "VALID" 0 "INVALID" ;
VAL_ 159 OBJ_Bottom_Out_Of_Image_V_7 1 "VALID" 0 "INVALID" ;
VAL_ 159 OBJ_Lane_Assignment_7 5 "RIGHT_RIGHT" 4 "RIGHT" 3 "HOST" 2 "LEFT" 1 "LEFT_LEFT" 0 "UNKNOWN" ;
VAL_ 159 OBJ_Lane_Assignment_V_7 1 "VALID" 0 "INVALID" ;
VAL_ 159 OBJ_Age_Seconds_V_7 1 "VALID" 0 "INVALID" ;
VAL_ 159 OBJ_Width_V_7 1 "VALID" 0 "INVALID" ;
VAL_ 159 OBJ_Width_STD_V_7 1 "VALID" 0 "INVALID" ;
VAL_ 159 OBJ_Length_V_7 1 "VALID" 0 "INVALID" ;
VAL_ 159 OBJ_Length_STD_V_7 1 "VALID" 0 "INVALID" ;
VAL_ 159 OBJ_Height_V_7 1 "VALID" 0 "INVALID" ;
VAL_ 159 OBJ_Height_STD_V_7 1 "VALID" 0 "INVALID" ;
VAL_ 159 OBJ_Abs_Long_Velocity_V_7 1 "VALID" 0 "INVALID" ;
VAL_ 159 OBJ_Abs_Long_Vel_STD_V_7 1 "VALID" 0 "INVALID" ;
VAL_ 159 OBJ_Abs_Lat_Velocity_V_7 1 "VALID" 0 "INVALID" ;
VAL_ 159 OBJ_Abs_Lat_Vel_STD_V_7 1 "VALID" 0 "INVALID" ;
VAL_ 159 OBJ_Abs_Long_Acc_V_7 1 "VALID" 0 "INVALID" ;
VAL_ 159 OBJ_Abs_Long_Acc_STD_V_7 1 "VALID" 0 "INVALID" ;
VAL_ 159 OBJ_Abs_Lat_Acc_V_7 1 "VALID" 0 "INVALID" ;
VAL_ 159 OBJ_Abs_Lat_Acc_STD_V_7 1 "VALID" 0 "INVALID" ;
VAL_ 159 OBJ_Abs_Acceleration_V_7 1 "VALID" 0 "INVALID" ;
VAL_ 159 OBJ_Abs_Acc_STD_V_7 1 "VALID" 0 "INVALID" ;
VAL_ 159 OBJ_Inv_TTC_V_7 1 "VALID" 0 "INVALID" ;
VAL_ 159 OBJ_Inv_TTC_STD_V_7 1 "VALID" 0 "INVALID" ;
VAL_ 159 OBJ_Relative_Long_Acc_V_7 1 "VALID" 0 "INVALID" ;
VAL_ 159 OBJ_Rel_Long_Acc_STD_V_7 1 "VALID" 0 "INVALID" ;
VAL_ 158 OBJ_Relative_Long_Velocity_V_6 1 "VALID" 0 "INVALID" ;
VAL_ 158 OBJ_Rel_Long_Vel_STD_V_6 1 "VALID" 0 "INVALID" ;
VAL_ 158 OBJ_Relative_Lat_Velocity_V_6 1 "VALID" 0 "INVALID" ;
VAL_ 158 OBJ_Rel_Lat_Vel_STD_V_6 1 "VALID" 0 "INVALID" ;
VAL_ 158 OBJ_Long_Distance_V_6 1 "VALID" 0 "INVALID" ;
VAL_ 158 OBJ_Long_Distance_STD_V_6 1 "VALID" 0 "INVALID" ;
VAL_ 158 OBJ_Lat_Distance_V_6 1 "VALID" 0 "INVALID" ;
VAL_ 158 OBJ_Lat_Distance_STD_V_6 1 "VALID" 0 "INVALID" ;
VAL_ 158 OBJ_Absolute_Speed_V_6 1 "VALID" 0 "INVALID" ;
VAL_ 158 OBJ_Absolute_Speed_STD_V_6 1 "VALID" 0 "INVALID" ;
VAL_ 158 OBJ_Heading_V_6 1 "VALID" 0 "INVALID" ;
VAL_ 158 OBJ_Heading_STD_V_6 1 "VALID" 0 "INVALID" ;
VAL_ 158 OBJ_Angle_Rate_STD_V_6 1 "VALID" 0 "INVALID" ;
VAL_ 158 OBJ_Angle_Rate_V_6 1 "VALID" 0 "INVALID" ;
VAL_ 158 OBJ_Angle_Right_V_6 1 "VALID" 0 "INVALID" ;
VAL_ 158 OBJ_Angle_Right_STD_V_6 1 "VALID" 0 "INVALID" ;
VAL_ 158 OBJ_Angle_Left_V_6 1 "VALID" 0 "INVALID" ;
VAL_ 158 OBJ_Angle_Left_STD_V_6 1 "VALID" 0 "INVALID" ;
VAL_ 158 OBJ_Angle_Side_V_6 1 "VALID" 0 "INVALID" ;
VAL_ 158 OBJ_Angle_Side_STD_V_6 1 "VALID" 0 "INVALID" ;
VAL_ 158 OBJ_Angle_Mid_V_6 1 "VALID" 0 "INVALID" ;
VAL_ 158 OBJ_Angle_Mid_STD_V_6 1 "VALID" 0 "INVALID" ;
VAL_ 158 OBJ_Angle_Bottom_V_6 1 "VALID" 0 "INVALID" ;
VAL_ 158 OBJ_Angle_Bottom_STD_V_6 1 "VALID" 0 "INVALID" ;
VAL_ 158 OBJ_Visibility_Side_V_6 1 "VALID" 0 "INVALID" ;
VAL_ 158 OBJ_Visibility_Side_6 2 "REAR" 1 "FRONT" 0 "NOT_VISIBLE" ;
VAL_ 158 OBJ_Is_In_Drivable_Area_6 1 "TRUE" 0 "FALSE" ;
VAL_ 158 OBJ_Is_In_Drivable_Area_V_6 1 "VALID" 0 "INVALID" ;
VAL_ 158 OBJ_Is_VeryClose_6 1 "TRUE" 0 "FALSE" ;
VAL_ 158 OBJ_Is_VeryClose_V_6 1 "VALID" 0 "INVALID" ;
VAL_ 157 OBJ_Triggered_SDM_6 2 "NOT_TRIGGERED" 1 "TRIGGERED" 0 "NOT_AVAILABLE" ;
VAL_ 157 OBJ_Motion_Category_6 13 "ONCOMING" 12 "PRECEEDING" 11 "MOVING" 10 "RTAP" 9 "LTAP" 8 "CROSSING" 7 "MOVING_OUT" 6 "MOVING_IN" 5 "CLOSE_CUT_IN" 4 "PASSING_OUT" 3 "PASSING_IN" 2 "PASSING" 1 "UNDEFINED" 0 "INVALID" ;
VAL_ 157 OBJ_Measuring_Status_6 2 "(BIT_2)NOT_VALID_OR_VALID" 1 "(BIT_1)PREDICTED_OR_MEASURED" 0 "(BIT_0)OLD_OR_NEW" ;
VAL_ 157 OBJ_Object_Class_6 8 "UNCERTAIN_VCL" 7 "ANIMAL" 6 "GENERAL_OBJECT" 5 "PEDESTRIAN" 4 "BICYCLE" 3 "MOTOR_BIKE" 2 "TRUCK" 1 "CAR" 0 "INVALID" ;
VAL_ 157 OBJ_Camera_Source_6 11 "PARKING_RIGHT" 10 "PARKING_LEFT" 9 "PARKING_REAR" 8 "PARKING_FRONT" 7 "FRONT_CORNER_RIGHT" 6 "FRONT_CORNER_LEFT" 5 "REAR_CORNER_RIGHT" 4 "REAR_CORNER_LEFT" 3 "REAR" 2 "FRONT_FISHEYE" 1 "FRONT_NARROW" 0 "FRONT_MAIN" ;
VAL_ 157 OBJ_Motion_Status_6 5 "MOVING_SLOWLY" 4 "STOPPED" 3 "STATIONARY" 2 "MOVING" 1 "UNKNOWN" 0 "INVALID" ;
VAL_ 157 OBJ_Motion_Orientation_6 13 "UNKNOWN" 12 "PRECEEDING" 11 "DRIFTING_LEFT" 9 "CROSSING_LEFT" 7 "OC_DRIFTING_LEFT" 6 "ONCOMING" 5 "OC_DRIFTING_RIGHT" 3 "CROSSING_RIGHT" 1 "DRIFTING_RIGHT" 0 "INVALID" ;
VAL_ 157 OBJ_Has_Cut_Lane_6 1 "TRUE" 0 "FALSE" ;
VAL_ 157 OBJ_Has_Cut_Path_6 1 "TRUE" 0 "FALSE" ;
VAL_ 157 OBJ_Brake_Light_6 1 "TRUE" 0 "FALSE" ;
VAL_ 157 OBJ_Turn_Indicator_Right_6 1 "TRUE" 0 "FALSE" ;
VAL_ 157 OBJ_Turn_Indicator_Left_6 1 "TRUE" 0 "FALSE" ;
VAL_ 157 OBJ_Light_Indicator_Validity_6 1 "TRUE" 0 "FALSE" ;
VAL_ 157 OBJ_Right_Out_Of_Image_6 1 "TRUE" 0 "FALSE" ;
VAL_ 157 OBJ_Left_Out_Of_Image_6 1 "TRUE" 0 "FALSE" ;
VAL_ 157 OBJ_Right_Out_Of_Image_V_6 1 "TRUE" 0 "FALSE" ;
VAL_ 157 OBJ_Left_Out_Of_Image_V_6 1 "TRUE" 0 "FALSE" ;
VAL_ 157 OBJ_Top_Out_Of_Image_6 1 "TRUE" 0 "FALSE" ;
VAL_ 157 OBJ_Bottom_Out_Of_Image_6 1 "TRUE" 0 "FALSE" ;
VAL_ 157 OBJ_Top_Out_Of_Image_V_6 1 "VALID" 0 "INVALID" ;
VAL_ 157 OBJ_Bottom_Out_Of_Image_V_6 1 "VALID" 0 "INVALID" ;
VAL_ 157 OBJ_Lane_Assignment_6 5 "RIGHT_RIGHT" 4 "RIGHT" 3 "HOST" 2 "LEFT" 1 "LEFT_LEFT" 0 "UNKNOWN" ;
VAL_ 157 OBJ_Lane_Assignment_V_6 1 "VALID" 0 "INVALID" ;
VAL_ 157 OBJ_Age_Seconds_V_6 1 "VALID" 0 "INVALID" ;
VAL_ 157 OBJ_Width_V_6 1 "VALID" 0 "INVALID" ;
VAL_ 157 OBJ_Width_STD_V_6 1 "VALID" 0 "INVALID" ;
VAL_ 157 OBJ_Length_V_6 1 "VALID" 0 "INVALID" ;
VAL_ 157 OBJ_Length_STD_V_6 1 "VALID" 0 "INVALID" ;
VAL_ 157 OBJ_Height_V_6 1 "VALID" 0 "INVALID" ;
VAL_ 157 OBJ_Height_STD_V_6 1 "VALID" 0 "INVALID" ;
VAL_ 157 OBJ_Abs_Long_Velocity_V_6 1 "VALID" 0 "INVALID" ;
VAL_ 157 OBJ_Abs_Long_Vel_STD_V_6 1 "VALID" 0 "INVALID" ;
VAL_ 157 OBJ_Abs_Lat_Velocity_V_6 1 "VALID" 0 "INVALID" ;
VAL_ 157 OBJ_Abs_Lat_Vel_STD_V_6 1 "VALID" 0 "INVALID" ;
VAL_ 157 OBJ_Abs_Long_Acc_V_6 1 "VALID" 0 "INVALID" ;
VAL_ 157 OBJ_Abs_Long_Acc_STD_V_6 1 "VALID" 0 "INVALID" ;
VAL_ 157 OBJ_Abs_Lat_Acc_V_6 1 "VALID" 0 "INVALID" ;
VAL_ 157 OBJ_Abs_Lat_Acc_STD_V_6 1 "VALID" 0 "INVALID" ;
VAL_ 157 OBJ_Abs_Acceleration_V_6 1 "VALID" 0 "INVALID" ;
VAL_ 157 OBJ_Abs_Acc_STD_V_6 1 "VALID" 0 "INVALID" ;
VAL_ 157 OBJ_Inv_TTC_V_6 1 "VALID" 0 "INVALID" ;
VAL_ 157 OBJ_Inv_TTC_STD_V_6 1 "VALID" 0 "INVALID" ;
VAL_ 157 OBJ_Relative_Long_Acc_V_6 1 "VALID" 0 "INVALID" ;
VAL_ 157 OBJ_Rel_Long_Acc_STD_V_6 1 "VALID" 0 "INVALID" ;
SIG_GROUP_ 176 ICM_Object_Prot15_B 1 : OBJ_Buffer_15 OBJ_Is_VeryClose_V_15 OBJ_Is_VeryClose_15 OBJ_Is_In_Drivable_Area_V_15 OBJ_Is_In_Drivable_Area_15 OBJ_Visibility_Side_15 OBJ_Visibility_Side_V_15 OBJ_Angle_Bottom_STD_V_15 OBJ_Angle_Bottom_STD_15 OBJ_Angle_Bottom_15 OBJ_Angle_Bottom_V_15 OBJ_Angle_Mid_STD_V_15 OBJ_Angle_Mid_STD_15 OBJ_Angle_Mid_15 OBJ_Angle_Mid_V_15 OBJ_Angle_Side_STD_V_15 OBJ_Angle_Side_STD_15 OBJ_Angle_Side_V_15 OBJ_Angle_Side_15 OBJ_Angle_Left_STD_V_15 OBJ_Angle_Left_STD_15 OBJ_Angle_Left_V_15 OBJ_Angle_Left_15 OBJ_Angle_Right_STD_V_15 OBJ_Angle_Right_STD_15 OBJ_Angle_Right_V_15 OBJ_Angle_Right_15 OBJ_Angle_Rate_V_15 OBJ_Angle_Rate_15 OBJ_Angle_Rate_STD_V_15 OBJ_Angle_Rate_STD_15 OBJ_Heading_STD_V_15 OBJ_Heading_STD_15 OBJ_Heading_V_15 OBJ_Heading_15 OBJ_Absolute_Speed_STD_V_15 OBJ_Absolute_Speed_STD_15 OBJ_Absolute_Speed_V_15 OBJ_Absolute_Speed_15 OBJ_Lat_Distance_STD_V_15 OBJ_Lat_Distance_STD_15 OBJ_Lat_Distance_V_15 OBJ_Lat_Distance_15 OBJ_Long_Distance_STD_V_15 OBJ_Long_Distance_STD_15 OBJ_Long_Distance_V_15 OBJ_Long_Distance_15 OBJ_Rel_Lat_Vel_STD_V_15 OBJ_Relative_Lat_Velocity_STD_15 OBJ_Relative_Lat_Velocity_V_15 OBJ_Relative_Lat_Velocity_15 OBJ_Rel_Long_Vel_STD_V_15 OBJ_Relative_Long_Vel_STD_15 OBJ_Relative_Long_Velocity_V_15 OBJ_Relative_Long_Velocity_15 ICM_Object_Prot15_B_Header;
SIG_GROUP_ 175 ICM_Object_Prot15_A 1 : OBJ_Rel_Long_Acc_STD_V_15 OBJ_Relative_Long_Acc_STD_15 OBJ_Relative_Long_Acc_V_15 OBJ_Relative_Long_Acc_15 OBJ_Inv_TTC_STD_V_15 OBJ_Inv_TTC_STD_15 OBJ_Inv_TTC_V_15 OBJ_Inv_TTC_15 OBJ_Abs_Acc_STD_V_15 OBJ_Abs_Acc_STD_15 OBJ_Abs_Acceleration_V_15 OBJ_Abs_Acceleration_15 OBJ_Abs_Lat_Acc_STD_V_15 OBJ_Abs_Lat_Acc_STD_15 OBJ_Abs_Lat_Acc_V_15 OBJ_Abs_Lat_Acc_15 OBJ_Abs_Long_Acc_STD_V_15 OBJ_Abs_Long_Acc_STD_15 OBJ_Abs_Long_Acc_V_15 OBJ_Abs_Long_Acc_15 OBJ_Abs_Lat_Vel_STD_V_15 OBJ_Abs_Lat_Velocity_STD_15 OBJ_Abs_Lat_Velocity_V_15 OBJ_Abs_Lat_Velocity_15 OBJ_Abs_Long_Vel_STD_V_15 OBJ_Abs_Long_Velocity_STD_15 OBJ_Abs_Long_Velocity_V_15 OBJ_Abs_Long_Velocity_15 OBJ_Height_STD_V_15 OBJ_Height_STD_15 OBJ_Height_V_15 OBJ_Height_15 OBJ_Length_STD_V_15 OBJ_Length_STD_15 OBJ_Length_V_15 OBJ_Length_15 OBJ_Width_STD_V_15 OBJ_Width_STD_15 OBJ_Width_V_15 OBJ_Width_15 OBJ_Age_Seconds_V_15 OBJ_Age_Seconds_15 OBJ_Lane_Assignment_V_15 OBJ_Lane_Assignment_15 OBJ_Bottom_Out_Of_Image_V_15 OBJ_Top_Out_Of_Image_V_15 OBJ_Bottom_Out_Of_Image_15 OBJ_Top_Out_Of_Image_15 OBJ_Left_Out_Of_Image_V_15 OBJ_Right_Out_Of_Image_V_15 OBJ_Left_Out_Of_Image_15 OBJ_Right_Out_Of_Image_15 OBJ_Light_Indicator_Validity_15 OBJ_Turn_Indicator_Left_15 OBJ_Turn_Indicator_Right_15 OBJ_Brake_Light_15 OBJ_Has_Cut_Path_15 OBJ_Has_Cut_Lane_15 OBJ_Motion_Orientation_15 OBJ_Motion_Status_15 OBJ_Camera_Source_15 OBJ_Bike_Probability_15 OBJ_Truck_Probability_15 OBJ_Car_Probability_15 OBJ_Class_Probability_15 OBJ_Object_Class_15 OBJ_Measuring_Status_15 OBJ_Object_Age_15 OBJ_Moving_IN_Probability_15 OBJ_Motion_Category_15 OBJ_Triggered_SDM_15 OBJ_Fusion_Source_15 OBJ_Existence_Probability_15 OBJ_ID_15 OBJ_CRC_15 ICM_Object_Prot15_A_Header;
SIG_GROUP_ 174 ICM_Object_Prot14_B 1 : OBJ_Buffer_14 OBJ_Is_VeryClose_V_14 OBJ_Is_VeryClose_14 OBJ_Is_In_Drivable_Area_V_14 OBJ_Is_In_Drivable_Area_14 OBJ_Visibility_Side_14 OBJ_Visibility_Side_V_14 OBJ_Angle_Bottom_STD_V_14 OBJ_Angle_Bottom_STD_14 OBJ_Angle_Bottom_14 OBJ_Angle_Bottom_V_14 OBJ_Angle_Mid_STD_V_14 OBJ_Angle_Mid_STD_14 OBJ_Angle_Mid_14 OBJ_Angle_Mid_V_14 OBJ_Angle_Side_STD_V_14 OBJ_Angle_Side_STD_14 OBJ_Angle_Side_V_14 OBJ_Angle_Side_14 OBJ_Angle_Left_STD_V_14 OBJ_Angle_Left_STD_14 OBJ_Angle_Left_V_14 OBJ_Angle_Left_14 OBJ_Angle_Right_STD_V_14 OBJ_Angle_Right_STD_14 OBJ_Angle_Right_V_14 OBJ_Angle_Right_14 OBJ_Angle_Rate_V_14 OBJ_Angle_Rate_14 OBJ_Angle_Rate_STD_V_14 OBJ_Angle_Rate_STD_14 OBJ_Heading_STD_V_14 OBJ_Heading_STD_14 OBJ_Heading_V_14 OBJ_Heading_14 OBJ_Absolute_Speed_STD_V_14 OBJ_Absolute_Speed_STD_14 OBJ_Absolute_Speed_V_14 OBJ_Absolute_Speed_14 OBJ_Lat_Distance_STD_V_14 OBJ_Lat_Distance_STD_14 OBJ_Lat_Distance_V_14 OBJ_Lat_Distance_14 OBJ_Long_Distance_STD_V_14 OBJ_Long_Distance_STD_14 OBJ_Long_Distance_V_14 OBJ_Long_Distance_14 OBJ_Rel_Lat_Vel_STD_V_14 OBJ_Relative_Lat_Velocity_STD_14 OBJ_Relative_Lat_Velocity_V_14 OBJ_Relative_Lat_Velocity_14 OBJ_Rel_Long_Vel_STD_V_14 OBJ_Relative_Long_Vel_STD_14 OBJ_Relative_Long_Velocity_V_14 OBJ_Relative_Long_Velocity_14 ICM_Object_Prot14_B_Header;
SIG_GROUP_ 173 ICM_Object_Prot14_A 1 : OBJ_Rel_Long_Acc_STD_V_14 OBJ_Relative_Long_Acc_STD_14 OBJ_Relative_Long_Acc_V_14 OBJ_Relative_Long_Acc_14 OBJ_Inv_TTC_STD_V_14 OBJ_Inv_TTC_STD_14 OBJ_Inv_TTC_V_14 OBJ_Inv_TTC_14 OBJ_Abs_Acc_STD_V_14 OBJ_Abs_Acc_STD_14 OBJ_Abs_Acceleration_V_14 OBJ_Abs_Acceleration_14 OBJ_Abs_Lat_Acc_STD_V_14 OBJ_Abs_Lat_Acc_STD_14 OBJ_Abs_Lat_Acc_V_14 OBJ_Abs_Lat_Acc_14 OBJ_Abs_Long_Acc_STD_V_14 OBJ_Abs_Long_Acc_STD_14 OBJ_Abs_Long_Acc_V_14 OBJ_Abs_Long_Acc_14 OBJ_Abs_Lat_Vel_STD_V_14 OBJ_Abs_Lat_Velocity_STD_14 OBJ_Abs_Lat_Velocity_V_14 OBJ_Abs_Lat_Velocity_14 OBJ_Abs_Long_Vel_STD_V_14 OBJ_Abs_Long_Velocity_STD_14 OBJ_Abs_Long_Velocity_V_14 OBJ_Abs_Long_Velocity_14 OBJ_Height_STD_V_14 OBJ_Height_STD_14 OBJ_Height_V_14 OBJ_Height_14 OBJ_Length_STD_V_14 OBJ_Length_STD_14 OBJ_Length_V_14 OBJ_Length_14 OBJ_Width_STD_V_14 OBJ_Width_STD_14 OBJ_Width_V_14 OBJ_Width_14 OBJ_Age_Seconds_V_14 OBJ_Age_Seconds_14 OBJ_Lane_Assignment_V_14 OBJ_Lane_Assignment_14 OBJ_Bottom_Out_Of_Image_V_14 OBJ_Top_Out_Of_Image_V_14 OBJ_Bottom_Out_Of_Image_14 OBJ_Top_Out_Of_Image_14 OBJ_Left_Out_Of_Image_V_14 OBJ_Right_Out_Of_Image_V_14 OBJ_Left_Out_Of_Image_14 OBJ_Right_Out_Of_Image_14 OBJ_Light_Indicator_Validity_14 OBJ_Turn_Indicator_Left_14 OBJ_Turn_Indicator_Right_14 OBJ_Brake_Light_14 OBJ_Has_Cut_Path_14 OBJ_Has_Cut_Lane_14 OBJ_Motion_Orientation_14 OBJ_Motion_Status_14 OBJ_Camera_Source_14 OBJ_Bike_Probability_14 OBJ_Truck_Probability_14 OBJ_Car_Probability_14 OBJ_Class_Probability_14 OBJ_Object_Class_14 OBJ_Measuring_Status_14 OBJ_Object_Age_14 OBJ_Moving_IN_Probability_14 OBJ_Motion_Category_14 OBJ_Triggered_SDM_14 OBJ_Fusion_Source_14 OBJ_Existence_Probability_14 OBJ_ID_14 OBJ_CRC_14 ICM_Object_Prot14_A_Header;
SIG_GROUP_ 172 ICM_Object_Prot13_B 1 : OBJ_Buffer_13 OBJ_Is_VeryClose_V_13 OBJ_Is_VeryClose_13 OBJ_Is_In_Drivable_Area_V_13 OBJ_Is_In_Drivable_Area_13 OBJ_Visibility_Side_13 OBJ_Visibility_Side_V_13 OBJ_Angle_Bottom_STD_V_13 OBJ_Angle_Bottom_STD_13 OBJ_Angle_Bottom_13 OBJ_Angle_Bottom_V_13 OBJ_Angle_Mid_STD_V_13 OBJ_Angle_Mid_STD_13 OBJ_Angle_Mid_13 OBJ_Angle_Mid_V_13 OBJ_Angle_Side_STD_V_13 OBJ_Angle_Side_STD_13 OBJ_Angle_Side_V_13 OBJ_Angle_Side_13 OBJ_Angle_Left_STD_V_13 OBJ_Angle_Left_STD_13 OBJ_Angle_Left_V_13 OBJ_Angle_Left_13 OBJ_Angle_Right_STD_V_13 OBJ_Angle_Right_STD_13 OBJ_Angle_Right_V_13 OBJ_Angle_Right_13 OBJ_Angle_Rate_V_13 OBJ_Angle_Rate_13 OBJ_Angle_Rate_STD_V_13 OBJ_Angle_Rate_STD_13 OBJ_Heading_STD_V_13 OBJ_Heading_STD_13 OBJ_Heading_V_13 OBJ_Heading_13 OBJ_Absolute_Speed_STD_V_13 OBJ_Absolute_Speed_STD_13 OBJ_Absolute_Speed_V_13 OBJ_Absolute_Speed_13 OBJ_Lat_Distance_STD_V_13 OBJ_Lat_Distance_STD_13 OBJ_Lat_Distance_V_13 OBJ_Lat_Distance_13 OBJ_Long_Distance_STD_V_13 OBJ_Long_Distance_STD_13 OBJ_Long_Distance_V_13 OBJ_Long_Distance_13 OBJ_Rel_Lat_Vel_STD_V_13 OBJ_Relative_Lat_Velocity_STD_13 OBJ_Relative_Lat_Velocity_V_13 OBJ_Relative_Lat_Velocity_13 OBJ_Rel_Long_Vel_STD_V_13 OBJ_Relative_Long_Vel_STD_13 OBJ_Relative_Long_Velocity_V_13 OBJ_Relative_Long_Velocity_13 ICM_Object_Prot13_B_Header;
SIG_GROUP_ 171 ICM_Object_Prot13_A 1 : OBJ_Rel_Long_Acc_STD_V_13 OBJ_Relative_Long_Acc_STD_13 OBJ_Relative_Long_Acc_V_13 OBJ_Relative_Long_Acc_13 OBJ_Inv_TTC_STD_V_13 OBJ_Inv_TTC_STD_13 OBJ_Inv_TTC_V_13 OBJ_Inv_TTC_13 OBJ_Abs_Acc_STD_V_13 OBJ_Abs_Acc_STD_13 OBJ_Abs_Acceleration_V_13 OBJ_Abs_Acceleration_13 OBJ_Abs_Lat_Acc_STD_V_13 OBJ_Abs_Lat_Acc_STD_13 OBJ_Abs_Lat_Acc_V_13 OBJ_Abs_Lat_Acc_13 OBJ_Abs_Long_Acc_STD_V_13 OBJ_Abs_Long_Acc_STD_13 OBJ_Abs_Long_Acc_V_13 OBJ_Abs_Long_Acc_13 OBJ_Abs_Lat_Vel_STD_V_13 OBJ_Abs_Lat_Velocity_STD_13 OBJ_Abs_Lat_Velocity_V_13 OBJ_Abs_Lat_Velocity_13 OBJ_Abs_Long_Vel_STD_V_13 OBJ_Abs_Long_Velocity_STD_13 OBJ_Abs_Long_Velocity_V_13 OBJ_Abs_Long_Velocity_13 OBJ_Height_STD_V_13 OBJ_Height_STD_13 OBJ_Height_V_13 OBJ_Height_13 OBJ_Length_STD_V_13 OBJ_Length_STD_13 OBJ_Length_V_13 OBJ_Length_13 OBJ_Width_STD_V_13 OBJ_Width_STD_13 OBJ_Width_V_13 OBJ_Width_13 OBJ_Age_Seconds_V_13 OBJ_Age_Seconds_13 OBJ_Lane_Assignment_V_13 OBJ_Lane_Assignment_13 OBJ_Bottom_Out_Of_Image_V_13 OBJ_Top_Out_Of_Image_V_13 OBJ_Bottom_Out_Of_Image_13 OBJ_Top_Out_Of_Image_13 OBJ_Left_Out_Of_Image_V_13 OBJ_Right_Out_Of_Image_V_13 OBJ_Left_Out_Of_Image_13 OBJ_Right_Out_Of_Image_13 OBJ_Light_Indicator_Validity_13 OBJ_Turn_Indicator_Left_13 OBJ_Turn_Indicator_Right_13 OBJ_Brake_Light_13 OBJ_Has_Cut_Path_13 OBJ_Has_Cut_Lane_13 OBJ_Motion_Orientation_13 OBJ_Motion_Status_13 OBJ_Camera_Source_13 OBJ_Bike_Probability_13 OBJ_Truck_Probability_13 OBJ_Car_Probability_13 OBJ_Class_Probability_13 OBJ_Object_Class_13 OBJ_Measuring_Status_13 OBJ_Object_Age_13 OBJ_Moving_IN_Probability_13 OBJ_Motion_Category_13 OBJ_Triggered_SDM_13 OBJ_Fusion_Source_13 OBJ_Existence_Probability_13 OBJ_ID_13 OBJ_CRC_13 ICM_Object_Prot13_A_Header;
SIG_GROUP_ 170 ICM_Object_Prot12_B 1 : OBJ_Buffer_12 OBJ_Is_VeryClose_V_12 OBJ_Is_VeryClose_12 OBJ_Is_In_Drivable_Area_V_12 OBJ_Is_In_Drivable_Area_12 OBJ_Visibility_Side_12 OBJ_Visibility_Side_V_12 OBJ_Angle_Bottom_STD_V_12 OBJ_Angle_Bottom_STD_12 OBJ_Angle_Bottom_12 OBJ_Angle_Bottom_V_12 OBJ_Angle_Mid_STD_V_12 OBJ_Angle_Mid_STD_12 OBJ_Angle_Mid_12 OBJ_Angle_Mid_V_12 OBJ_Angle_Side_STD_V_12 OBJ_Angle_Side_STD_12 OBJ_Angle_Side_V_12 OBJ_Angle_Side_12 OBJ_Angle_Left_STD_V_12 OBJ_Angle_Left_STD_12 OBJ_Angle_Left_V_12 OBJ_Angle_Left_12 OBJ_Angle_Right_STD_V_12 OBJ_Angle_Right_STD_12 OBJ_Angle_Right_V_12 OBJ_Angle_Right_12 OBJ_Angle_Rate_V_12 OBJ_Angle_Rate_12 OBJ_Angle_Rate_STD_V_12 OBJ_Angle_Rate_STD_12 OBJ_Heading_STD_V_12 OBJ_Heading_STD_12 OBJ_Heading_V_12 OBJ_Heading_12 OBJ_Absolute_Speed_STD_V_12 OBJ_Absolute_Speed_STD_12 OBJ_Absolute_Speed_V_12 OBJ_Absolute_Speed_12 OBJ_Lat_Distance_STD_V_12 OBJ_Lat_Distance_STD_12 OBJ_Lat_Distance_V_12 OBJ_Lat_Distance_12 OBJ_Long_Distance_STD_V_12 OBJ_Long_Distance_STD_12 OBJ_Long_Distance_V_12 OBJ_Long_Distance_12 OBJ_Rel_Lat_Vel_STD_V_12 OBJ_Relative_Lat_Velocity_STD_12 OBJ_Relative_Lat_Velocity_V_12 OBJ_Relative_Lat_Velocity_12 OBJ_Rel_Long_Vel_STD_V_12 OBJ_Relative_Long_Vel_STD_12 OBJ_Relative_Long_Velocity_V_12 OBJ_Relative_Long_Velocity_12 ICM_Object_Prot12_B_Header;
SIG_GROUP_ 169 ICM_Object_Prot12_A 1 : OBJ_Rel_Long_Acc_STD_V_12 OBJ_Relative_Long_Acc_STD_12 OBJ_Relative_Long_Acc_V_12 OBJ_Relative_Long_Acc_12 OBJ_Inv_TTC_STD_V_12 OBJ_Inv_TTC_STD_12 OBJ_Inv_TTC_V_12 OBJ_Inv_TTC_12 OBJ_Abs_Acc_STD_V_12 OBJ_Abs_Acc_STD_12 OBJ_Abs_Acceleration_V_12 OBJ_Abs_Acceleration_12 OBJ_Abs_Lat_Acc_STD_V_12 OBJ_Abs_Lat_Acc_STD_12 OBJ_Abs_Lat_Acc_V_12 OBJ_Abs_Lat_Acc_12 OBJ_Abs_Long_Acc_STD_V_12 OBJ_Abs_Long_Acc_STD_12 OBJ_Abs_Long_Acc_V_12 OBJ_Abs_Long_Acc_12 OBJ_Abs_Lat_Vel_STD_V_12 OBJ_Abs_Lat_Velocity_STD_12 OBJ_Abs_Lat_Velocity_V_12 OBJ_Abs_Lat_Velocity_12 OBJ_Abs_Long_Vel_STD_V_12 OBJ_Abs_Long_Velocity_STD_12 OBJ_Abs_Long_Velocity_V_12 OBJ_Abs_Long_Velocity_12 OBJ_Height_STD_V_12 OBJ_Height_STD_12 OBJ_Height_V_12 OBJ_Height_12 OBJ_Length_STD_V_12 OBJ_Length_STD_12 OBJ_Length_V_12 OBJ_Length_12 OBJ_Width_STD_V_12 OBJ_Width_STD_12 OBJ_Width_V_12 OBJ_Width_12 OBJ_Age_Seconds_V_12 OBJ_Age_Seconds_12 OBJ_Lane_Assignment_V_12 OBJ_Lane_Assignment_12 OBJ_Bottom_Out_Of_Image_V_12 OBJ_Top_Out_Of_Image_V_12 OBJ_Bottom_Out_Of_Image_12 OBJ_Top_Out_Of_Image_12 OBJ_Left_Out_Of_Image_V_12 OBJ_Right_Out_Of_Image_V_12 OBJ_Left_Out_Of_Image_12 OBJ_Right_Out_Of_Image_12 OBJ_Light_Indicator_Validity_12 OBJ_Turn_Indicator_Left_12 OBJ_Turn_Indicator_Right_12 OBJ_Brake_Light_12 OBJ_Has_Cut_Path_12 OBJ_Has_Cut_Lane_12 OBJ_Motion_Orientation_12 OBJ_Motion_Status_12 OBJ_Camera_Source_12 OBJ_Bike_Probability_12 OBJ_Truck_Probability_12 OBJ_Car_Probability_12 OBJ_Class_Probability_12 OBJ_Object_Class_12 OBJ_Measuring_Status_12 OBJ_Object_Age_12 OBJ_Moving_IN_Probability_12 OBJ_Motion_Category_12 OBJ_Triggered_SDM_12 OBJ_Fusion_Source_12 OBJ_Existence_Probability_12 OBJ_ID_12 OBJ_CRC_12 ICM_Object_Prot12_A_Header;
SIG_GROUP_ 168 ICM_Object_Prot11_B 1 : OBJ_Buffer_11 OBJ_Is_VeryClose_V_11 OBJ_Is_VeryClose_11 OBJ_Is_In_Drivable_Area_V_11 OBJ_Is_In_Drivable_Area_11 OBJ_Visibility_Side_11 OBJ_Visibility_Side_V_11 OBJ_Angle_Bottom_STD_V_11 OBJ_Angle_Bottom_STD_11 OBJ_Angle_Bottom_11 OBJ_Angle_Bottom_V_11 OBJ_Angle_Mid_STD_V_11 OBJ_Angle_Mid_STD_11 OBJ_Angle_Mid_11 OBJ_Angle_Mid_V_11 OBJ_Angle_Side_STD_V_11 OBJ_Angle_Side_STD_11 OBJ_Angle_Side_V_11 OBJ_Angle_Side_11 OBJ_Angle_Left_STD_V_11 OBJ_Angle_Left_STD_11 OBJ_Angle_Left_V_11 OBJ_Angle_Left_11 OBJ_Angle_Right_STD_V_11 OBJ_Angle_Right_STD_11 OBJ_Angle_Right_V_11 OBJ_Angle_Right_11 OBJ_Angle_Rate_V_11 OBJ_Angle_Rate_11 OBJ_Angle_Rate_STD_V_11 OBJ_Angle_Rate_STD_11 OBJ_Heading_STD_V_11 OBJ_Heading_STD_11 OBJ_Heading_V_11 OBJ_Heading_11 OBJ_Absolute_Speed_STD_V_11 OBJ_Absolute_Speed_STD_11 OBJ_Absolute_Speed_V_11 OBJ_Absolute_Speed_11 OBJ_Lat_Distance_STD_V_11 OBJ_Lat_Distance_STD_11 OBJ_Lat_Distance_V_11 OBJ_Lat_Distance_11 OBJ_Long_Distance_STD_V_11 OBJ_Long_Distance_STD_11 OBJ_Long_Distance_V_11 OBJ_Long_Distance_11 OBJ_Rel_Lat_Vel_STD_V_11 OBJ_Relative_Lat_Velocity_STD_11 OBJ_Relative_Lat_Velocity_V_11 OBJ_Relative_Lat_Velocity_11 OBJ_Rel_Long_Vel_STD_V_11 OBJ_Relative_Long_Vel_STD_11 OBJ_Relative_Long_Velocity_V_11 OBJ_Relative_Long_Velocity_11 ICM_Object_Prot11_B_Header;
SIG_GROUP_ 167 ICM_Object_Prot11_A 1 : OBJ_Rel_Long_Acc_STD_V_11 OBJ_Relative_Long_Acc_STD_11 OBJ_Relative_Long_Acc_V_11 OBJ_Relative_Long_Acc_11 OBJ_Inv_TTC_STD_V_11 OBJ_Inv_TTC_STD_11 OBJ_Inv_TTC_V_11 OBJ_Inv_TTC_11 OBJ_Abs_Acc_STD_V_11 OBJ_Abs_Acc_STD_11 OBJ_Abs_Acceleration_V_11 OBJ_Abs_Acceleration_11 OBJ_Abs_Lat_Acc_STD_V_11 OBJ_Abs_Lat_Acc_STD_11 OBJ_Abs_Lat_Acc_V_11 OBJ_Abs_Lat_Acc_11 OBJ_Abs_Long_Acc_STD_V_11 OBJ_Abs_Long_Acc_STD_11 OBJ_Abs_Long_Acc_V_11 OBJ_Abs_Long_Acc_11 OBJ_Abs_Lat_Vel_STD_V_11 OBJ_Abs_Lat_Velocity_STD_11 OBJ_Abs_Lat_Velocity_V_11 OBJ_Abs_Lat_Velocity_11 OBJ_Abs_Long_Vel_STD_V_11 OBJ_Abs_Long_Velocity_STD_11 OBJ_Abs_Long_Velocity_V_11 OBJ_Abs_Long_Velocity_11 OBJ_Height_STD_V_11 OBJ_Height_STD_11 OBJ_Height_V_11 OBJ_Height_11 OBJ_Length_STD_V_11 OBJ_Length_STD_11 OBJ_Length_V_11 OBJ_Length_11 OBJ_Width_STD_V_11 OBJ_Width_STD_11 OBJ_Width_V_11 OBJ_Width_11 OBJ_Age_Seconds_V_11 OBJ_Age_Seconds_11 OBJ_Lane_Assignment_V_11 OBJ_Lane_Assignment_11 OBJ_Bottom_Out_Of_Image_V_11 OBJ_Top_Out_Of_Image_V_11 OBJ_Bottom_Out_Of_Image_11 OBJ_Top_Out_Of_Image_11 OBJ_Left_Out_Of_Image_V_11 OBJ_Right_Out_Of_Image_V_11 OBJ_Left_Out_Of_Image_11 OBJ_Right_Out_Of_Image_11 OBJ_Light_Indicator_Validity_11 OBJ_Turn_Indicator_Left_11 OBJ_Turn_Indicator_Right_11 OBJ_Brake_Light_11 OBJ_Has_Cut_Path_11 OBJ_Has_Cut_Lane_11 OBJ_Motion_Orientation_11 OBJ_Motion_Status_11 OBJ_Camera_Source_11 OBJ_Bike_Probability_11 OBJ_Truck_Probability_11 OBJ_Car_Probability_11 OBJ_Class_Probability_11 OBJ_Object_Class_11 OBJ_Measuring_Status_11 OBJ_Object_Age_11 OBJ_Moving_IN_Probability_11 OBJ_Motion_Category_11 OBJ_Triggered_SDM_11 OBJ_Fusion_Source_11 OBJ_Existence_Probability_11 OBJ_ID_11 OBJ_CRC_11 ICM_Object_Prot11_A_Header;
SIG_GROUP_ 166 ICM_Object_Prot10_B 1 : OBJ_Buffer_10 OBJ_Is_VeryClose_V_10 OBJ_Is_VeryClose_10 OBJ_Is_In_Drivable_Area_V_10 OBJ_Is_In_Drivable_Area_10 OBJ_Visibility_Side_10 OBJ_Visibility_Side_V_10 OBJ_Angle_Bottom_STD_V_10 OBJ_Angle_Bottom_STD_10 OBJ_Angle_Bottom_10 OBJ_Angle_Bottom_V_10 OBJ_Angle_Mid_STD_V_10 OBJ_Angle_Mid_STD_10 OBJ_Angle_Mid_10 OBJ_Angle_Mid_V_10 OBJ_Angle_Side_STD_V_10 OBJ_Angle_Side_STD_10 OBJ_Angle_Side_V_10 OBJ_Angle_Side_10 OBJ_Angle_Left_STD_V_10 OBJ_Angle_Left_STD_10 OBJ_Angle_Left_V_10 OBJ_Angle_Left_10 OBJ_Angle_Right_STD_V_10 OBJ_Angle_Right_STD_10 OBJ_Angle_Right_V_10 OBJ_Angle_Right_10 OBJ_Angle_Rate_V_10 OBJ_Angle_Rate_10 OBJ_Angle_Rate_STD_V_10 OBJ_Angle_Rate_STD_10 OBJ_Heading_STD_V_10 OBJ_Heading_STD_10 OBJ_Heading_V_10 OBJ_Heading_10 OBJ_Absolute_Speed_STD_V_10 OBJ_Absolute_Speed_STD_10 OBJ_Absolute_Speed_V_10 OBJ_Absolute_Speed_10 OBJ_Lat_Distance_STD_V_10 OBJ_Lat_Distance_STD_10 OBJ_Lat_Distance_V_10 OBJ_Lat_Distance_10 OBJ_Long_Distance_STD_V_10 OBJ_Long_Distance_STD_10 OBJ_Long_Distance_V_10 OBJ_Long_Distance_10 OBJ_Rel_Lat_Vel_STD_V_10 OBJ_Relative_Lat_Velocity_STD_10 OBJ_Relative_Lat_Velocity_V_10 OBJ_Relative_Lat_Velocity_10 OBJ_Rel_Long_Vel_STD_V_10 OBJ_Relative_Long_Vel_STD_10 OBJ_Relative_Long_Velocity_V_10 OBJ_Relative_Long_Velocity_10 ICM_Object_Prot10_B_Header;
SIG_GROUP_ 165 ICM_Object_Prot10_A 1 : OBJ_Rel_Long_Acc_STD_V_10 OBJ_Relative_Long_Acc_STD_10 OBJ_Relative_Long_Acc_V_10 OBJ_Relative_Long_Acc_10 OBJ_Inv_TTC_STD_V_10 OBJ_Inv_TTC_STD_10 OBJ_Inv_TTC_V_10 OBJ_Inv_TTC_10 OBJ_Abs_Acc_STD_V_10 OBJ_Abs_Acc_STD_10 OBJ_Abs_Acceleration_V_10 OBJ_Abs_Acceleration_10 OBJ_Abs_Lat_Acc_STD_V_10 OBJ_Abs_Lat_Acc_STD_10 OBJ_Abs_Lat_Acc_V_10 OBJ_Abs_Lat_Acc_10 OBJ_Abs_Long_Acc_STD_V_10 OBJ_Abs_Long_Acc_STD_10 OBJ_Abs_Long_Acc_V_10 OBJ_Abs_Long_Acc_10 OBJ_Abs_Lat_Vel_STD_V_10 OBJ_Abs_Lat_Velocity_STD_10 OBJ_Abs_Lat_Velocity_V_10 OBJ_Abs_Lat_Velocity_10 OBJ_Abs_Long_Vel_STD_V_10 OBJ_Abs_Long_Velocity_STD_10 OBJ_Abs_Long_Velocity_V_10 OBJ_Abs_Long_Velocity_10 OBJ_Height_STD_V_10 OBJ_Height_STD_10 OBJ_Height_V_10 OBJ_Height_10 OBJ_Length_STD_V_10 OBJ_Length_STD_10 OBJ_Length_V_10 OBJ_Length_10 OBJ_Width_STD_V_10 OBJ_Width_STD_10 OBJ_Width_V_10 OBJ_Width_10 OBJ_Age_Seconds_V_10 OBJ_Age_Seconds_10 OBJ_Lane_Assignment_V_10 OBJ_Lane_Assignment_10 OBJ_Bottom_Out_Of_Image_V_10 OBJ_Top_Out_Of_Image_V_10 OBJ_Bottom_Out_Of_Image_10 OBJ_Top_Out_Of_Image_10 OBJ_Left_Out_Of_Image_V_10 OBJ_Right_Out_Of_Image_V_10 OBJ_Left_Out_Of_Image_10 OBJ_Right_Out_Of_Image_10 OBJ_Light_Indicator_Validity_10 OBJ_Turn_Indicator_Left_10 OBJ_Turn_Indicator_Right_10 OBJ_Brake_Light_10 OBJ_Has_Cut_Path_10 OBJ_Has_Cut_Lane_10 OBJ_Motion_Orientation_10 OBJ_Motion_Status_10 OBJ_Camera_Source_10 OBJ_Bike_Probability_10 OBJ_Truck_Probability_10 OBJ_Car_Probability_10 OBJ_Class_Probability_10 OBJ_Object_Class_10 OBJ_Measuring_Status_10 OBJ_Object_Age_10 OBJ_Moving_IN_Probability_10 OBJ_Motion_Category_10 OBJ_Triggered_SDM_10 OBJ_Fusion_Source_10 OBJ_Existence_Probability_10 OBJ_ID_10 OBJ_CRC_10 ICM_Object_Prot10_A_Header;
SIG_GROUP_ 164 ICM_Object_Prot9_B 1 : OBJ_Buffer_9 OBJ_Is_VeryClose_V_9 OBJ_Is_VeryClose_9 OBJ_Is_In_Drivable_Area_V_9 OBJ_Is_In_Drivable_Area_9 OBJ_Visibility_Side_9 OBJ_Visibility_Side_V_9 OBJ_Angle_Bottom_STD_V_9 OBJ_Angle_Bottom_STD_9 OBJ_Angle_Bottom_9 OBJ_Angle_Bottom_V_9 OBJ_Angle_Mid_STD_V_9 OBJ_Angle_Mid_STD_9 OBJ_Angle_Mid_9 OBJ_Angle_Mid_V_9 OBJ_Angle_Side_STD_V_9 OBJ_Angle_Side_STD_9 OBJ_Angle_Side_V_9 OBJ_Angle_Side_9 OBJ_Angle_Left_STD_V_9 OBJ_Angle_Left_STD_9 OBJ_Angle_Left_V_9 OBJ_Angle_Left_9 OBJ_Angle_Right_STD_V_9 OBJ_Angle_Right_STD_9 OBJ_Angle_Right_V_9 OBJ_Angle_Right_9 OBJ_Angle_Rate_V_9 OBJ_Angle_Rate_9 OBJ_Angle_Rate_STD_V_9 OBJ_Angle_Rate_STD_9 OBJ_Heading_STD_V_9 OBJ_Heading_STD_9 OBJ_Heading_V_9 OBJ_Heading_9 OBJ_Absolute_Speed_STD_V_9 OBJ_Absolute_Speed_STD_9 OBJ_Absolute_Speed_V_9 OBJ_Absolute_Speed_9 OBJ_Lat_Distance_STD_V_9 OBJ_Lat_Distance_STD_9 OBJ_Lat_Distance_V_9 OBJ_Lat_Distance_9 OBJ_Long_Distance_STD_V_9 OBJ_Long_Distance_STD_9 OBJ_Long_Distance_V_9 OBJ_Long_Distance_9 OBJ_Rel_Lat_Vel_STD_V_9 OBJ_Relative_Lat_Velocity_STD_9 OBJ_Relative_Lat_Velocity_V_9 OBJ_Relative_Lat_Velocity_9 OBJ_Rel_Long_Vel_STD_V_9 OBJ_Relative_Long_Vel_STD_9 OBJ_Relative_Long_Velocity_V_9 OBJ_Relative_Long_Velocity_9 ICM_Object_Prot9_B_Header;
SIG_GROUP_ 163 ICM_Object_Prot9_A 1 : OBJ_Rel_Long_Acc_STD_V_9 OBJ_Relative_Long_Acc_STD_9 OBJ_Relative_Long_Acc_V_9 OBJ_Relative_Long_Acc_9 OBJ_Inv_TTC_STD_V_9 OBJ_Inv_TTC_STD_9 OBJ_Inv_TTC_V_9 OBJ_Inv_TTC_9 OBJ_Abs_Acc_STD_V_9 OBJ_Abs_Acc_STD_9 OBJ_Abs_Acceleration_V_9 OBJ_Abs_Acceleration_9 OBJ_Abs_Lat_Acc_STD_V_9 OBJ_Abs_Lat_Acc_STD_9 OBJ_Abs_Lat_Acc_V_9 OBJ_Abs_Lat_Acc_9 OBJ_Abs_Long_Acc_STD_V_9 OBJ_Abs_Long_Acc_STD_9 OBJ_Abs_Long_Acc_V_9 OBJ_Abs_Long_Acc_9 OBJ_Abs_Lat_Vel_STD_V_9 OBJ_Abs_Lat_Velocity_STD_9 OBJ_Abs_Lat_Velocity_V_9 OBJ_Abs_Lat_Velocity_9 OBJ_Abs_Long_Vel_STD_V_9 OBJ_Abs_Long_Velocity_STD_9 OBJ_Abs_Long_Velocity_V_9 OBJ_Abs_Long_Velocity_9 OBJ_Height_STD_V_9 OBJ_Height_STD_9 OBJ_Height_V_9 OBJ_Height_9 OBJ_Length_STD_V_9 OBJ_Length_STD_9 OBJ_Length_V_9 OBJ_Length_9 OBJ_Width_STD_V_9 OBJ_Width_STD_9 OBJ_Width_V_9 OBJ_Width_9 OBJ_Age_Seconds_V_9 OBJ_Age_Seconds_9 OBJ_Lane_Assignment_V_9 OBJ_Lane_Assignment_9 OBJ_Bottom_Out_Of_Image_V_9 OBJ_Top_Out_Of_Image_V_9 OBJ_Bottom_Out_Of_Image_9 OBJ_Top_Out_Of_Image_9 OBJ_Left_Out_Of_Image_V_9 OBJ_Right_Out_Of_Image_V_9 OBJ_Left_Out_Of_Image_9 OBJ_Right_Out_Of_Image_9 OBJ_Light_Indicator_Validity_9 OBJ_Turn_Indicator_Left_9 OBJ_Turn_Indicator_Right_9 OBJ_Brake_Light_9 OBJ_Has_Cut_Path_9 OBJ_Has_Cut_Lane_9 OBJ_Motion_Orientation_9 OBJ_Motion_Status_9 OBJ_Camera_Source_9 OBJ_Bike_Probability_9 OBJ_Truck_Probability_9 OBJ_Car_Probability_9 OBJ_Class_Probability_9 OBJ_Object_Class_9 OBJ_Measuring_Status_9 OBJ_Object_Age_9 OBJ_Moving_IN_Probability_9 OBJ_Motion_Category_9 OBJ_Triggered_SDM_9 OBJ_Fusion_Source_9 OBJ_Existence_Probability_9 OBJ_ID_9 OBJ_CRC_9 ICM_Object_Prot9_A_Header;
SIG_GROUP_ 162 ICM_Object_Prot8_B 1 : OBJ_Buffer_8 OBJ_Is_VeryClose_V_8 OBJ_Is_VeryClose_8 OBJ_Is_In_Drivable_Area_V_8 OBJ_Is_In_Drivable_Area_8 OBJ_Visibility_Side_8 OBJ_Visibility_Side_V_8 OBJ_Angle_Bottom_STD_V_8 OBJ_Angle_Bottom_STD_8 OBJ_Angle_Bottom_8 OBJ_Angle_Bottom_V_8 OBJ_Angle_Mid_STD_V_8 OBJ_Angle_Mid_STD_8 OBJ_Angle_Mid_8 OBJ_Angle_Mid_V_8 OBJ_Angle_Side_STD_V_8 OBJ_Angle_Side_STD_8 OBJ_Angle_Side_V_8 OBJ_Angle_Side_8 OBJ_Angle_Left_STD_V_8 OBJ_Angle_Left_STD_8 OBJ_Angle_Left_V_8 OBJ_Angle_Left_8 OBJ_Angle_Right_STD_V_8 OBJ_Angle_Right_STD_8 OBJ_Angle_Right_V_8 OBJ_Angle_Right_8 OBJ_Angle_Rate_V_8 OBJ_Angle_Rate_8 OBJ_Angle_Rate_STD_V_8 OBJ_Angle_Rate_STD_8 OBJ_Heading_STD_V_8 OBJ_Heading_STD_8 OBJ_Heading_V_8 OBJ_Heading_8 OBJ_Absolute_Speed_STD_V_8 OBJ_Absolute_Speed_STD_8 OBJ_Absolute_Speed_V_8 OBJ_Absolute_Speed_8 OBJ_Lat_Distance_STD_V_8 OBJ_Lat_Distance_STD_8 OBJ_Lat_Distance_V_8 OBJ_Lat_Distance_8 OBJ_Long_Distance_STD_V_8 OBJ_Long_Distance_STD_8 OBJ_Long_Distance_V_8 OBJ_Long_Distance_8 OBJ_Rel_Lat_Vel_STD_V_8 OBJ_Relative_Lat_Velocity_STD_8 OBJ_Relative_Lat_Velocity_V_8 OBJ_Relative_Lat_Velocity_8 OBJ_Rel_Long_Vel_STD_V_8 OBJ_Relative_Long_Vel_STD_8 OBJ_Relative_Long_Velocity_V_8 OBJ_Relative_Long_Velocity_8 ICM_Object_Prot8_B_Header;
SIG_GROUP_ 161 ICM_Object_Prot8_A 1 : OBJ_Rel_Long_Acc_STD_V_8 OBJ_Relative_Long_Acc_STD_8 OBJ_Relative_Long_Acc_V_8 OBJ_Relative_Long_Acc_8 OBJ_Inv_TTC_STD_V_8 OBJ_Inv_TTC_STD_8 OBJ_Inv_TTC_V_8 OBJ_Inv_TTC_8 OBJ_Abs_Acc_STD_V_8 OBJ_Abs_Acc_STD_8 OBJ_Abs_Acceleration_V_8 OBJ_Abs_Acceleration_8 OBJ_Abs_Lat_Acc_STD_V_8 OBJ_Abs_Lat_Acc_STD_8 OBJ_Abs_Lat_Acc_V_8 OBJ_Abs_Lat_Acc_8 OBJ_Abs_Long_Acc_STD_V_8 OBJ_Abs_Long_Acc_STD_8 OBJ_Abs_Long_Acc_V_8 OBJ_Abs_Long_Acc_8 OBJ_Abs_Lat_Vel_STD_V_8 OBJ_Abs_Lat_Velocity_STD_8 OBJ_Abs_Lat_Velocity_V_8 OBJ_Abs_Lat_Velocity_8 OBJ_Abs_Long_Vel_STD_V_8 OBJ_Abs_Long_Velocity_STD_8 OBJ_Abs_Long_Velocity_V_8 OBJ_Abs_Long_Velocity_8 OBJ_Height_STD_V_8 OBJ_Height_STD_8 OBJ_Height_V_8 OBJ_Height_8 OBJ_Length_STD_V_8 OBJ_Length_STD_8 OBJ_Length_V_8 OBJ_Length_8 OBJ_Width_STD_V_8 OBJ_Width_STD_8 OBJ_Width_V_8 OBJ_Width_8 OBJ_Age_Seconds_V_8 OBJ_Age_Seconds_8 OBJ_Lane_Assignment_V_8 OBJ_Lane_Assignment_8 OBJ_Bottom_Out_Of_Image_V_8 OBJ_Top_Out_Of_Image_V_8 OBJ_Bottom_Out_Of_Image_8 OBJ_Top_Out_Of_Image_8 OBJ_Left_Out_Of_Image_V_8 OBJ_Right_Out_Of_Image_V_8 OBJ_Left_Out_Of_Image_8 OBJ_Right_Out_Of_Image_8 OBJ_Light_Indicator_Validity_8 OBJ_Turn_Indicator_Left_8 OBJ_Turn_Indicator_Right_8 OBJ_Brake_Light_8 OBJ_Has_Cut_Path_8 OBJ_Has_Cut_Lane_8 OBJ_Motion_Orientation_8 OBJ_Motion_Status_8 OBJ_Camera_Source_8 OBJ_Bike_Probability_8 OBJ_Truck_Probability_8 OBJ_Car_Probability_8 OBJ_Class_Probability_8 OBJ_Object_Class_8 OBJ_Measuring_Status_8 OBJ_Object_Age_8 OBJ_Moving_IN_Probability_8 OBJ_Motion_Category_8 OBJ_Triggered_SDM_8 OBJ_Fusion_Source_8 OBJ_Existence_Probability_8 OBJ_ID_8 OBJ_CRC_8 ICM_Object_Prot8_A_Header;
SIG_GROUP_ 160 ICM_Object_Prot7_B 1 : OBJ_Buffer_7 OBJ_Is_VeryClose_V_7 OBJ_Is_VeryClose_7 OBJ_Is_In_Drivable_Area_V_7 OBJ_Is_In_Drivable_Area_7 OBJ_Visibility_Side_7 OBJ_Visibility_Side_V_7 OBJ_Angle_Bottom_STD_V_7 OBJ_Angle_Bottom_STD_7 OBJ_Angle_Bottom_7 OBJ_Angle_Bottom_V_7 OBJ_Angle_Mid_STD_V_7 OBJ_Angle_Mid_STD_7 OBJ_Angle_Mid_7 OBJ_Angle_Mid_V_7 OBJ_Angle_Side_STD_V_7 OBJ_Angle_Side_STD_7 OBJ_Angle_Side_V_7 OBJ_Angle_Side_7 OBJ_Angle_Left_STD_V_7 OBJ_Angle_Left_STD_7 OBJ_Angle_Left_V_7 OBJ_Angle_Left_7 OBJ_Angle_Right_STD_V_7 OBJ_Angle_Right_STD_7 OBJ_Angle_Right_V_7 OBJ_Angle_Right_7 OBJ_Angle_Rate_V_7 OBJ_Angle_Rate_7 OBJ_Angle_Rate_STD_V_7 OBJ_Angle_Rate_STD_7 OBJ_Heading_STD_V_7 OBJ_Heading_STD_7 OBJ_Heading_V_7 OBJ_Heading_7 OBJ_Absolute_Speed_STD_V_7 OBJ_Absolute_Speed_STD_7 OBJ_Absolute_Speed_V_7 OBJ_Absolute_Speed_7 OBJ_Lat_Distance_STD_V_7 OBJ_Lat_Distance_STD_7 OBJ_Lat_Distance_V_7 OBJ_Lat_Distance_7 OBJ_Long_Distance_STD_V_7 OBJ_Long_Distance_STD_7 OBJ_Long_Distance_V_7 OBJ_Long_Distance_7 OBJ_Rel_Lat_Vel_STD_V_7 OBJ_Relative_Lat_Velocity_STD_7 OBJ_Relative_Lat_Velocity_V_7 OBJ_Relative_Lat_Velocity_7 OBJ_Rel_Long_Vel_STD_V_7 OBJ_Relative_Long_Vel_STD_7 OBJ_Relative_Long_Velocity_V_7 OBJ_Relative_Long_Velocity_7 ICM_Object_Prot7_B_Header;
SIG_GROUP_ 159 ICM_Object_Prot7_A 1 : OBJ_Rel_Long_Acc_STD_V_7 OBJ_Relative_Long_Acc_STD_7 OBJ_Relative_Long_Acc_V_7 OBJ_Relative_Long_Acc_7 OBJ_Inv_TTC_STD_V_7 OBJ_Inv_TTC_STD_7 OBJ_Inv_TTC_V_7 OBJ_Inv_TTC_7 OBJ_Abs_Acc_STD_V_7 OBJ_Abs_Acc_STD_7 OBJ_Abs_Acceleration_V_7 OBJ_Abs_Acceleration_7 OBJ_Abs_Lat_Acc_STD_V_7 OBJ_Abs_Lat_Acc_STD_7 OBJ_Abs_Lat_Acc_V_7 OBJ_Abs_Lat_Acc_7 OBJ_Abs_Long_Acc_STD_V_7 OBJ_Abs_Long_Acc_STD_7 OBJ_Abs_Long_Acc_V_7 OBJ_Abs_Long_Acc_7 OBJ_Abs_Lat_Vel_STD_V_7 OBJ_Abs_Lat_Velocity_STD_7 OBJ_Abs_Lat_Velocity_V_7 OBJ_Abs_Lat_Velocity_7 OBJ_Abs_Long_Vel_STD_V_7 OBJ_Abs_Long_Velocity_STD_7 OBJ_Abs_Long_Velocity_V_7 OBJ_Abs_Long_Velocity_7 OBJ_Height_STD_V_7 OBJ_Height_STD_7 OBJ_Height_V_7 OBJ_Height_7 OBJ_Length_STD_V_7 OBJ_Length_STD_7 OBJ_Length_V_7 OBJ_Length_7 OBJ_Width_STD_V_7 OBJ_Width_STD_7 OBJ_Width_V_7 OBJ_Width_7 OBJ_Age_Seconds_V_7 OBJ_Age_Seconds_7 OBJ_Lane_Assignment_V_7 OBJ_Lane_Assignment_7 OBJ_Bottom_Out_Of_Image_V_7 OBJ_Top_Out_Of_Image_V_7 OBJ_Bottom_Out_Of_Image_7 OBJ_Top_Out_Of_Image_7 OBJ_Left_Out_Of_Image_V_7 OBJ_Right_Out_Of_Image_V_7 OBJ_Left_Out_Of_Image_7 OBJ_Right_Out_Of_Image_7 OBJ_Light_Indicator_Validity_7 OBJ_Turn_Indicator_Left_7 OBJ_Turn_Indicator_Right_7 OBJ_Brake_Light_7 OBJ_Has_Cut_Path_7 OBJ_Has_Cut_Lane_7 OBJ_Motion_Orientation_7 OBJ_Motion_Status_7 OBJ_Camera_Source_7 OBJ_Bike_Probability_7 OBJ_Truck_Probability_7 OBJ_Car_Probability_7 OBJ_Class_Probability_7 OBJ_Object_Class_7 OBJ_Measuring_Status_7 OBJ_Object_Age_7 OBJ_Moving_IN_Probability_7 OBJ_Motion_Category_7 OBJ_Triggered_SDM_7 OBJ_Fusion_Source_7 OBJ_Existence_Probability_7 OBJ_ID_7 OBJ_CRC_7 ICM_Object_Prot7_A_Header;
SIG_GROUP_ 158 ICM_Object_Prot6_B 1 : OBJ_Buffer_6 OBJ_Is_VeryClose_V_6 OBJ_Is_VeryClose_6 OBJ_Is_In_Drivable_Area_V_6 OBJ_Is_In_Drivable_Area_6 OBJ_Visibility_Side_6 OBJ_Visibility_Side_V_6 OBJ_Angle_Bottom_STD_V_6 OBJ_Angle_Bottom_STD_6 OBJ_Angle_Bottom_6 OBJ_Angle_Bottom_V_6 OBJ_Angle_Mid_STD_V_6 OBJ_Angle_Mid_STD_6 OBJ_Angle_Mid_6 OBJ_Angle_Mid_V_6 OBJ_Angle_Side_STD_V_6 OBJ_Angle_Side_STD_6 OBJ_Angle_Side_V_6 OBJ_Angle_Side_6 OBJ_Angle_Left_STD_V_6 OBJ_Angle_Left_STD_6 OBJ_Angle_Left_V_6 OBJ_Angle_Left_6 OBJ_Angle_Right_STD_V_6 OBJ_Angle_Right_STD_6 OBJ_Angle_Right_V_6 OBJ_Angle_Right_6 OBJ_Angle_Rate_V_6 OBJ_Angle_Rate_6 OBJ_Angle_Rate_STD_V_6 OBJ_Angle_Rate_STD_6 OBJ_Heading_STD_V_6 OBJ_Heading_STD_6 OBJ_Heading_V_6 OBJ_Heading_6 OBJ_Absolute_Speed_STD_V_6 OBJ_Absolute_Speed_STD_6 OBJ_Absolute_Speed_V_6 OBJ_Absolute_Speed_6 OBJ_Lat_Distance_STD_V_6 OBJ_Lat_Distance_STD_6 OBJ_Lat_Distance_V_6 OBJ_Lat_Distance_6 OBJ_Long_Distance_STD_V_6 OBJ_Long_Distance_STD_6 OBJ_Long_Distance_V_6 OBJ_Long_Distance_6 OBJ_Rel_Lat_Vel_STD_V_6 OBJ_Relative_Lat_Velocity_STD_6 OBJ_Relative_Lat_Velocity_V_6 OBJ_Relative_Lat_Velocity_6 OBJ_Rel_Long_Vel_STD_V_6 OBJ_Relative_Long_Vel_STD_6 OBJ_Relative_Long_Velocity_V_6 OBJ_Relative_Long_Velocity_6 ICM_Object_Prot6_B_Header;
SIG_GROUP_ 157 ICM_Object_Prot6_A 1 : OBJ_Rel_Long_Acc_STD_V_6 OBJ_Relative_Long_Acc_STD_6 OBJ_Relative_Long_Acc_V_6 OBJ_Relative_Long_Acc_6 OBJ_Inv_TTC_STD_V_6 OBJ_Inv_TTC_STD_6 OBJ_Inv_TTC_V_6 OBJ_Inv_TTC_6 OBJ_Abs_Acc_STD_V_6 OBJ_Abs_Acc_STD_6 OBJ_Abs_Acceleration_V_6 OBJ_Abs_Acceleration_6 OBJ_Abs_Lat_Acc_STD_V_6 OBJ_Abs_Lat_Acc_STD_6 OBJ_Abs_Lat_Acc_V_6 OBJ_Abs_Lat_Acc_6 OBJ_Abs_Long_Acc_STD_V_6 OBJ_Abs_Long_Acc_STD_6 OBJ_Abs_Long_Acc_V_6 OBJ_Abs_Long_Acc_6 OBJ_Abs_Lat_Vel_STD_V_6 OBJ_Abs_Lat_Velocity_STD_6 OBJ_Abs_Lat_Velocity_V_6 OBJ_Abs_Lat_Velocity_6 OBJ_Abs_Long_Vel_STD_V_6 OBJ_Abs_Long_Velocity_STD_6 OBJ_Abs_Long_Velocity_V_6 OBJ_Abs_Long_Velocity_6 OBJ_Height_STD_V_6 OBJ_Height_STD_6 OBJ_Height_V_6 OBJ_Height_6 OBJ_Length_STD_V_6 OBJ_Length_STD_6 OBJ_Length_V_6 OBJ_Length_6 OBJ_Width_STD_V_6 OBJ_Width_STD_6 OBJ_Width_V_6 OBJ_Width_6 OBJ_Age_Seconds_V_6 OBJ_Age_Seconds_6 OBJ_Lane_Assignment_V_6 OBJ_Lane_Assignment_6 OBJ_Bottom_Out_Of_Image_V_6 OBJ_Top_Out_Of_Image_V_6 OBJ_Bottom_Out_Of_Image_6 OBJ_Top_Out_Of_Image_6 OBJ_Left_Out_Of_Image_V_6 OBJ_Right_Out_Of_Image_V_6 OBJ_Left_Out_Of_Image_6 OBJ_Right_Out_Of_Image_6 OBJ_Light_Indicator_Validity_6 OBJ_Turn_Indicator_Left_6 OBJ_Turn_Indicator_Right_6 OBJ_Brake_Light_6 OBJ_Has_Cut_Path_6 OBJ_Has_Cut_Lane_6 OBJ_Motion_Orientation_6 OBJ_Motion_Status_6 OBJ_Camera_Source_6 OBJ_Bike_Probability_6 OBJ_Truck_Probability_6 OBJ_Car_Probability_6 OBJ_Class_Probability_6 OBJ_Object_Class_6 OBJ_Measuring_Status_6 OBJ_Object_Age_6 OBJ_Moving_IN_Probability_6 OBJ_Motion_Category_6 OBJ_Triggered_SDM_6 OBJ_Fusion_Source_6 OBJ_Existence_Probability_6 OBJ_ID_6 OBJ_CRC_6 ICM_Object_Prot6_A_Header;
