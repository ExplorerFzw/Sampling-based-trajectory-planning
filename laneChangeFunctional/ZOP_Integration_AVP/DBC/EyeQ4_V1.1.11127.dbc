VERSION "3"

NS_ :

BS_:

BU_: MyECU ACM

BO_ 216 ICM_Object_Prot35_B: 64 MyECU
 SG_ ICM_Object_Prot35_B_Header : 0|16@1+ (1,0) [0|65535] ""  ACM
 SG_ OBJ_Relative_Long_Velocity_35 : 16|13@1+ (0.05,-120) [-120|130] "MPS"  ACM
 SG_ OBJ_Relative_Long_Velocity_V_35 : 29|1@1+ (1,0) [0|1] "bool"  ACM
 SG_ OBJ_Relative_Long_Vel_STD_35 : 30|12@1+ (0.05,0) [0|130] "MPS"  ACM
 SG_ OBJ_Rel_Long_Vel_STD_V_35 : 42|1@1+ (1,0) [0|1] "bool"  ACM
 SG_ OBJ_Relative_Lat_Velocity_35 : 48|11@1+ (0.05,-50) [-50|50] "MPS"  ACM
 SG_ OBJ_Relative_Lat_Velocity_V_35 : 59|1@1+ (1,0) [0|1] "bool"  ACM
 SG_ OBJ_Relative_Lat_Velocity_STD_35 : 60|10@1+ (0.05,0) [0|50] "MPS"  ACM
 SG_ OBJ_Rel_Lat_Vel_STD_V_35 : 70|1@1+ (1,0) [0|1] "bool"  ACM
 SG_ OBJ_Long_Distance_35 : 80|14@1+ (0.05,-200) [-200|250] "m"  ACM
 SG_ OBJ_Long_Distance_V_35 : 94|1@1+ (1,0) [0|1] "bool"  ACM
 SG_ OBJ_Long_Distance_STD_35 : 95|13@1+ (0.05,0) [0|250] "m"  ACM
 SG_ OBJ_Long_Distance_STD_V_35 : 108|1@1+ (1,0) [0|1] "bool"  ACM
 SG_ OBJ_Lat_Distance_35 : 112|12@1+ (0.05,-100) [-100|100] "m"  ACM
 SG_ OBJ_Lat_Distance_V_35 : 124|1@1+ (1,0) [0|1] "bool"  ACM
 SG_ OBJ_Lat_Distance_STD_35 : 125|11@1+ (0.05,0) [0|100] "m"  ACM
 SG_ OBJ_Lat_Distance_STD_V_35 : 136|1@1+ (1,0) [0|1] "bool"  ACM
 SG_ OBJ_Absolute_Speed_35 : 144|12@1+ (0.05,-65) [-65|65] "MPS"  ACM
 SG_ OBJ_Absolute_Speed_V_35 : 156|1@1+ (1,0) [0|1] "bool"  ACM
 SG_ OBJ_Absolute_Speed_STD_35 : 157|11@1+ (0.05,-65) [0|65] "MPS"  ACM
 SG_ OBJ_Absolute_Speed_STD_V_35 : 168|1@1+ (1,0) [0|1] "bool"  ACM
 SG_ OBJ_Heading_35 : 176|10@1+ (0.01,-3.14) [-3.14|3.14] "rad"  ACM
 SG_ OBJ_Heading_V_35 : 186|1@1+ (1,0) [0|1] "bool"  ACM
 SG_ OBJ_Heading_STD_35 : 187|9@1+ (0.01,0) [0|3.14] "rad"  ACM
 SG_ OBJ_Heading_STD_V_35 : 196|1@1+ (1,0) [0|1] "bool"  ACM
 SG_ OBJ_Angle_Rate_STD_35 : 197|11@1+ (0.002,0) [0|2.2318] "RPS"  ACM
 SG_ OBJ_Angle_Rate_STD_V_35 : 208|1@1+ (1,0) [0|1] "bool"  ACM
 SG_ OBJ_Angle_Rate_35 : 209|12@1+ (0.002,-2.234) [-2.234|2.2318] "RPS"  ACM
 SG_ OBJ_Angle_Rate_V_35 : 221|1@1+ (1,0) [0|1] "bool"  ACM
 SG_ OBJ_Angle_Right_35 : 222|14@1+ (0.0002,-1.571) [-1.571|1.571] "rad "  ACM
 SG_ OBJ_Angle_Right_V_35 : 236|1@1+ (1,0) [0|1] "bool"  ACM
 SG_ OBJ_Angle_Right_STD_35 : 240|13@1+ (0.0002,0) [0|1.571] "rad "  ACM
 SG_ OBJ_Angle_Right_STD_V_35 : 253|1@1+ (1,0) [0|1] "bool"  ACM
 SG_ OBJ_Angle_Left_35 : 254|14@1+ (0.0002,-1.571) [-1.571|1.571] "rad "  ACM
 SG_ OBJ_Angle_Left_V_35 : 268|1@1+ (1,0) [0|1] "bool"  ACM
 SG_ OBJ_Angle_Left_STD_35 : 272|13@1+ (0.0002,0) [0|1.571] "rad"  ACM
 SG_ OBJ_Angle_Left_STD_V_35 : 285|1@1+ (1,0) [0|1] "bool"  ACM
 SG_ OBJ_Angle_Side_35 : 286|14@1+ (0.0002,-1.571) [-1.571|1.571] "rad"  ACM
 SG_ OBJ_Angle_Side_V_35 : 300|1@1+ (1,0) [0|1] "bool"  ACM
 SG_ OBJ_Angle_Side_STD_35 : 304|13@1+ (0.0002,0) [0|1.571] "rad"  ACM
 SG_ OBJ_Angle_Side_STD_V_35 : 317|1@1+ (1,0) [0|1] "bool"  ACM
 SG_ OBJ_Angle_Mid_V_35 : 318|1@1+ (1,0) [0|1] "bool"  ACM
 SG_ OBJ_Angle_Mid_35 : 319|14@1+ (0.0002,-1.571) [-1.571|1.571] "rad"  ACM
 SG_ OBJ_Angle_Mid_STD_35 : 336|13@1+ (0.0002,0) [0|1.571] "rad"  ACM
 SG_ OBJ_Angle_Mid_STD_V_35 : 349|1@1+ (1,0) [0|1] "bool"  ACM
 SG_ OBJ_Angle_Bottom_V_35 : 350|1@1+ (1,0) [0|1] "bool"  ACM
 SG_ OBJ_Angle_Bottom_35 : 351|14@1+ (0.0002,-1.571) [-1.571|1.571] "rad"  ACM
 SG_ OBJ_Angle_Bottom_STD_35 : 368|13@1+ (0.0002,0) [0|1.571] "rad"  ACM
 SG_ OBJ_Angle_Bottom_STD_V_35 : 381|1@1+ (1,0) [0|1] "bool"  ACM
 SG_ OBJ_Visibility_Side_V_35 : 382|1@1+ (1,0) [0|1] "bool"  ACM
 SG_ OBJ_Visibility_Side_35 : 383|2@1+ (1,0) [0|2] "ENUM"  ACM
 SG_ OBJ_Is_In_Drivable_Area_35 : 385|1@1+ (1,0) [0|1] "bool"  ACM
 SG_ OBJ_Is_In_Drivable_Area_V_35 : 386|1@1+ (1,0) [0|1] "bool"  ACM
 SG_ OBJ_Is_VeryClose_35 : 387|1@1+ (1,0) [0|1] "bool"  ACM
 SG_ OBJ_Is_VeryClose_V_35 : 388|1@1+ (1,0) [0|1] "bool"  ACM
 SG_ OBJ_Buffer_35 : 389|11@1+ (1,0) [0|0] "NA"  ACM

BO_ 215 ICM_Object_Prot35_A: 64 MyECU
 SG_ ICM_Object_Prot35_A_Header : 0|16@1+ (1,0) [0|65535] ""  ACM
 SG_ OBJ_CRC_35 : 16|32@1+ (1,0) [0|4294967295] "NA"  ACM
 SG_ OBJ_ID_35 : 48|8@1+ (1,0) [0|255] "NA"  ACM
 SG_ OBJ_Existence_Probability_35 : 56|8@1+ (0.01,0) [0|1] "NA"  ACM
 SG_ OBJ_Fusion_Source_35 : 64|16@1+ (1,0) [0|65535] "BITWIZE"  ACM
 SG_ OBJ_Triggered_SDM_35 : 80|2@1+ (1,0) [0|2] "ENUM"  ACM
 SG_ OBJ_Motion_Category_35 : 82|4@1+ (1,0) [0|13] "ENUM "  ACM
 SG_ OBJ_Moving_IN_Probability_35 : 86|7@1+ (0.01,0) [0|0] "NA"  ACM
 SG_ OBJ_Object_Age_35 : 93|11@1+ (1,0) [0|2047] "Frame"  ACM
 SG_ OBJ_Measuring_Status_35 : 104|3@1+ (1,0) [0|7] "BITWIZE"  ACM
 SG_ OBJ_Object_Class_35 : 107|4@1+ (1,0) [0|8] "ENUM"  ACM
 SG_ OBJ_Class_Probability_35 : 112|7@1+ (0.01,0) [0|1] "NA"  ACM
 SG_ OBJ_Car_Probability_35 : 119|7@1+ (0.01,0) [0|0] "NA"  ACM
 SG_ OBJ_Truck_Probability_35 : 126|7@1+ (0.01,0) [0|0] "NA"  ACM
 SG_ OBJ_Bike_Probability_35 : 133|7@1+ (0.01,0) [0|0] "NA"  ACM
 SG_ OBJ_Camera_Source_35 : 140|4@1+ (1,0) [0|15] "ENUM"  ACM
 SG_ OBJ_Motion_Status_35 : 144|3@1+ (1,0) [0|5] "ENUM "  ACM
 SG_ OBJ_Motion_Orientation_35 : 147|4@1+ (1,0) [0|13] "ENUM "  ACM
 SG_ OBJ_Has_Cut_Lane_35 : 151|1@1+ (1,0) [0|1] "bool"  ACM
 SG_ OBJ_Has_Cut_Path_35 : 152|1@1+ (1,0) [0|1] "bool"  ACM
 SG_ OBJ_Brake_Light_35 : 153|1@1+ (1,0) [0|1] "bool"  ACM
 SG_ OBJ_Turn_Indicator_Right_35 : 154|1@1+ (1,0) [0|1] "bool"  ACM
 SG_ OBJ_Turn_Indicator_Left_35 : 155|1@1+ (1,0) [0|1] "bool"  ACM
 SG_ OBJ_Light_Indicator_Validity_35 : 156|1@1+ (1,0) [0|1] "bool"  ACM
 SG_ OBJ_Right_Out_Of_Image_35 : 157|1@1+ (1,0) [0|1] "bool"  ACM
 SG_ OBJ_Left_Out_Of_Image_35 : 158|1@1+ (1,0) [0|1] "bool"  ACM
 SG_ OBJ_Right_Out_Of_Image_V_35 : 159|1@1+ (1,0) [0|1] "bool"  ACM
 SG_ OBJ_Left_Out_Of_Image_V_35 : 160|1@1+ (1,0) [0|1] "bool"  ACM
 SG_ OBJ_Top_Out_Of_Image_35 : 161|1@1+ (1,0) [0|1] "bool"  ACM
 SG_ OBJ_Bottom_Out_Of_Image_35 : 162|1@1+ (1,0) [0|1] "bool"  ACM
 SG_ OBJ_Top_Out_Of_Image_V_35 : 163|1@1+ (1,0) [0|1] "bool"  ACM
 SG_ OBJ_Bottom_Out_Of_Image_V_35 : 164|1@1+ (1,0) [0|1] "bool"  ACM
 SG_ OBJ_Lane_Assignment_35 : 165|3@1+ (1,0) [0|5] "ENUM"  ACM
 SG_ OBJ_Lane_Assignment_V_35 : 168|1@1+ (1,0) [0|1] "bool"  ACM
 SG_ OBJ_Age_Seconds_35 : 169|7@1+ (1,0) [0|100] "s"  ACM
 SG_ OBJ_Age_Seconds_V_35 : 176|1@1+ (1,0) [0|1] "bool"  ACM
 SG_ OBJ_Width_35 : 177|9@1+ (0.01,0) [0.4|2.95] "m"  ACM
 SG_ OBJ_Width_V_35 : 186|1@1+ (1,0) [0|1] "bool"  ACM
 SG_ OBJ_Width_STD_35 : 187|8@1+ (0.01,0) [0|2] "m"  ACM
 SG_ OBJ_Width_STD_V_35 : 195|1@1+ (1,0) [0|1] "bool"  ACM
 SG_ OBJ_Length_35 : 196|9@1+ (0.05,0) [1.2|21] "m"  ACM
 SG_ OBJ_Length_V_35 : 205|1@1+ (1,0) [0|1] "bool"  ACM
 SG_ OBJ_Length_STD_35 : 208|8@1+ (0.05,0) [0|10] "m"  ACM
 SG_ OBJ_Length_STD_V_35 : 216|1@1+ (1,0) [0|1] "bool"  ACM
 SG_ OBJ_Height_35 : 217|9@1+ (0.01,0) [0|2.95] "m"  ACM
 SG_ OBJ_Height_V_35 : 226|1@1+ (1,0) [0|1] "bool"  ACM
 SG_ OBJ_Height_STD_35 : 227|8@1+ (0.01,0) [0|2] "m"  ACM
 SG_ OBJ_Height_STD_V_35 : 235|1@1+ (1,0) [0|1] "bool"  ACM
 SG_ OBJ_Abs_Long_Velocity_35 : 240|12@1+ (0.05,-30) [-30|100] "MPS"  ACM
 SG_ OBJ_Abs_Long_Velocity_V_35 : 252|1@1+ (1,0) [0|1] "bool"  ACM
 SG_ OBJ_Abs_Long_Velocity_STD_35 : 253|11@1+ (0.05,0) [0|65] "MPS"  ACM
 SG_ OBJ_Abs_Long_Vel_STD_V_35 : 264|1@1+ (1,0) [0|1] "bool"  ACM
 SG_ OBJ_Abs_Lat_Velocity_35 : 272|11@1+ (0.05,-50) [-50|50] "MPS"  ACM
 SG_ OBJ_Abs_Lat_Velocity_V_35 : 283|1@1+ (1,0) [0|1] "bool"  ACM
 SG_ OBJ_Abs_Lat_Velocity_STD_35 : 284|10@1+ (0.05,0) [0|50] "MPS"  ACM
 SG_ OBJ_Abs_Lat_Vel_STD_V_35 : 294|1@1+ (1,0) [0|1] "bool"  ACM
 SG_ OBJ_Abs_Long_Acc_35 : 295|9@1+ (0.05,-10.3) [-10.3|7.3] "MPS2"  ACM
 SG_ OBJ_Abs_Long_Acc_V_35 : 304|1@1+ (1,0) [0|1] "bool"  ACM
 SG_ OBJ_Abs_Long_Acc_STD_35 : 305|8@1+ (0.05,0) [0|7.3] "MPS2"  ACM
 SG_ OBJ_Abs_Long_Acc_STD_V_35 : 313|1@1+ (1,0) [0|1] "bool"  ACM
 SG_ OBJ_Abs_Lat_Acc_35 : 314|9@1+ (0.05,-10.3) [-10.3|7.3] "MPS2"  ACM
 SG_ OBJ_Abs_Lat_Acc_V_35 : 323|1@1+ (1,0) [0|1] "bool"  ACM
 SG_ OBJ_Abs_Lat_Acc_STD_35 : 324|8@1+ (0.05,0) [0|7.3] "MPS2"  ACM
 SG_ OBJ_Abs_Lat_Acc_STD_V_35 : 332|1@1+ (1,0) [0|1] "bool"  ACM
 SG_ OBJ_Abs_Acceleration_35 : 336|9@1+ (0.05,-10.3) [-10.3|7.3] "MPS2"  ACM
 SG_ OBJ_Abs_Acceleration_V_35 : 345|1@1+ (1,0) [0|1] "bool"  ACM
 SG_ OBJ_Abs_Acc_STD_35 : 346|8@1+ (0.05,0) [0|7.3] "MPS2"  ACM
 SG_ OBJ_Abs_Acc_STD_V_35 : 354|1@1+ (1,0) [0|1] "bool"  ACM
 SG_ OBJ_Inv_TTC_35 : 355|11@1+ (0.01,-8) [-8|8] "INV(s)"  ACM
 SG_ OBJ_Inv_TTC_V_35 : 366|1@1+ (1,0) [0|1] "bool"  ACM
 SG_ OBJ_Inv_TTC_STD_35 : 368|11@1+ (0.01,0) [0|4] "INV(s)"  ACM
 SG_ OBJ_Inv_TTC_STD_V_35 : 379|1@1+ (1,0) [0|1] "bool"  ACM
 SG_ OBJ_Relative_Long_Acc_35 : 380|9@1+ (0.05,-10.3) [-10.3|7.3] "MPS2"  ACM
 SG_ OBJ_Relative_Long_Acc_V_35 : 389|1@1+ (1,0) [0|1] "bool"  ACM
 SG_ OBJ_Relative_Long_Acc_STD_35 : 390|8@1+ (0.05,0) [0|7.3] "MPS2"  ACM
 SG_ OBJ_Rel_Long_Acc_STD_V_35 : 398|1@1+ (1,0) [0|1] "bool"  ACM

BO_ 214 ICM_Object_Prot34_B: 64 MyECU
 SG_ ICM_Object_Prot34_B_Header : 0|16@1+ (1,0) [0|65535] ""  ACM
 SG_ OBJ_Relative_Long_Velocity_34 : 16|13@1+ (0.05,-120) [-120|130] "MPS"  ACM
 SG_ OBJ_Relative_Long_Velocity_V_34 : 29|1@1+ (1,0) [0|1] "bool"  ACM
 SG_ OBJ_Relative_Long_Vel_STD_34 : 30|12@1+ (0.05,0) [0|130] "MPS"  ACM
 SG_ OBJ_Rel_Long_Vel_STD_V_34 : 42|1@1+ (1,0) [0|1] "bool"  ACM
 SG_ OBJ_Relative_Lat_Velocity_34 : 48|11@1+ (0.05,-50) [-50|50] "MPS"  ACM
 SG_ OBJ_Relative_Lat_Velocity_V_34 : 59|1@1+ (1,0) [0|1] "bool"  ACM
 SG_ OBJ_Relative_Lat_Velocity_STD_34 : 60|10@1+ (0.05,0) [0|50] "MPS"  ACM
 SG_ OBJ_Rel_Lat_Vel_STD_V_34 : 70|1@1+ (1,0) [0|1] "bool"  ACM
 SG_ OBJ_Long_Distance_34 : 80|14@1+ (0.05,-200) [-200|250] "m"  ACM
 SG_ OBJ_Long_Distance_V_34 : 94|1@1+ (1,0) [0|1] "bool"  ACM
 SG_ OBJ_Long_Distance_STD_34 : 95|13@1+ (0.05,0) [0|250] "m"  ACM
 SG_ OBJ_Long_Distance_STD_V_34 : 108|1@1+ (1,0) [0|1] "bool"  ACM
 SG_ OBJ_Lat_Distance_34 : 112|12@1+ (0.05,-100) [-100|100] "m"  ACM
 SG_ OBJ_Lat_Distance_V_34 : 124|1@1+ (1,0) [0|1] "bool"  ACM
 SG_ OBJ_Lat_Distance_STD_34 : 125|11@1+ (0.05,0) [0|100] "m"  ACM
 SG_ OBJ_Lat_Distance_STD_V_34 : 136|1@1+ (1,0) [0|1] "bool"  ACM
 SG_ OBJ_Absolute_Speed_34 : 144|12@1+ (0.05,-65) [-65|65] "MPS"  ACM
 SG_ OBJ_Absolute_Speed_V_34 : 156|1@1+ (1,0) [0|1] "bool"  ACM
 SG_ OBJ_Absolute_Speed_STD_34 : 157|11@1+ (0.05,-65) [0|65] "MPS"  ACM
 SG_ OBJ_Absolute_Speed_STD_V_34 : 168|1@1+ (1,0) [0|1] "bool"  ACM
 SG_ OBJ_Heading_34 : 176|10@1+ (0.01,-3.14) [-3.14|3.14] "rad"  ACM
 SG_ OBJ_Heading_V_34 : 186|1@1+ (1,0) [0|1] "bool"  ACM
 SG_ OBJ_Heading_STD_34 : 187|9@1+ (0.01,0) [0|3.14] "rad"  ACM
 SG_ OBJ_Heading_STD_V_34 : 196|1@1+ (1,0) [0|1] "bool"  ACM
 SG_ OBJ_Angle_Rate_STD_34 : 197|11@1+ (0.002,0) [0|2.2318] "RPS"  ACM
 SG_ OBJ_Angle_Rate_STD_V_34 : 208|1@1+ (1,0) [0|1] "bool"  ACM
 SG_ OBJ_Angle_Rate_34 : 209|12@1+ (0.002,-2.234) [-2.234|2.2318] "RPS"  ACM
 SG_ OBJ_Angle_Rate_V_34 : 221|1@1+ (1,0) [0|1] "bool"  ACM
 SG_ OBJ_Angle_Right_34 : 222|14@1+ (0.0002,-1.571) [-1.571|1.571] "rad "  ACM
 SG_ OBJ_Angle_Right_V_34 : 236|1@1+ (1,0) [0|1] "bool"  ACM
 SG_ OBJ_Angle_Right_STD_34 : 240|13@1+ (0.0002,0) [0|1.571] "rad "  ACM
 SG_ OBJ_Angle_Right_STD_V_34 : 253|1@1+ (1,0) [0|1] "bool"  ACM
 SG_ OBJ_Angle_Left_34 : 254|14@1+ (0.0002,-1.571) [-1.571|1.571] "rad "  ACM
 SG_ OBJ_Angle_Left_V_34 : 268|1@1+ (1,0) [0|1] "bool"  ACM
 SG_ OBJ_Angle_Left_STD_34 : 272|13@1+ (0.0002,0) [0|1.571] "rad"  ACM
 SG_ OBJ_Angle_Left_STD_V_34 : 285|1@1+ (1,0) [0|1] "bool"  ACM
 SG_ OBJ_Angle_Side_34 : 286|14@1+ (0.0002,-1.571) [-1.571|1.571] "rad"  ACM
 SG_ OBJ_Angle_Side_V_34 : 300|1@1+ (1,0) [0|1] "bool"  ACM
 SG_ OBJ_Angle_Side_STD_34 : 304|13@1+ (0.0002,0) [0|1.571] "rad"  ACM
 SG_ OBJ_Angle_Side_STD_V_34 : 317|1@1+ (1,0) [0|1] "bool"  ACM
 SG_ OBJ_Angle_Mid_V_34 : 318|1@1+ (1,0) [0|1] "bool"  ACM
 SG_ OBJ_Angle_Mid_34 : 319|14@1+ (0.0002,-1.571) [-1.571|1.571] "rad"  ACM
 SG_ OBJ_Angle_Mid_STD_34 : 336|13@1+ (0.0002,0) [0|1.571] "rad"  ACM
 SG_ OBJ_Angle_Mid_STD_V_34 : 349|1@1+ (1,0) [0|1] "bool"  ACM
 SG_ OBJ_Angle_Bottom_V_34 : 350|1@1+ (1,0) [0|1] "bool"  ACM
 SG_ OBJ_Angle_Bottom_34 : 351|14@1+ (0.0002,-1.571) [-1.571|1.571] "rad"  ACM
 SG_ OBJ_Angle_Bottom_STD_34 : 368|13@1+ (0.0002,0) [0|1.571] "rad"  ACM
 SG_ OBJ_Angle_Bottom_STD_V_34 : 381|1@1+ (1,0) [0|1] "bool"  ACM
 SG_ OBJ_Visibility_Side_V_34 : 382|1@1+ (1,0) [0|1] "bool"  ACM
 SG_ OBJ_Visibility_Side_34 : 383|2@1+ (1,0) [0|2] "ENUM"  ACM
 SG_ OBJ_Is_In_Drivable_Area_34 : 385|1@1+ (1,0) [0|1] "bool"  ACM
 SG_ OBJ_Is_In_Drivable_Area_V_34 : 386|1@1+ (1,0) [0|1] "bool"  ACM
 SG_ OBJ_Is_VeryClose_34 : 387|1@1+ (1,0) [0|1] "bool"  ACM
 SG_ OBJ_Is_VeryClose_V_34 : 388|1@1+ (1,0) [0|1] "bool"  ACM
 SG_ OBJ_Buffer_34 : 389|11@1+ (1,0) [0|0] "NA"  ACM

BO_ 213 ICM_Object_Prot34_A: 64 MyECU
 SG_ ICM_Object_Prot34_A_Header : 0|16@1+ (1,0) [0|65535] ""  ACM
 SG_ OBJ_CRC_34 : 16|32@1+ (1,0) [0|4294967295] "NA"  ACM
 SG_ OBJ_ID_34 : 48|8@1+ (1,0) [0|255] "NA"  ACM
 SG_ OBJ_Existence_Probability_34 : 56|8@1+ (0.01,0) [0|1] "NA"  ACM
 SG_ OBJ_Fusion_Source_34 : 64|16@1+ (1,0) [0|65535] "BITWIZE"  ACM
 SG_ OBJ_Triggered_SDM_34 : 80|2@1+ (1,0) [0|2] "ENUM"  ACM
 SG_ OBJ_Motion_Category_34 : 82|4@1+ (1,0) [0|13] "ENUM "  ACM
 SG_ OBJ_Moving_IN_Probability_34 : 86|7@1+ (0.01,0) [0|0] "NA"  ACM
 SG_ OBJ_Object_Age_34 : 93|11@1+ (1,0) [0|2047] "Frame"  ACM
 SG_ OBJ_Measuring_Status_34 : 104|3@1+ (1,0) [0|7] "BITWIZE"  ACM
 SG_ OBJ_Object_Class_34 : 107|4@1+ (1,0) [0|8] "ENUM"  ACM
 SG_ OBJ_Class_Probability_34 : 112|7@1+ (0.01,0) [0|1] "NA"  ACM
 SG_ OBJ_Car_Probability_34 : 119|7@1+ (0.01,0) [0|0] "NA"  ACM
 SG_ OBJ_Truck_Probability_34 : 126|7@1+ (0.01,0) [0|0] "NA"  ACM
 SG_ OBJ_Bike_Probability_34 : 133|7@1+ (0.01,0) [0|0] "NA"  ACM
 SG_ OBJ_Camera_Source_34 : 140|4@1+ (1,0) [0|15] "ENUM"  ACM
 SG_ OBJ_Motion_Status_34 : 144|3@1+ (1,0) [0|5] "ENUM "  ACM
 SG_ OBJ_Motion_Orientation_34 : 147|4@1+ (1,0) [0|13] "ENUM "  ACM
 SG_ OBJ_Has_Cut_Lane_34 : 151|1@1+ (1,0) [0|1] "bool"  ACM
 SG_ OBJ_Has_Cut_Path_34 : 152|1@1+ (1,0) [0|1] "bool"  ACM
 SG_ OBJ_Brake_Light_34 : 153|1@1+ (1,0) [0|1] "bool"  ACM
 SG_ OBJ_Turn_Indicator_Right_34 : 154|1@1+ (1,0) [0|1] "bool"  ACM
 SG_ OBJ_Turn_Indicator_Left_34 : 155|1@1+ (1,0) [0|1] "bool"  ACM
 SG_ OBJ_Light_Indicator_Validity_34 : 156|1@1+ (1,0) [0|1] "bool"  ACM
 SG_ OBJ_Right_Out_Of_Image_34 : 157|1@1+ (1,0) [0|1] "bool"  ACM
 SG_ OBJ_Left_Out_Of_Image_34 : 158|1@1+ (1,0) [0|1] "bool"  ACM
 SG_ OBJ_Right_Out_Of_Image_V_34 : 159|1@1+ (1,0) [0|1] "bool"  ACM
 SG_ OBJ_Left_Out_Of_Image_V_34 : 160|1@1+ (1,0) [0|1] "bool"  ACM
 SG_ OBJ_Top_Out_Of_Image_34 : 161|1@1+ (1,0) [0|1] "bool"  ACM
 SG_ OBJ_Bottom_Out_Of_Image_34 : 162|1@1+ (1,0) [0|1] "bool"  ACM
 SG_ OBJ_Top_Out_Of_Image_V_34 : 163|1@1+ (1,0) [0|1] "bool"  ACM
 SG_ OBJ_Bottom_Out_Of_Image_V_34 : 164|1@1+ (1,0) [0|1] "bool"  ACM
 SG_ OBJ_Lane_Assignment_34 : 165|3@1+ (1,0) [0|5] "ENUM"  ACM
 SG_ OBJ_Lane_Assignment_V_34 : 168|1@1+ (1,0) [0|1] "bool"  ACM
 SG_ OBJ_Age_Seconds_34 : 169|7@1+ (1,0) [0|100] "s"  ACM
 SG_ OBJ_Age_Seconds_V_34 : 176|1@1+ (1,0) [0|1] "bool"  ACM
 SG_ OBJ_Width_34 : 177|9@1+ (0.01,0) [0.4|2.95] "m"  ACM
 SG_ OBJ_Width_V_34 : 186|1@1+ (1,0) [0|1] "bool"  ACM
 SG_ OBJ_Width_STD_34 : 187|8@1+ (0.01,0) [0|2] "m"  ACM
 SG_ OBJ_Width_STD_V_34 : 195|1@1+ (1,0) [0|1] "bool"  ACM
 SG_ OBJ_Length_34 : 196|9@1+ (0.05,0) [1.2|21] "m"  ACM
 SG_ OBJ_Length_V_34 : 205|1@1+ (1,0) [0|1] "bool"  ACM
 SG_ OBJ_Length_STD_34 : 208|8@1+ (0.05,0) [0|10] "m"  ACM
 SG_ OBJ_Length_STD_V_34 : 216|1@1+ (1,0) [0|1] "bool"  ACM
 SG_ OBJ_Height_34 : 217|9@1+ (0.01,0) [0|2.95] "m"  ACM
 SG_ OBJ_Height_V_34 : 226|1@1+ (1,0) [0|1] "bool"  ACM
 SG_ OBJ_Height_STD_34 : 227|8@1+ (0.01,0) [0|2] "m"  ACM
 SG_ OBJ_Height_STD_V_34 : 235|1@1+ (1,0) [0|1] "bool"  ACM
 SG_ OBJ_Abs_Long_Velocity_34 : 240|12@1+ (0.05,-30) [-30|100] "MPS"  ACM
 SG_ OBJ_Abs_Long_Velocity_V_34 : 252|1@1+ (1,0) [0|1] "bool"  ACM
 SG_ OBJ_Abs_Long_Velocity_STD_34 : 253|11@1+ (0.05,0) [0|65] "MPS"  ACM
 SG_ OBJ_Abs_Long_Vel_STD_V_34 : 264|1@1+ (1,0) [0|1] "bool"  ACM
 SG_ OBJ_Abs_Lat_Velocity_34 : 272|11@1+ (0.05,-50) [-50|50] "MPS"  ACM
 SG_ OBJ_Abs_Lat_Velocity_V_34 : 283|1@1+ (1,0) [0|1] "bool"  ACM
 SG_ OBJ_Abs_Lat_Velocity_STD_34 : 284|10@1+ (0.05,0) [0|50] "MPS"  ACM
 SG_ OBJ_Abs_Lat_Vel_STD_V_34 : 294|1@1+ (1,0) [0|1] "bool"  ACM
 SG_ OBJ_Abs_Long_Acc_34 : 295|9@1+ (0.05,-10.3) [-10.3|7.3] "MPS2"  ACM
 SG_ OBJ_Abs_Long_Acc_V_34 : 304|1@1+ (1,0) [0|1] "bool"  ACM
 SG_ OBJ_Abs_Long_Acc_STD_34 : 305|8@1+ (0.05,0) [0|7.3] "MPS2"  ACM
 SG_ OBJ_Abs_Long_Acc_STD_V_34 : 313|1@1+ (1,0) [0|1] "bool"  ACM
 SG_ OBJ_Abs_Lat_Acc_34 : 314|9@1+ (0.05,-10.3) [-10.3|7.3] "MPS2"  ACM
 SG_ OBJ_Abs_Lat_Acc_V_34 : 323|1@1+ (1,0) [0|1] "bool"  ACM
 SG_ OBJ_Abs_Lat_Acc_STD_34 : 324|8@1+ (0.05,0) [0|7.3] "MPS2"  ACM
 SG_ OBJ_Abs_Lat_Acc_STD_V_34 : 332|1@1+ (1,0) [0|1] "bool"  ACM
 SG_ OBJ_Abs_Acceleration_34 : 336|9@1+ (0.05,-10.3) [-10.3|7.3] "MPS2"  ACM
 SG_ OBJ_Abs_Acceleration_V_34 : 345|1@1+ (1,0) [0|1] "bool"  ACM
 SG_ OBJ_Abs_Acc_STD_34 : 346|8@1+ (0.05,0) [0|7.3] "MPS2"  ACM
 SG_ OBJ_Abs_Acc_STD_V_34 : 354|1@1+ (1,0) [0|1] "bool"  ACM
 SG_ OBJ_Inv_TTC_34 : 355|11@1+ (0.01,-8) [-8|8] "INV(s)"  ACM
 SG_ OBJ_Inv_TTC_V_34 : 366|1@1+ (1,0) [0|1] "bool"  ACM
 SG_ OBJ_Inv_TTC_STD_34 : 368|11@1+ (0.01,0) [0|4] "INV(s)"  ACM
 SG_ OBJ_Inv_TTC_STD_V_34 : 379|1@1+ (1,0) [0|1] "bool"  ACM
 SG_ OBJ_Relative_Long_Acc_34 : 380|9@1+ (0.05,-10.3) [-10.3|7.3] "MPS2"  ACM
 SG_ OBJ_Relative_Long_Acc_V_34 : 389|1@1+ (1,0) [0|1] "bool"  ACM
 SG_ OBJ_Relative_Long_Acc_STD_34 : 390|8@1+ (0.05,0) [0|7.3] "MPS2"  ACM
 SG_ OBJ_Rel_Long_Acc_STD_V_34 : 398|1@1+ (1,0) [0|1] "bool"  ACM

BO_ 212 ICM_Object_Prot33_B: 64 MyECU
 SG_ ICM_Object_Prot33_B_Header : 0|16@1+ (1,0) [0|65535] ""  ACM
 SG_ OBJ_Relative_Long_Velocity_33 : 16|13@1+ (0.05,-120) [-120|130] "MPS"  ACM
 SG_ OBJ_Relative_Long_Velocity_V_33 : 29|1@1+ (1,0) [0|1] "bool"  ACM
 SG_ OBJ_Relative_Long_Vel_STD_33 : 30|12@1+ (0.05,0) [0|130] "MPS"  ACM
 SG_ OBJ_Rel_Long_Vel_STD_V_33 : 42|1@1+ (1,0) [0|1] "bool"  ACM
 SG_ OBJ_Relative_Lat_Velocity_33 : 48|11@1+ (0.05,-50) [-50|50] "MPS"  ACM
 SG_ OBJ_Relative_Lat_Velocity_V_33 : 59|1@1+ (1,0) [0|1] "bool"  ACM
 SG_ OBJ_Relative_Lat_Velocity_STD_33 : 60|10@1+ (0.05,0) [0|50] "MPS"  ACM
 SG_ OBJ_Rel_Lat_Vel_STD_V_33 : 70|1@1+ (1,0) [0|1] "bool"  ACM
 SG_ OBJ_Long_Distance_33 : 80|14@1+ (0.05,-200) [-200|250] "m"  ACM
 SG_ OBJ_Long_Distance_V_33 : 94|1@1+ (1,0) [0|1] "bool"  ACM
 SG_ OBJ_Long_Distance_STD_33 : 95|13@1+ (0.05,0) [0|250] "m"  ACM
 SG_ OBJ_Long_Distance_STD_V_33 : 108|1@1+ (1,0) [0|1] "bool"  ACM
 SG_ OBJ_Lat_Distance_33 : 112|12@1+ (0.05,-100) [-100|100] "m"  ACM
 SG_ OBJ_Lat_Distance_V_33 : 124|1@1+ (1,0) [0|1] "bool"  ACM
 SG_ OBJ_Lat_Distance_STD_33 : 125|11@1+ (0.05,0) [0|100] "m"  ACM
 SG_ OBJ_Lat_Distance_STD_V_33 : 136|1@1+ (1,0) [0|1] "bool"  ACM
 SG_ OBJ_Absolute_Speed_33 : 144|12@1+ (0.05,-65) [-65|65] "MPS"  ACM
 SG_ OBJ_Absolute_Speed_V_33 : 156|1@1+ (1,0) [0|1] "bool"  ACM
 SG_ OBJ_Absolute_Speed_STD_33 : 157|11@1+ (0.05,-65) [0|65] "MPS"  ACM
 SG_ OBJ_Absolute_Speed_STD_V_33 : 168|1@1+ (1,0) [0|1] "bool"  ACM
 SG_ OBJ_Heading_33 : 176|10@1+ (0.01,-3.14) [-3.14|3.14] "rad"  ACM
 SG_ OBJ_Heading_V_33 : 186|1@1+ (1,0) [0|1] "bool"  ACM
 SG_ OBJ_Heading_STD_33 : 187|9@1+ (0.01,0) [0|3.14] "rad"  ACM
 SG_ OBJ_Heading_STD_V_33 : 196|1@1+ (1,0) [0|1] "bool"  ACM
 SG_ OBJ_Angle_Rate_STD_33 : 197|11@1+ (0.002,0) [0|2.2318] "RPS"  ACM
 SG_ OBJ_Angle_Rate_STD_V_33 : 208|1@1+ (1,0) [0|1] "bool"  ACM
 SG_ OBJ_Angle_Rate_33 : 209|12@1+ (0.002,-2.234) [-2.234|2.2318] "RPS"  ACM
 SG_ OBJ_Angle_Rate_V_33 : 221|1@1+ (1,0) [0|1] "bool"  ACM
 SG_ OBJ_Angle_Right_33 : 222|14@1+ (0.0002,-1.571) [-1.571|1.571] "rad "  ACM
 SG_ OBJ_Angle_Right_V_33 : 236|1@1+ (1,0) [0|1] "bool"  ACM
 SG_ OBJ_Angle_Right_STD_33 : 240|13@1+ (0.0002,0) [0|1.571] "rad "  ACM
 SG_ OBJ_Angle_Right_STD_V_33 : 253|1@1+ (1,0) [0|1] "bool"  ACM
 SG_ OBJ_Angle_Left_33 : 254|14@1+ (0.0002,-1.571) [-1.571|1.571] "rad "  ACM
 SG_ OBJ_Angle_Left_V_33 : 268|1@1+ (1,0) [0|1] "bool"  ACM
 SG_ OBJ_Angle_Left_STD_33 : 272|13@1+ (0.0002,0) [0|1.571] "rad"  ACM
 SG_ OBJ_Angle_Left_STD_V_33 : 285|1@1+ (1,0) [0|1] "bool"  ACM
 SG_ OBJ_Angle_Side_33 : 286|14@1+ (0.0002,-1.571) [-1.571|1.571] "rad"  ACM
 SG_ OBJ_Angle_Side_V_33 : 300|1@1+ (1,0) [0|1] "bool"  ACM
 SG_ OBJ_Angle_Side_STD_33 : 304|13@1+ (0.0002,0) [0|1.571] "rad"  ACM
 SG_ OBJ_Angle_Side_STD_V_33 : 317|1@1+ (1,0) [0|1] "bool"  ACM
 SG_ OBJ_Angle_Mid_V_33 : 318|1@1+ (1,0) [0|1] "bool"  ACM
 SG_ OBJ_Angle_Mid_33 : 319|14@1+ (0.0002,-1.571) [-1.571|1.571] "rad"  ACM
 SG_ OBJ_Angle_Mid_STD_33 : 336|13@1+ (0.0002,0) [0|1.571] "rad"  ACM
 SG_ OBJ_Angle_Mid_STD_V_33 : 349|1@1+ (1,0) [0|1] "bool"  ACM
 SG_ OBJ_Angle_Bottom_V_33 : 350|1@1+ (1,0) [0|1] "bool"  ACM
 SG_ OBJ_Angle_Bottom_33 : 351|14@1+ (0.0002,-1.571) [-1.571|1.571] "rad"  ACM
 SG_ OBJ_Angle_Bottom_STD_33 : 368|13@1+ (0.0002,0) [0|1.571] "rad"  ACM
 SG_ OBJ_Angle_Bottom_STD_V_33 : 381|1@1+ (1,0) [0|1] "bool"  ACM
 SG_ OBJ_Visibility_Side_V_33 : 382|1@1+ (1,0) [0|1] "bool"  ACM
 SG_ OBJ_Visibility_Side_33 : 383|2@1+ (1,0) [0|2] "ENUM"  ACM
 SG_ OBJ_Is_In_Drivable_Area_33 : 385|1@1+ (1,0) [0|1] "bool"  ACM
 SG_ OBJ_Is_In_Drivable_Area_V_33 : 386|1@1+ (1,0) [0|1] "bool"  ACM
 SG_ OBJ_Is_VeryClose_33 : 387|1@1+ (1,0) [0|1] "bool"  ACM
 SG_ OBJ_Is_VeryClose_V_33 : 388|1@1+ (1,0) [0|1] "bool"  ACM
 SG_ OBJ_Buffer_33 : 389|11@1+ (1,0) [0|0] "NA"  ACM

BO_ 211 ICM_Object_Prot33_A: 64 MyECU
 SG_ ICM_Object_Prot33_A_Header : 0|16@1+ (1,0) [0|65535] ""  ACM
 SG_ OBJ_CRC_33 : 16|32@1+ (1,0) [0|4294967295] "NA"  ACM
 SG_ OBJ_ID_33 : 48|8@1+ (1,0) [0|255] "NA"  ACM
 SG_ OBJ_Existence_Probability_33 : 56|8@1+ (0.01,0) [0|1] "NA"  ACM
 SG_ OBJ_Fusion_Source_33 : 64|16@1+ (1,0) [0|65535] "BITWIZE"  ACM
 SG_ OBJ_Triggered_SDM_33 : 80|2@1+ (1,0) [0|2] "ENUM"  ACM
 SG_ OBJ_Motion_Category_33 : 82|4@1+ (1,0) [0|13] "ENUM "  ACM
 SG_ OBJ_Moving_IN_Probability_33 : 86|7@1+ (0.01,0) [0|0] "NA"  ACM
 SG_ OBJ_Object_Age_33 : 93|11@1+ (1,0) [0|2047] "Frame"  ACM
 SG_ OBJ_Measuring_Status_33 : 104|3@1+ (1,0) [0|7] "BITWIZE"  ACM
 SG_ OBJ_Object_Class_33 : 107|4@1+ (1,0) [0|8] "ENUM"  ACM
 SG_ OBJ_Class_Probability_33 : 112|7@1+ (0.01,0) [0|1] "NA"  ACM
 SG_ OBJ_Car_Probability_33 : 119|7@1+ (0.01,0) [0|0] "NA"  ACM
 SG_ OBJ_Truck_Probability_33 : 126|7@1+ (0.01,0) [0|0] "NA"  ACM
 SG_ OBJ_Bike_Probability_33 : 133|7@1+ (0.01,0) [0|0] "NA"  ACM
 SG_ OBJ_Camera_Source_33 : 140|4@1+ (1,0) [0|15] "ENUM"  ACM
 SG_ OBJ_Motion_Status_33 : 144|3@1+ (1,0) [0|5] "ENUM "  ACM
 SG_ OBJ_Motion_Orientation_33 : 147|4@1+ (1,0) [0|13] "ENUM "  ACM
 SG_ OBJ_Has_Cut_Lane_33 : 151|1@1+ (1,0) [0|1] "bool"  ACM
 SG_ OBJ_Has_Cut_Path_33 : 152|1@1+ (1,0) [0|1] "bool"  ACM
 SG_ OBJ_Brake_Light_33 : 153|1@1+ (1,0) [0|1] "bool"  ACM
 SG_ OBJ_Turn_Indicator_Right_33 : 154|1@1+ (1,0) [0|1] "bool"  ACM
 SG_ OBJ_Turn_Indicator_Left_33 : 155|1@1+ (1,0) [0|1] "bool"  ACM
 SG_ OBJ_Light_Indicator_Validity_33 : 156|1@1+ (1,0) [0|1] "bool"  ACM
 SG_ OBJ_Right_Out_Of_Image_33 : 157|1@1+ (1,0) [0|1] "bool"  ACM
 SG_ OBJ_Left_Out_Of_Image_33 : 158|1@1+ (1,0) [0|1] "bool"  ACM
 SG_ OBJ_Right_Out_Of_Image_V_33 : 159|1@1+ (1,0) [0|1] "bool"  ACM
 SG_ OBJ_Left_Out_Of_Image_V_33 : 160|1@1+ (1,0) [0|1] "bool"  ACM
 SG_ OBJ_Top_Out_Of_Image_33 : 161|1@1+ (1,0) [0|1] "bool"  ACM
 SG_ OBJ_Bottom_Out_Of_Image_33 : 162|1@1+ (1,0) [0|1] "bool"  ACM
 SG_ OBJ_Top_Out_Of_Image_V_33 : 163|1@1+ (1,0) [0|1] "bool"  ACM
 SG_ OBJ_Bottom_Out_Of_Image_V_33 : 164|1@1+ (1,0) [0|1] "bool"  ACM
 SG_ OBJ_Lane_Assignment_33 : 165|3@1+ (1,0) [0|5] "ENUM"  ACM
 SG_ OBJ_Lane_Assignment_V_33 : 168|1@1+ (1,0) [0|1] "bool"  ACM
 SG_ OBJ_Age_Seconds_33 : 169|7@1+ (1,0) [0|100] "s"  ACM
 SG_ OBJ_Age_Seconds_V_33 : 176|1@1+ (1,0) [0|1] "bool"  ACM
 SG_ OBJ_Width_33 : 177|9@1+ (0.01,0) [0.4|2.95] "m"  ACM
 SG_ OBJ_Width_V_33 : 186|1@1+ (1,0) [0|1] "bool"  ACM
 SG_ OBJ_Width_STD_33 : 187|8@1+ (0.01,0) [0|2] "m"  ACM
 SG_ OBJ_Width_STD_V_33 : 195|1@1+ (1,0) [0|1] "bool"  ACM
 SG_ OBJ_Length_33 : 196|9@1+ (0.05,0) [1.2|21] "m"  ACM
 SG_ OBJ_Length_V_33 : 205|1@1+ (1,0) [0|1] "bool"  ACM
 SG_ OBJ_Length_STD_33 : 208|8@1+ (0.05,0) [0|10] "m"  ACM
 SG_ OBJ_Length_STD_V_33 : 216|1@1+ (1,0) [0|1] "bool"  ACM
 SG_ OBJ_Height_33 : 217|9@1+ (0.01,0) [0|2.95] "m"  ACM
 SG_ OBJ_Height_V_33 : 226|1@1+ (1,0) [0|1] "bool"  ACM
 SG_ OBJ_Height_STD_33 : 227|8@1+ (0.01,0) [0|2] "m"  ACM
 SG_ OBJ_Height_STD_V_33 : 235|1@1+ (1,0) [0|1] "bool"  ACM
 SG_ OBJ_Abs_Long_Velocity_33 : 240|12@1+ (0.05,-30) [-30|100] "MPS"  ACM
 SG_ OBJ_Abs_Long_Velocity_V_33 : 252|1@1+ (1,0) [0|1] "bool"  ACM
 SG_ OBJ_Abs_Long_Velocity_STD_33 : 253|11@1+ (0.05,0) [0|65] "MPS"  ACM
 SG_ OBJ_Abs_Long_Vel_STD_V_33 : 264|1@1+ (1,0) [0|1] "bool"  ACM
 SG_ OBJ_Abs_Lat_Velocity_33 : 272|11@1+ (0.05,-50) [-50|50] "MPS"  ACM
 SG_ OBJ_Abs_Lat_Velocity_V_33 : 283|1@1+ (1,0) [0|1] "bool"  ACM
 SG_ OBJ_Abs_Lat_Velocity_STD_33 : 284|10@1+ (0.05,0) [0|50] "MPS"  ACM
 SG_ OBJ_Abs_Lat_Vel_STD_V_33 : 294|1@1+ (1,0) [0|1] "bool"  ACM
 SG_ OBJ_Abs_Long_Acc_33 : 295|9@1+ (0.05,-10.3) [-10.3|7.3] "MPS2"  ACM
 SG_ OBJ_Abs_Long_Acc_V_33 : 304|1@1+ (1,0) [0|1] "bool"  ACM
 SG_ OBJ_Abs_Long_Acc_STD_33 : 305|8@1+ (0.05,0) [0|7.3] "MPS2"  ACM
 SG_ OBJ_Abs_Long_Acc_STD_V_33 : 313|1@1+ (1,0) [0|1] "bool"  ACM
 SG_ OBJ_Abs_Lat_Acc_33 : 314|9@1+ (0.05,-10.3) [-10.3|7.3] "MPS2"  ACM
 SG_ OBJ_Abs_Lat_Acc_V_33 : 323|1@1+ (1,0) [0|1] "bool"  ACM
 SG_ OBJ_Abs_Lat_Acc_STD_33 : 324|8@1+ (0.05,0) [0|7.3] "MPS2"  ACM
 SG_ OBJ_Abs_Lat_Acc_STD_V_33 : 332|1@1+ (1,0) [0|1] "bool"  ACM
 SG_ OBJ_Abs_Acceleration_33 : 336|9@1+ (0.05,-10.3) [-10.3|7.3] "MPS2"  ACM
 SG_ OBJ_Abs_Acceleration_V_33 : 345|1@1+ (1,0) [0|1] "bool"  ACM
 SG_ OBJ_Abs_Acc_STD_33 : 346|8@1+ (0.05,0) [0|7.3] "MPS2"  ACM
 SG_ OBJ_Abs_Acc_STD_V_33 : 354|1@1+ (1,0) [0|1] "bool"  ACM
 SG_ OBJ_Inv_TTC_33 : 355|11@1+ (0.01,-8) [-8|8] "INV(s)"  ACM
 SG_ OBJ_Inv_TTC_V_33 : 366|1@1+ (1,0) [0|1] "bool"  ACM
 SG_ OBJ_Inv_TTC_STD_33 : 368|11@1+ (0.01,0) [0|4] "INV(s)"  ACM
 SG_ OBJ_Inv_TTC_STD_V_33 : 379|1@1+ (1,0) [0|1] "bool"  ACM
 SG_ OBJ_Relative_Long_Acc_33 : 380|9@1+ (0.05,-10.3) [-10.3|7.3] "MPS2"  ACM
 SG_ OBJ_Relative_Long_Acc_V_33 : 389|1@1+ (1,0) [0|1] "bool"  ACM
 SG_ OBJ_Relative_Long_Acc_STD_33 : 390|8@1+ (0.05,0) [0|7.3] "MPS2"  ACM
 SG_ OBJ_Rel_Long_Acc_STD_V_33 : 398|1@1+ (1,0) [0|1] "bool"  ACM

BO_ 210 ICM_Object_Prot32_B: 64 MyECU
 SG_ ICM_Object_Prot32_B_Header : 0|16@1+ (1,0) [0|65535] ""  ACM
 SG_ OBJ_Relative_Long_Velocity_32 : 16|13@1+ (0.05,-120) [-120|130] "MPS"  ACM
 SG_ OBJ_Relative_Long_Velocity_V_32 : 29|1@1+ (1,0) [0|1] "bool"  ACM
 SG_ OBJ_Relative_Long_Vel_STD_32 : 30|12@1+ (0.05,0) [0|130] "MPS"  ACM
 SG_ OBJ_Rel_Long_Vel_STD_V_32 : 42|1@1+ (1,0) [0|1] "bool"  ACM
 SG_ OBJ_Relative_Lat_Velocity_32 : 48|11@1+ (0.05,-50) [-50|50] "MPS"  ACM
 SG_ OBJ_Relative_Lat_Velocity_V_32 : 59|1@1+ (1,0) [0|1] "bool"  ACM
 SG_ OBJ_Relative_Lat_Velocity_STD_32 : 60|10@1+ (0.05,0) [0|50] "MPS"  ACM
 SG_ OBJ_Rel_Lat_Vel_STD_V_32 : 70|1@1+ (1,0) [0|1] "bool"  ACM
 SG_ OBJ_Long_Distance_32 : 80|14@1+ (0.05,-200) [-200|250] "m"  ACM
 SG_ OBJ_Long_Distance_V_32 : 94|1@1+ (1,0) [0|1] "bool"  ACM
 SG_ OBJ_Long_Distance_STD_32 : 95|13@1+ (0.05,0) [0|250] "m"  ACM
 SG_ OBJ_Long_Distance_STD_V_32 : 108|1@1+ (1,0) [0|1] "bool"  ACM
 SG_ OBJ_Lat_Distance_32 : 112|12@1+ (0.05,-100) [-100|100] "m"  ACM
 SG_ OBJ_Lat_Distance_V_32 : 124|1@1+ (1,0) [0|1] "bool"  ACM
 SG_ OBJ_Lat_Distance_STD_32 : 125|11@1+ (0.05,0) [0|100] "m"  ACM
 SG_ OBJ_Lat_Distance_STD_V_32 : 136|1@1+ (1,0) [0|1] "bool"  ACM
 SG_ OBJ_Absolute_Speed_32 : 144|12@1+ (0.05,-65) [-65|65] "MPS"  ACM
 SG_ OBJ_Absolute_Speed_V_32 : 156|1@1+ (1,0) [0|1] "bool"  ACM
 SG_ OBJ_Absolute_Speed_STD_32 : 157|11@1+ (0.05,-65) [0|65] "MPS"  ACM
 SG_ OBJ_Absolute_Speed_STD_V_32 : 168|1@1+ (1,0) [0|1] "bool"  ACM
 SG_ OBJ_Heading_32 : 176|10@1+ (0.01,-3.14) [-3.14|3.14] "rad"  ACM
 SG_ OBJ_Heading_V_32 : 186|1@1+ (1,0) [0|1] "bool"  ACM
 SG_ OBJ_Heading_STD_32 : 187|9@1+ (0.01,0) [0|3.14] "rad"  ACM
 SG_ OBJ_Heading_STD_V_32 : 196|1@1+ (1,0) [0|1] "bool"  ACM
 SG_ OBJ_Angle_Rate_STD_32 : 197|11@1+ (0.002,0) [0|2.2318] "RPS"  ACM
 SG_ OBJ_Angle_Rate_STD_V_32 : 208|1@1+ (1,0) [0|1] "bool"  ACM
 SG_ OBJ_Angle_Rate_32 : 209|12@1+ (0.002,-2.234) [-2.234|2.2318] "RPS"  ACM
 SG_ OBJ_Angle_Rate_V_32 : 221|1@1+ (1,0) [0|1] "bool"  ACM
 SG_ OBJ_Angle_Right_32 : 222|14@1+ (0.0002,-1.571) [-1.571|1.571] "rad "  ACM
 SG_ OBJ_Angle_Right_V_32 : 236|1@1+ (1,0) [0|1] "bool"  ACM
 SG_ OBJ_Angle_Right_STD_32 : 240|13@1+ (0.0002,0) [0|1.571] "rad "  ACM
 SG_ OBJ_Angle_Right_STD_V_32 : 253|1@1+ (1,0) [0|1] "bool"  ACM
 SG_ OBJ_Angle_Left_32 : 254|14@1+ (0.0002,-1.571) [-1.571|1.571] "rad "  ACM
 SG_ OBJ_Angle_Left_V_32 : 268|1@1+ (1,0) [0|1] "bool"  ACM
 SG_ OBJ_Angle_Left_STD_32 : 272|13@1+ (0.0002,0) [0|1.571] "rad"  ACM
 SG_ OBJ_Angle_Left_STD_V_32 : 285|1@1+ (1,0) [0|1] "bool"  ACM
 SG_ OBJ_Angle_Side_32 : 286|14@1+ (0.0002,-1.571) [-1.571|1.571] "rad"  ACM
 SG_ OBJ_Angle_Side_V_32 : 300|1@1+ (1,0) [0|1] "bool"  ACM
 SG_ OBJ_Angle_Side_STD_32 : 304|13@1+ (0.0002,0) [0|1.571] "rad"  ACM
 SG_ OBJ_Angle_Side_STD_V_32 : 317|1@1+ (1,0) [0|1] "bool"  ACM
 SG_ OBJ_Angle_Mid_V_32 : 318|1@1+ (1,0) [0|1] "bool"  ACM
 SG_ OBJ_Angle_Mid_32 : 319|14@1+ (0.0002,-1.571) [-1.571|1.571] "rad"  ACM
 SG_ OBJ_Angle_Mid_STD_32 : 336|13@1+ (0.0002,0) [0|1.571] "rad"  ACM
 SG_ OBJ_Angle_Mid_STD_V_32 : 349|1@1+ (1,0) [0|1] "bool"  ACM
 SG_ OBJ_Angle_Bottom_V_32 : 350|1@1+ (1,0) [0|1] "bool"  ACM
 SG_ OBJ_Angle_Bottom_32 : 351|14@1+ (0.0002,-1.571) [-1.571|1.571] "rad"  ACM
 SG_ OBJ_Angle_Bottom_STD_32 : 368|13@1+ (0.0002,0) [0|1.571] "rad"  ACM
 SG_ OBJ_Angle_Bottom_STD_V_32 : 381|1@1+ (1,0) [0|1] "bool"  ACM
 SG_ OBJ_Visibility_Side_V_32 : 382|1@1+ (1,0) [0|1] "bool"  ACM
 SG_ OBJ_Visibility_Side_32 : 383|2@1+ (1,0) [0|2] "ENUM"  ACM
 SG_ OBJ_Is_In_Drivable_Area_32 : 385|1@1+ (1,0) [0|1] "bool"  ACM
 SG_ OBJ_Is_In_Drivable_Area_V_32 : 386|1@1+ (1,0) [0|1] "bool"  ACM
 SG_ OBJ_Is_VeryClose_32 : 387|1@1+ (1,0) [0|1] "bool"  ACM
 SG_ OBJ_Is_VeryClose_V_32 : 388|1@1+ (1,0) [0|1] "bool"  ACM
 SG_ OBJ_Buffer_32 : 389|11@1+ (1,0) [0|0] "NA"  ACM

BO_ 209 ICM_Object_Prot32_A: 64 MyECU
 SG_ ICM_Object_Prot32_A_Header : 0|16@1+ (1,0) [0|65535] ""  ACM
 SG_ OBJ_CRC_32 : 16|32@1+ (1,0) [0|4294967295] "NA"  ACM
 SG_ OBJ_ID_32 : 48|8@1+ (1,0) [0|255] "NA"  ACM
 SG_ OBJ_Existence_Probability_32 : 56|8@1+ (0.01,0) [0|1] "NA"  ACM
 SG_ OBJ_Fusion_Source_32 : 64|16@1+ (1,0) [0|65535] "BITWIZE"  ACM
 SG_ OBJ_Triggered_SDM_32 : 80|2@1+ (1,0) [0|2] "ENUM"  ACM
 SG_ OBJ_Motion_Category_32 : 82|4@1+ (1,0) [0|13] "ENUM "  ACM
 SG_ OBJ_Moving_IN_Probability_32 : 86|7@1+ (0.01,0) [0|0] "NA"  ACM
 SG_ OBJ_Object_Age_32 : 93|11@1+ (1,0) [0|2047] "Frame"  ACM
 SG_ OBJ_Measuring_Status_32 : 104|3@1+ (1,0) [0|7] "BITWIZE"  ACM
 SG_ OBJ_Object_Class_32 : 107|4@1+ (1,0) [0|8] "ENUM"  ACM
 SG_ OBJ_Class_Probability_32 : 112|7@1+ (0.01,0) [0|1] "NA"  ACM
 SG_ OBJ_Car_Probability_32 : 119|7@1+ (0.01,0) [0|0] "NA"  ACM
 SG_ OBJ_Truck_Probability_32 : 126|7@1+ (0.01,0) [0|0] "NA"  ACM
 SG_ OBJ_Bike_Probability_32 : 133|7@1+ (0.01,0) [0|0] "NA"  ACM
 SG_ OBJ_Camera_Source_32 : 140|4@1+ (1,0) [0|15] "ENUM"  ACM
 SG_ OBJ_Motion_Status_32 : 144|3@1+ (1,0) [0|5] "ENUM "  ACM
 SG_ OBJ_Motion_Orientation_32 : 147|4@1+ (1,0) [0|13] "ENUM "  ACM
 SG_ OBJ_Has_Cut_Lane_32 : 151|1@1+ (1,0) [0|1] "bool"  ACM
 SG_ OBJ_Has_Cut_Path_32 : 152|1@1+ (1,0) [0|1] "bool"  ACM
 SG_ OBJ_Brake_Light_32 : 153|1@1+ (1,0) [0|1] "bool"  ACM
 SG_ OBJ_Turn_Indicator_Right_32 : 154|1@1+ (1,0) [0|1] "bool"  ACM
 SG_ OBJ_Turn_Indicator_Left_32 : 155|1@1+ (1,0) [0|1] "bool"  ACM
 SG_ OBJ_Light_Indicator_Validity_32 : 156|1@1+ (1,0) [0|1] "bool"  ACM
 SG_ OBJ_Right_Out_Of_Image_32 : 157|1@1+ (1,0) [0|1] "bool"  ACM
 SG_ OBJ_Left_Out_Of_Image_32 : 158|1@1+ (1,0) [0|1] "bool"  ACM
 SG_ OBJ_Right_Out_Of_Image_V_32 : 159|1@1+ (1,0) [0|1] "bool"  ACM
 SG_ OBJ_Left_Out_Of_Image_V_32 : 160|1@1+ (1,0) [0|1] "bool"  ACM
 SG_ OBJ_Top_Out_Of_Image_32 : 161|1@1+ (1,0) [0|1] "bool"  ACM
 SG_ OBJ_Bottom_Out_Of_Image_32 : 162|1@1+ (1,0) [0|1] "bool"  ACM
 SG_ OBJ_Top_Out_Of_Image_V_32 : 163|1@1+ (1,0) [0|1] "bool"  ACM
 SG_ OBJ_Bottom_Out_Of_Image_V_32 : 164|1@1+ (1,0) [0|1] "bool"  ACM
 SG_ OBJ_Lane_Assignment_32 : 165|3@1+ (1,0) [0|5] "ENUM"  ACM
 SG_ OBJ_Lane_Assignment_V_32 : 168|1@1+ (1,0) [0|1] "bool"  ACM
 SG_ OBJ_Age_Seconds_32 : 169|7@1+ (1,0) [0|100] "s"  ACM
 SG_ OBJ_Age_Seconds_V_32 : 176|1@1+ (1,0) [0|1] "bool"  ACM
 SG_ OBJ_Width_32 : 177|9@1+ (0.01,0) [0.4|2.95] "m"  ACM
 SG_ OBJ_Width_V_32 : 186|1@1+ (1,0) [0|1] "bool"  ACM
 SG_ OBJ_Width_STD_32 : 187|8@1+ (0.01,0) [0|2] "m"  ACM
 SG_ OBJ_Width_STD_V_32 : 195|1@1+ (1,0) [0|1] "bool"  ACM
 SG_ OBJ_Length_32 : 196|9@1+ (0.05,0) [1.2|21] "m"  ACM
 SG_ OBJ_Length_V_32 : 205|1@1+ (1,0) [0|1] "bool"  ACM
 SG_ OBJ_Length_STD_32 : 208|8@1+ (0.05,0) [0|10] "m"  ACM
 SG_ OBJ_Length_STD_V_32 : 216|1@1+ (1,0) [0|1] "bool"  ACM
 SG_ OBJ_Height_32 : 217|9@1+ (0.01,0) [0|2.95] "m"  ACM
 SG_ OBJ_Height_V_32 : 226|1@1+ (1,0) [0|1] "bool"  ACM
 SG_ OBJ_Height_STD_32 : 227|8@1+ (0.01,0) [0|2] "m"  ACM
 SG_ OBJ_Height_STD_V_32 : 235|1@1+ (1,0) [0|1] "bool"  ACM
 SG_ OBJ_Abs_Long_Velocity_32 : 240|12@1+ (0.05,-30) [-30|100] "MPS"  ACM
 SG_ OBJ_Abs_Long_Velocity_V_32 : 252|1@1+ (1,0) [0|1] "bool"  ACM
 SG_ OBJ_Abs_Long_Velocity_STD_32 : 253|11@1+ (0.05,0) [0|65] "MPS"  ACM
 SG_ OBJ_Abs_Long_Vel_STD_V_32 : 264|1@1+ (1,0) [0|1] "bool"  ACM
 SG_ OBJ_Abs_Lat_Velocity_32 : 272|11@1+ (0.05,-50) [-50|50] "MPS"  ACM
 SG_ OBJ_Abs_Lat_Velocity_V_32 : 283|1@1+ (1,0) [0|1] "bool"  ACM
 SG_ OBJ_Abs_Lat_Velocity_STD_32 : 284|10@1+ (0.05,0) [0|50] "MPS"  ACM
 SG_ OBJ_Abs_Lat_Vel_STD_V_32 : 294|1@1+ (1,0) [0|1] "bool"  ACM
 SG_ OBJ_Abs_Long_Acc_32 : 295|9@1+ (0.05,-10.3) [-10.3|7.3] "MPS2"  ACM
 SG_ OBJ_Abs_Long_Acc_V_32 : 304|1@1+ (1,0) [0|1] "bool"  ACM
 SG_ OBJ_Abs_Long_Acc_STD_32 : 305|8@1+ (0.05,0) [0|7.3] "MPS2"  ACM
 SG_ OBJ_Abs_Long_Acc_STD_V_32 : 313|1@1+ (1,0) [0|1] "bool"  ACM
 SG_ OBJ_Abs_Lat_Acc_32 : 314|9@1+ (0.05,-10.3) [-10.3|7.3] "MPS2"  ACM
 SG_ OBJ_Abs_Lat_Acc_V_32 : 323|1@1+ (1,0) [0|1] "bool"  ACM
 SG_ OBJ_Abs_Lat_Acc_STD_32 : 324|8@1+ (0.05,0) [0|7.3] "MPS2"  ACM
 SG_ OBJ_Abs_Lat_Acc_STD_V_32 : 332|1@1+ (1,0) [0|1] "bool"  ACM
 SG_ OBJ_Abs_Acceleration_32 : 336|9@1+ (0.05,-10.3) [-10.3|7.3] "MPS2"  ACM
 SG_ OBJ_Abs_Acceleration_V_32 : 345|1@1+ (1,0) [0|1] "bool"  ACM
 SG_ OBJ_Abs_Acc_STD_32 : 346|8@1+ (0.05,0) [0|7.3] "MPS2"  ACM
 SG_ OBJ_Abs_Acc_STD_V_32 : 354|1@1+ (1,0) [0|1] "bool"  ACM
 SG_ OBJ_Inv_TTC_32 : 355|11@1+ (0.01,-8) [-8|8] "INV(s)"  ACM
 SG_ OBJ_Inv_TTC_V_32 : 366|1@1+ (1,0) [0|1] "bool"  ACM
 SG_ OBJ_Inv_TTC_STD_32 : 368|11@1+ (0.01,0) [0|4] "INV(s)"  ACM
 SG_ OBJ_Inv_TTC_STD_V_32 : 379|1@1+ (1,0) [0|1] "bool"  ACM
 SG_ OBJ_Relative_Long_Acc_32 : 380|9@1+ (0.05,-10.3) [-10.3|7.3] "MPS2"  ACM
 SG_ OBJ_Relative_Long_Acc_V_32 : 389|1@1+ (1,0) [0|1] "bool"  ACM
 SG_ OBJ_Relative_Long_Acc_STD_32 : 390|8@1+ (0.05,0) [0|7.3] "MPS2"  ACM
 SG_ OBJ_Rel_Long_Acc_STD_V_32 : 398|1@1+ (1,0) [0|1] "bool"  ACM

BO_ 208 ICM_Object_Prot31_B: 64 MyECU
 SG_ ICM_Object_Prot31_B_Header : 0|16@1+ (1,0) [0|65535] ""  ACM
 SG_ OBJ_Relative_Long_Velocity_31 : 16|13@1+ (0.05,-120) [-120|130] "MPS"  ACM
 SG_ OBJ_Relative_Long_Velocity_V_31 : 29|1@1+ (1,0) [0|1] "bool"  ACM
 SG_ OBJ_Relative_Long_Vel_STD_31 : 30|12@1+ (0.05,0) [0|130] "MPS"  ACM
 SG_ OBJ_Rel_Long_Vel_STD_V_31 : 42|1@1+ (1,0) [0|1] "bool"  ACM
 SG_ OBJ_Relative_Lat_Velocity_31 : 48|11@1+ (0.05,-50) [-50|50] "MPS"  ACM
 SG_ OBJ_Relative_Lat_Velocity_V_31 : 59|1@1+ (1,0) [0|1] "bool"  ACM
 SG_ OBJ_Relative_Lat_Velocity_STD_31 : 60|10@1+ (0.05,0) [0|50] "MPS"  ACM
 SG_ OBJ_Rel_Lat_Vel_STD_V_31 : 70|1@1+ (1,0) [0|1] "bool"  ACM
 SG_ OBJ_Long_Distance_31 : 80|14@1+ (0.05,-200) [-200|250] "m"  ACM
 SG_ OBJ_Long_Distance_V_31 : 94|1@1+ (1,0) [0|1] "bool"  ACM
 SG_ OBJ_Long_Distance_STD_31 : 95|13@1+ (0.05,0) [0|250] "m"  ACM
 SG_ OBJ_Long_Distance_STD_V_31 : 108|1@1+ (1,0) [0|1] "bool"  ACM
 SG_ OBJ_Lat_Distance_31 : 112|12@1+ (0.05,-100) [-100|100] "m"  ACM
 SG_ OBJ_Lat_Distance_V_31 : 124|1@1+ (1,0) [0|1] "bool"  ACM
 SG_ OBJ_Lat_Distance_STD_31 : 125|11@1+ (0.05,0) [0|100] "m"  ACM
 SG_ OBJ_Lat_Distance_STD_V_31 : 136|1@1+ (1,0) [0|1] "bool"  ACM
 SG_ OBJ_Absolute_Speed_31 : 144|12@1+ (0.05,-65) [-65|65] "MPS"  ACM
 SG_ OBJ_Absolute_Speed_V_31 : 156|1@1+ (1,0) [0|1] "bool"  ACM
 SG_ OBJ_Absolute_Speed_STD_31 : 157|11@1+ (0.05,-65) [0|65] "MPS"  ACM
 SG_ OBJ_Absolute_Speed_STD_V_31 : 168|1@1+ (1,0) [0|1] "bool"  ACM
 SG_ OBJ_Heading_31 : 176|10@1+ (0.01,-3.14) [-3.14|3.14] "rad"  ACM
 SG_ OBJ_Heading_V_31 : 186|1@1+ (1,0) [0|1] "bool"  ACM
 SG_ OBJ_Heading_STD_31 : 187|9@1+ (0.01,0) [0|3.14] "rad"  ACM
 SG_ OBJ_Heading_STD_V_31 : 196|1@1+ (1,0) [0|1] "bool"  ACM
 SG_ OBJ_Angle_Rate_STD_31 : 197|11@1+ (0.002,0) [0|2.2318] "RPS"  ACM
 SG_ OBJ_Angle_Rate_STD_V_31 : 208|1@1+ (1,0) [0|1] "bool"  ACM
 SG_ OBJ_Angle_Rate_31 : 209|12@1+ (0.002,-2.234) [-2.234|2.2318] "RPS"  ACM
 SG_ OBJ_Angle_Rate_V_31 : 221|1@1+ (1,0) [0|1] "bool"  ACM
 SG_ OBJ_Angle_Right_31 : 222|14@1+ (0.0002,-1.571) [-1.571|1.571] "rad "  ACM
 SG_ OBJ_Angle_Right_V_31 : 236|1@1+ (1,0) [0|1] "bool"  ACM
 SG_ OBJ_Angle_Right_STD_31 : 240|13@1+ (0.0002,0) [0|1.571] "rad "  ACM
 SG_ OBJ_Angle_Right_STD_V_31 : 253|1@1+ (1,0) [0|1] "bool"  ACM
 SG_ OBJ_Angle_Left_31 : 254|14@1+ (0.0002,-1.571) [-1.571|1.571] "rad "  ACM
 SG_ OBJ_Angle_Left_V_31 : 268|1@1+ (1,0) [0|1] "bool"  ACM
 SG_ OBJ_Angle_Left_STD_31 : 272|13@1+ (0.0002,0) [0|1.571] "rad"  ACM
 SG_ OBJ_Angle_Left_STD_V_31 : 285|1@1+ (1,0) [0|1] "bool"  ACM
 SG_ OBJ_Angle_Side_31 : 286|14@1+ (0.0002,-1.571) [-1.571|1.571] "rad"  ACM
 SG_ OBJ_Angle_Side_V_31 : 300|1@1+ (1,0) [0|1] "bool"  ACM
 SG_ OBJ_Angle_Side_STD_31 : 304|13@1+ (0.0002,0) [0|1.571] "rad"  ACM
 SG_ OBJ_Angle_Side_STD_V_31 : 317|1@1+ (1,0) [0|1] "bool"  ACM
 SG_ OBJ_Angle_Mid_V_31 : 318|1@1+ (1,0) [0|1] "bool"  ACM
 SG_ OBJ_Angle_Mid_31 : 319|14@1+ (0.0002,-1.571) [-1.571|1.571] "rad"  ACM
 SG_ OBJ_Angle_Mid_STD_31 : 336|13@1+ (0.0002,0) [0|1.571] "rad"  ACM
 SG_ OBJ_Angle_Mid_STD_V_31 : 349|1@1+ (1,0) [0|1] "bool"  ACM
 SG_ OBJ_Angle_Bottom_V_31 : 350|1@1+ (1,0) [0|1] "bool"  ACM
 SG_ OBJ_Angle_Bottom_31 : 351|14@1+ (0.0002,-1.571) [-1.571|1.571] "rad"  ACM
 SG_ OBJ_Angle_Bottom_STD_31 : 368|13@1+ (0.0002,0) [0|1.571] "rad"  ACM
 SG_ OBJ_Angle_Bottom_STD_V_31 : 381|1@1+ (1,0) [0|1] "bool"  ACM
 SG_ OBJ_Visibility_Side_V_31 : 382|1@1+ (1,0) [0|1] "bool"  ACM
 SG_ OBJ_Visibility_Side_31 : 383|2@1+ (1,0) [0|2] "ENUM"  ACM
 SG_ OBJ_Is_In_Drivable_Area_31 : 385|1@1+ (1,0) [0|1] "bool"  ACM
 SG_ OBJ_Is_In_Drivable_Area_V_31 : 386|1@1+ (1,0) [0|1] "bool"  ACM
 SG_ OBJ_Is_VeryClose_31 : 387|1@1+ (1,0) [0|1] "bool"  ACM
 SG_ OBJ_Is_VeryClose_V_31 : 388|1@1+ (1,0) [0|1] "bool"  ACM
 SG_ OBJ_Buffer_31 : 389|11@1+ (1,0) [0|0] "NA"  ACM

BO_ 207 ICM_Object_Prot31_A: 64 MyECU
 SG_ ICM_Object_Prot31_A_Header : 0|16@1+ (1,0) [0|65535] ""  ACM
 SG_ OBJ_CRC_31 : 16|32@1+ (1,0) [0|4294967295] "NA"  ACM
 SG_ OBJ_ID_31 : 48|8@1+ (1,0) [0|255] "NA"  ACM
 SG_ OBJ_Existence_Probability_31 : 56|8@1+ (0.01,0) [0|1] "NA"  ACM
 SG_ OBJ_Fusion_Source_31 : 64|16@1+ (1,0) [0|65535] "BITWIZE"  ACM
 SG_ OBJ_Triggered_SDM_31 : 80|2@1+ (1,0) [0|2] "ENUM"  ACM
 SG_ OBJ_Motion_Category_31 : 82|4@1+ (1,0) [0|13] "ENUM "  ACM
 SG_ OBJ_Moving_IN_Probability_31 : 86|7@1+ (0.01,0) [0|0] "NA"  ACM
 SG_ OBJ_Object_Age_31 : 93|11@1+ (1,0) [0|2047] "Frame"  ACM
 SG_ OBJ_Measuring_Status_31 : 104|3@1+ (1,0) [0|7] "BITWIZE"  ACM
 SG_ OBJ_Object_Class_31 : 107|4@1+ (1,0) [0|8] "ENUM"  ACM
 SG_ OBJ_Class_Probability_31 : 112|7@1+ (0.01,0) [0|1] "NA"  ACM
 SG_ OBJ_Car_Probability_31 : 119|7@1+ (0.01,0) [0|0] "NA"  ACM
 SG_ OBJ_Truck_Probability_31 : 126|7@1+ (0.01,0) [0|0] "NA"  ACM
 SG_ OBJ_Bike_Probability_31 : 133|7@1+ (0.01,0) [0|0] "NA"  ACM
 SG_ OBJ_Camera_Source_31 : 140|4@1+ (1,0) [0|15] "ENUM"  ACM
 SG_ OBJ_Motion_Status_31 : 144|3@1+ (1,0) [0|5] "ENUM "  ACM
 SG_ OBJ_Motion_Orientation_31 : 147|4@1+ (1,0) [0|13] "ENUM "  ACM
 SG_ OBJ_Has_Cut_Lane_31 : 151|1@1+ (1,0) [0|1] "bool"  ACM
 SG_ OBJ_Has_Cut_Path_31 : 152|1@1+ (1,0) [0|1] "bool"  ACM
 SG_ OBJ_Brake_Light_31 : 153|1@1+ (1,0) [0|1] "bool"  ACM
 SG_ OBJ_Turn_Indicator_Right_31 : 154|1@1+ (1,0) [0|1] "bool"  ACM
 SG_ OBJ_Turn_Indicator_Left_31 : 155|1@1+ (1,0) [0|1] "bool"  ACM
 SG_ OBJ_Light_Indicator_Validity_31 : 156|1@1+ (1,0) [0|1] "bool"  ACM
 SG_ OBJ_Right_Out_Of_Image_31 : 157|1@1+ (1,0) [0|1] "bool"  ACM
 SG_ OBJ_Left_Out_Of_Image_31 : 158|1@1+ (1,0) [0|1] "bool"  ACM
 SG_ OBJ_Right_Out_Of_Image_V_31 : 159|1@1+ (1,0) [0|1] "bool"  ACM
 SG_ OBJ_Left_Out_Of_Image_V_31 : 160|1@1+ (1,0) [0|1] "bool"  ACM
 SG_ OBJ_Top_Out_Of_Image_31 : 161|1@1+ (1,0) [0|1] "bool"  ACM
 SG_ OBJ_Bottom_Out_Of_Image_31 : 162|1@1+ (1,0) [0|1] "bool"  ACM
 SG_ OBJ_Top_Out_Of_Image_V_31 : 164|1@1+ (1,0) [0|1] "bool"  ACM
 SG_ OBJ_Bottom_Out_Of_Image_V_31 : 163|1@1+ (1,0) [0|1] "bool"  ACM
 SG_ OBJ_Lane_Assignment_31 : 165|3@1+ (1,0) [0|5] "ENUM"  ACM
 SG_ OBJ_Lane_Assignment_V_31 : 168|1@1+ (1,0) [0|1] "bool"  ACM
 SG_ OBJ_Age_Seconds_31 : 169|7@1+ (1,0) [0|100] "s"  ACM
 SG_ OBJ_Age_Seconds_V_31 : 176|1@1+ (1,0) [0|1] "bool"  ACM
 SG_ OBJ_Width_31 : 177|9@1+ (0.01,0) [0.4|2.95] "m"  ACM
 SG_ OBJ_Width_V_31 : 186|1@1+ (1,0) [0|1] "bool"  ACM
 SG_ OBJ_Width_STD_31 : 187|8@1+ (0.01,0) [0|2] "m"  ACM
 SG_ OBJ_Width_STD_V_31 : 195|1@1+ (1,0) [0|1] "bool"  ACM
 SG_ OBJ_Length_31 : 196|9@1+ (0.05,0) [1.2|21] "m"  ACM
 SG_ OBJ_Length_V_31 : 205|1@1+ (1,0) [0|1] "bool"  ACM
 SG_ OBJ_Length_STD_31 : 208|8@1+ (0.05,0) [0|10] "m"  ACM
 SG_ OBJ_Length_STD_V_31 : 216|1@1+ (1,0) [0|1] "bool"  ACM
 SG_ OBJ_Height_31 : 217|9@1+ (0.01,0) [0|2.95] "m"  ACM
 SG_ OBJ_Height_V_31 : 226|1@1+ (1,0) [0|1] "bool"  ACM
 SG_ OBJ_Height_STD_31 : 227|8@1+ (0.01,0) [0|2] "m"  ACM
 SG_ OBJ_Height_STD_V_31 : 235|1@1+ (1,0) [0|1] "bool"  ACM
 SG_ OBJ_Abs_Long_Velocity_31 : 240|12@1+ (0.05,-30) [-30|100] "MPS"  ACM
 SG_ OBJ_Abs_Long_Velocity_V_31 : 252|1@1+ (1,0) [0|1] "bool"  ACM
 SG_ OBJ_Abs_Long_Velocity_STD_31 : 253|11@1+ (0.05,0) [0|65] "MPS"  ACM
 SG_ OBJ_Abs_Long_Vel_STD_V_31 : 264|1@1+ (1,0) [0|1] "bool"  ACM
 SG_ OBJ_Abs_Lat_Velocity_31 : 272|11@1+ (0.05,-50) [-50|50] "MPS"  ACM
 SG_ OBJ_Abs_Lat_Velocity_V_31 : 283|1@1+ (1,0) [0|1] "bool"  ACM
 SG_ OBJ_Abs_Lat_Velocity_STD_31 : 284|10@1+ (0.05,0) [0|50] "MPS"  ACM
 SG_ OBJ_Abs_Lat_Vel_STD_V_31 : 294|1@1+ (1,0) [0|1] "bool"  ACM
 SG_ OBJ_Abs_Long_Acc_31 : 295|9@1+ (0.05,-10.3) [-10.3|7.3] "MPS2"  ACM
 SG_ OBJ_Abs_Long_Acc_V_31 : 304|1@1+ (1,0) [0|1] "bool"  ACM
 SG_ OBJ_Abs_Long_Acc_STD_31 : 305|8@1+ (0.05,0) [0|7.3] "MPS2"  ACM
 SG_ OBJ_Abs_Long_Acc_STD_V_31 : 313|1@1+ (1,0) [0|1] "bool"  ACM
 SG_ OBJ_Abs_Lat_Acc_31 : 314|9@1+ (0.05,-10.3) [-10.3|7.3] "MPS2"  ACM
 SG_ OBJ_Abs_Lat_Acc_V_31 : 323|1@1+ (1,0) [0|1] "bool"  ACM
 SG_ OBJ_Abs_Lat_Acc_STD_31 : 324|8@1+ (0.05,0) [0|7.3] "MPS2"  ACM
 SG_ OBJ_Abs_Lat_Acc_STD_V_31 : 332|1@1+ (1,0) [0|1] "bool"  ACM
 SG_ OBJ_Abs_Acceleration_31 : 336|9@1+ (0.05,-10.3) [-10.3|7.3] "MPS2"  ACM
 SG_ OBJ_Abs_Acceleration_V_31 : 345|1@1+ (1,0) [0|1] "bool"  ACM
 SG_ OBJ_Abs_Acc_STD_31 : 346|8@1+ (0.05,0) [0|7.3] "MPS2"  ACM
 SG_ OBJ_Abs_Acc_STD_V_31 : 354|1@1+ (1,0) [0|1] "bool"  ACM
 SG_ OBJ_Inv_TTC_31 : 355|11@1+ (0.01,-8) [-8|8] "INV(s)"  ACM
 SG_ OBJ_Inv_TTC_V_31 : 366|1@1+ (1,0) [0|1] "bool"  ACM
 SG_ OBJ_Inv_TTC_STD_31 : 368|11@1+ (0.01,0) [0|4] "INV(s)"  ACM
 SG_ OBJ_Inv_TTC_STD_V_31 : 379|1@1+ (1,0) [0|1] "bool"  ACM
 SG_ OBJ_Relative_Long_Acc_31 : 380|9@1+ (0.05,-10.3) [-10.3|7.3] "MPS2"  ACM
 SG_ OBJ_Relative_Long_Acc_V_31 : 389|1@1+ (1,0) [0|1] "bool"  ACM
 SG_ OBJ_Relative_Long_Acc_STD_31 : 390|8@1+ (0.05,0) [0|7.3] "MPS2"  ACM
 SG_ OBJ_Rel_Long_Acc_STD_V_31 : 398|1@1+ (1,0) [0|1] "bool"  ACM

BO_ 206 ICM_Object_Prot30_B: 64 MyECU
 SG_ ICM_Object_Prot30_B_Header : 0|16@1+ (1,0) [0|65535] ""  ACM
 SG_ OBJ_Relative_Long_Velocity_30 : 16|13@1+ (0.05,-120) [-120|130] "MPS"  ACM
 SG_ OBJ_Relative_Long_Velocity_V_30 : 29|1@1+ (1,0) [0|1] "bool"  ACM
 SG_ OBJ_Relative_Long_Vel_STD_30 : 30|12@1+ (0.05,0) [0|130] "MPS"  ACM
 SG_ OBJ_Rel_Long_Vel_STD_V_30 : 42|1@1+ (1,0) [0|1] "bool"  ACM
 SG_ OBJ_Relative_Lat_Velocity_30 : 48|11@1+ (0.05,-50) [-50|50] "MPS"  ACM
 SG_ OBJ_Relative_Lat_Velocity_V_30 : 59|1@1+ (1,0) [0|1] "bool"  ACM
 SG_ OBJ_Relative_Lat_Velocity_STD_30 : 60|10@1+ (0.05,0) [0|50] "MPS"  ACM
 SG_ OBJ_Rel_Lat_Vel_STD_V_30 : 70|1@1+ (1,0) [0|1] "bool"  ACM
 SG_ OBJ_Long_Distance_30 : 80|14@1+ (0.05,-200) [-200|250] "m"  ACM
 SG_ OBJ_Long_Distance_V_30 : 94|1@1+ (1,0) [0|1] "bool"  ACM
 SG_ OBJ_Long_Distance_STD_30 : 95|13@1+ (0.05,0) [0|250] "m"  ACM
 SG_ OBJ_Long_Distance_STD_V_30 : 108|1@1+ (1,0) [0|1] "bool"  ACM
 SG_ OBJ_Lat_Distance_30 : 112|12@1+ (0.05,-100) [-100|100] "m"  ACM
 SG_ OBJ_Lat_Distance_V_30 : 124|1@1+ (1,0) [0|1] "bool"  ACM
 SG_ OBJ_Lat_Distance_STD_30 : 125|11@1+ (0.05,0) [0|100] "m"  ACM
 SG_ OBJ_Lat_Distance_STD_V_30 : 136|1@1+ (1,0) [0|1] "bool"  ACM
 SG_ OBJ_Absolute_Speed_30 : 144|12@1+ (0.05,-65) [-65|65] "MPS"  ACM
 SG_ OBJ_Absolute_Speed_V_30 : 156|1@1+ (1,0) [0|1] "bool"  ACM
 SG_ OBJ_Absolute_Speed_STD_30 : 157|11@1+ (0.05,-65) [0|65] "MPS"  ACM
 SG_ OBJ_Absolute_Speed_STD_V_30 : 168|1@1+ (1,0) [0|1] "bool"  ACM
 SG_ OBJ_Heading_30 : 176|10@1+ (0.01,-3.14) [-3.14|3.14] "rad"  ACM
 SG_ OBJ_Heading_V_30 : 186|1@1+ (1,0) [0|1] "bool"  ACM
 SG_ OBJ_Heading_STD_30 : 187|9@1+ (0.01,0) [0|3.14] "rad"  ACM
 SG_ OBJ_Heading_STD_V_30 : 196|1@1+ (1,0) [0|1] "bool"  ACM
 SG_ OBJ_Angle_Rate_STD_30 : 197|11@1+ (0.002,0) [0|2.2318] "RPS"  ACM
 SG_ OBJ_Angle_Rate_STD_V_30 : 208|1@1+ (1,0) [0|1] "bool"  ACM
 SG_ OBJ_Angle_Rate_30 : 209|12@1+ (0.002,-2.234) [-2.234|2.2318] "RPS"  ACM
 SG_ OBJ_Angle_Rate_V_30 : 221|1@1+ (1,0) [0|1] "bool"  ACM
 SG_ OBJ_Angle_Right_30 : 222|14@1+ (0.0002,-1.571) [-1.571|1.571] "rad "  ACM
 SG_ OBJ_Angle_Right_V_30 : 236|1@1+ (1,0) [0|1] "bool"  ACM
 SG_ OBJ_Angle_Right_STD_30 : 240|13@1+ (0.0002,0) [0|1.571] "rad "  ACM
 SG_ OBJ_Angle_Right_STD_V_30 : 253|1@1+ (1,0) [0|1] "bool"  ACM
 SG_ OBJ_Angle_Left_30 : 254|14@1+ (0.0002,-1.571) [-1.571|1.571] "rad "  ACM
 SG_ OBJ_Angle_Left_V_30 : 268|1@1+ (1,0) [0|1] "bool"  ACM
 SG_ OBJ_Angle_Left_STD_30 : 272|13@1+ (0.0002,0) [0|1.571] "rad"  ACM
 SG_ OBJ_Angle_Left_STD_V_30 : 285|1@1+ (1,0) [0|1] "bool"  ACM
 SG_ OBJ_Angle_Side_30 : 286|14@1+ (0.0002,-1.571) [-1.571|1.571] "rad"  ACM
 SG_ OBJ_Angle_Side_V_30 : 300|1@1+ (1,0) [0|1] "bool"  ACM
 SG_ OBJ_Angle_Side_STD_30 : 304|13@1+ (0.0002,0) [0|1.571] "rad"  ACM
 SG_ OBJ_Angle_Side_STD_V_30 : 317|1@1+ (1,0) [0|1] "bool"  ACM
 SG_ OBJ_Angle_Mid_V_30 : 318|1@1+ (1,0) [0|1] "bool"  ACM
 SG_ OBJ_Angle_Mid_30 : 319|14@1+ (0.0002,-1.571) [-1.571|1.571] "rad"  ACM
 SG_ OBJ_Angle_Mid_STD_30 : 336|13@1+ (0.0002,0) [0|1.571] "rad"  ACM
 SG_ OBJ_Angle_Mid_STD_V_30 : 349|1@1+ (1,0) [0|1] "bool"  ACM
 SG_ OBJ_Angle_Bottom_V_30 : 350|1@1+ (1,0) [0|1] "bool"  ACM
 SG_ OBJ_Angle_Bottom_30 : 351|14@1+ (0.0002,-1.571) [-1.571|1.571] "rad"  ACM
 SG_ OBJ_Angle_Bottom_STD_30 : 368|13@1+ (0.0002,0) [0|1.571] "rad"  ACM
 SG_ OBJ_Angle_Bottom_STD_V_30 : 381|1@1+ (1,0) [0|1] "bool"  ACM
 SG_ OBJ_Visibility_Side_V_30 : 382|1@1+ (1,0) [0|1] "bool"  ACM
 SG_ OBJ_Visibility_Side_30 : 383|2@1+ (1,0) [0|2] "ENUM"  ACM
 SG_ OBJ_Is_In_Drivable_Area_30 : 385|1@1+ (1,0) [0|1] "bool"  ACM
 SG_ OBJ_Is_In_Drivable_Area_V_30 : 386|1@1+ (1,0) [0|1] "bool"  ACM
 SG_ OBJ_Is_VeryClose_30 : 387|1@1+ (1,0) [0|1] "bool"  ACM
 SG_ OBJ_Is_VeryClose_V_30 : 388|1@1+ (1,0) [0|1] "bool"  ACM
 SG_ OBJ_Buffer_30 : 389|11@1+ (1,0) [0|0] "NA"  ACM

BO_ 205 ICM_Object_Prot30_A: 64 MyECU
 SG_ ICM_Object_Prot30_A_Header : 0|16@1+ (1,0) [0|65535] ""  ACM
 SG_ OBJ_CRC_30 : 16|32@1+ (1,0) [0|4294967295] "NA"  ACM
 SG_ OBJ_ID_30 : 48|8@1+ (1,0) [0|255] "NA"  ACM
 SG_ OBJ_Existence_Probability_30 : 56|8@1+ (0.01,0) [0|1] "NA"  ACM
 SG_ OBJ_Fusion_Source_30 : 64|16@1+ (1,0) [0|65535] "BITWIZE"  ACM
 SG_ OBJ_Triggered_SDM_30 : 80|2@1+ (1,0) [0|2] "ENUM"  ACM
 SG_ OBJ_Motion_Category_30 : 82|4@1+ (1,0) [0|13] "ENUM "  ACM
 SG_ OBJ_Moving_IN_Probability_30 : 86|7@1+ (0.01,0) [0|0] "NA"  ACM
 SG_ OBJ_Object_Age_30 : 93|11@1+ (1,0) [0|2047] "Frame"  ACM
 SG_ OBJ_Measuring_Status_30 : 104|3@1+ (1,0) [0|7] "BITWIZE"  ACM
 SG_ OBJ_Object_Class_30 : 107|4@1+ (1,0) [0|8] "ENUM"  ACM
 SG_ OBJ_Class_Probability_30 : 112|7@1+ (0.01,0) [0|1] "NA"  ACM
 SG_ OBJ_Car_Probability_30 : 119|7@1+ (0.01,0) [0|0] "NA"  ACM
 SG_ OBJ_Truck_Probability_30 : 126|7@1+ (0.01,0) [0|0] "NA"  ACM
 SG_ OBJ_Bike_Probability_30 : 133|7@1+ (0.01,0) [0|0] "NA"  ACM
 SG_ OBJ_Camera_Source_30 : 140|4@1+ (1,0) [0|15] "ENUM"  ACM
 SG_ OBJ_Motion_Status_30 : 144|3@1+ (1,0) [0|5] "ENUM "  ACM
 SG_ OBJ_Motion_Orientation_30 : 147|4@1+ (1,0) [0|13] "ENUM "  ACM
 SG_ OBJ_Has_Cut_Lane_30 : 151|1@1+ (1,0) [0|1] "bool"  ACM
 SG_ OBJ_Has_Cut_Path_30 : 152|1@1+ (1,0) [0|1] "bool"  ACM
 SG_ OBJ_Brake_Light_30 : 153|1@1+ (1,0) [0|1] "bool"  ACM
 SG_ OBJ_Turn_Indicator_Right_30 : 154|1@1+ (1,0) [0|1] "bool"  ACM
 SG_ OBJ_Turn_Indicator_Left_30 : 155|1@1+ (1,0) [0|1] "bool"  ACM
 SG_ OBJ_Light_Indicator_Validity_30 : 156|1@1+ (1,0) [0|1] "bool"  ACM
 SG_ OBJ_Right_Out_Of_Image_30 : 157|1@1+ (1,0) [0|1] "bool"  ACM
 SG_ OBJ_Left_Out_Of_Image_30 : 158|1@1+ (1,0) [0|1] "bool"  ACM
 SG_ OBJ_Right_Out_Of_Image_V_30 : 159|1@1+ (1,0) [0|1] "bool"  ACM
 SG_ OBJ_Left_Out_Of_Image_V_30 : 160|1@1+ (1,0) [0|1] "bool"  ACM
 SG_ OBJ_Top_Out_Of_Image_30 : 161|1@1+ (1,0) [0|1] "bool"  ACM
 SG_ OBJ_Bottom_Out_Of_Image_30 : 162|1@1+ (1,0) [0|1] "bool"  ACM
 SG_ OBJ_Top_Out_Of_Image_V_30 : 163|1@1+ (1,0) [0|1] "bool"  ACM
 SG_ OBJ_Bottom_Out_Of_Image_V_30 : 164|1@1+ (1,0) [0|1] "bool"  ACM
 SG_ OBJ_Lane_Assignment_30 : 165|3@1+ (1,0) [0|5] "ENUM"  ACM
 SG_ OBJ_Lane_Assignment_V_30 : 168|1@1+ (1,0) [0|1] "bool"  ACM
 SG_ OBJ_Age_Seconds_30 : 169|7@1+ (1,0) [0|100] "s"  ACM
 SG_ OBJ_Age_Seconds_V_30 : 176|1@1+ (1,0) [0|1] "bool"  ACM
 SG_ OBJ_Width_30 : 177|9@1+ (0.01,0) [0.4|2.95] "m"  ACM
 SG_ OBJ_Width_V_30 : 186|1@1+ (1,0) [0|1] "bool"  ACM
 SG_ OBJ_Width_STD_30 : 187|8@1+ (0.01,0) [0|2] "m"  ACM
 SG_ OBJ_Width_STD_V_30 : 195|1@1+ (1,0) [0|1] "bool"  ACM
 SG_ OBJ_Length_30 : 196|9@1+ (0.05,0) [1.2|21] "m"  ACM
 SG_ OBJ_Length_V_30 : 205|1@1+ (1,0) [0|1] "bool"  ACM
 SG_ OBJ_Length_STD_30 : 208|8@1+ (0.05,0) [0|10] "m"  ACM
 SG_ OBJ_Length_STD_V_30 : 216|1@1+ (1,0) [0|1] "bool"  ACM
 SG_ OBJ_Height_30 : 217|9@1+ (0.01,0) [0|2.95] "m"  ACM
 SG_ OBJ_Height_V_30 : 226|1@1+ (1,0) [0|1] "bool"  ACM
 SG_ OBJ_Height_STD_30 : 227|8@1+ (0.01,0) [0|2] "m"  ACM
 SG_ OBJ_Height_STD_V_30 : 235|1@1+ (1,0) [0|1] "bool"  ACM
 SG_ OBJ_Abs_Long_Velocity_30 : 240|12@1+ (0.05,-30) [-30|100] "MPS"  ACM
 SG_ OBJ_Abs_Long_Velocity_V_30 : 252|1@1+ (1,0) [0|1] "bool"  ACM
 SG_ OBJ_Abs_Long_Velocity_STD_30 : 253|11@1+ (0.05,0) [0|65] "MPS"  ACM
 SG_ OBJ_Abs_Long_Vel_STD_V_30 : 264|1@1+ (1,0) [0|1] "bool"  ACM
 SG_ OBJ_Abs_Lat_Velocity_30 : 272|11@1+ (0.05,-50) [-50|50] "MPS"  ACM
 SG_ OBJ_Abs_Lat_Velocity_V_30 : 283|1@1+ (1,0) [0|1] "bool"  ACM
 SG_ OBJ_Abs_Lat_Velocity_STD_30 : 284|10@1+ (0.05,0) [0|50] "MPS"  ACM
 SG_ OBJ_Abs_Lat_Vel_STD_V_30 : 294|1@1+ (1,0) [0|1] "bool"  ACM
 SG_ OBJ_Abs_Long_Acc_30 : 295|9@1+ (0.05,-10.3) [-10.3|7.3] "MPS2"  ACM
 SG_ OBJ_Abs_Long_Acc_V_30 : 304|1@1+ (1,0) [0|1] "bool"  ACM
 SG_ OBJ_Abs_Long_Acc_STD_30 : 305|8@1+ (0.05,0) [0|7.3] "MPS2"  ACM
 SG_ OBJ_Abs_Long_Acc_STD_V_30 : 313|1@1+ (1,0) [0|1] "bool"  ACM
 SG_ OBJ_Abs_Lat_Acc_30 : 314|9@1+ (0.05,-10.3) [-10.3|7.3] "MPS2"  ACM
 SG_ OBJ_Abs_Lat_Acc_V_30 : 323|1@1+ (1,0) [0|1] "bool"  ACM
 SG_ OBJ_Abs_Lat_Acc_STD_30 : 324|8@1+ (0.05,0) [0|7.3] "MPS2"  ACM
 SG_ OBJ_Abs_Lat_Acc_STD_V_30 : 332|1@1+ (1,0) [0|1] "bool"  ACM
 SG_ OBJ_Abs_Acceleration_30 : 336|9@1+ (0.05,-10.3) [-10.3|7.3] "MPS2"  ACM
 SG_ OBJ_Abs_Acceleration_V_30 : 345|1@1+ (1,0) [0|1] "bool"  ACM
 SG_ OBJ_Abs_Acc_STD_30 : 346|8@1+ (0.05,0) [0|7.3] "MPS2"  ACM
 SG_ OBJ_Abs_Acc_STD_V_30 : 354|1@1+ (1,0) [0|1] "bool"  ACM
 SG_ OBJ_Inv_TTC_30 : 355|11@1+ (0.01,-8) [-8|8] "INV(s)"  ACM
 SG_ OBJ_Inv_TTC_V_30 : 366|1@1+ (1,0) [0|1] "bool"  ACM
 SG_ OBJ_Inv_TTC_STD_30 : 368|11@1+ (0.01,0) [0|4] "INV(s)"  ACM
 SG_ OBJ_Inv_TTC_STD_V_30 : 379|1@1+ (1,0) [0|1] "bool"  ACM
 SG_ OBJ_Relative_Long_Acc_30 : 380|9@1+ (0.05,-10.3) [-10.3|7.3] "MPS2"  ACM
 SG_ OBJ_Relative_Long_Acc_V_30 : 389|1@1+ (1,0) [0|1] "bool"  ACM
 SG_ OBJ_Relative_Long_Acc_STD_30 : 390|8@1+ (0.05,0) [0|7.3] "MPS2"  ACM
 SG_ OBJ_Rel_Long_Acc_STD_V_30 : 398|1@1+ (1,0) [0|1] "bool"  ACM

BO_ 204 ICM_Object_Prot29_B: 64 MyECU
 SG_ ICM_Object_Prot29_B_Header : 0|16@1+ (1,0) [0|65535] ""  ACM
 SG_ OBJ_Relative_Long_Velocity_29 : 16|13@1+ (0.05,-120) [-120|130] "MPS"  ACM
 SG_ OBJ_Relative_Long_Velocity_V_29 : 29|1@1+ (1,0) [0|1] "bool"  ACM
 SG_ OBJ_Relative_Long_Vel_STD_29 : 30|12@1+ (0.05,0) [0|130] "MPS"  ACM
 SG_ OBJ_Rel_Long_Vel_STD_V_29 : 42|1@1+ (1,0) [0|1] "bool"  ACM
 SG_ OBJ_Relative_Lat_Velocity_29 : 48|11@1+ (0.05,-50) [-50|50] "MPS"  ACM
 SG_ OBJ_Relative_Lat_Velocity_V_29 : 59|1@1+ (1,0) [0|1] "bool"  ACM
 SG_ OBJ_Relative_Lat_Velocity_STD_29 : 60|10@1+ (0.05,0) [0|50] "MPS"  ACM
 SG_ OBJ_Rel_Lat_Vel_STD_V_29 : 70|1@1+ (1,0) [0|1] "bool"  ACM
 SG_ OBJ_Long_Distance_29 : 80|14@1+ (0.05,-200) [-200|250] "m"  ACM
 SG_ OBJ_Long_Distance_V_29 : 94|1@1+ (1,0) [0|1] "bool"  ACM
 SG_ OBJ_Long_Distance_STD_29 : 95|13@1+ (0.05,0) [0|250] "m"  ACM
 SG_ OBJ_Long_Distance_STD_V_29 : 108|1@1+ (1,0) [0|1] "bool"  ACM
 SG_ OBJ_Lat_Distance_29 : 112|12@1+ (0.05,-100) [-100|100] "m"  ACM
 SG_ OBJ_Lat_Distance_V_29 : 124|1@1+ (1,0) [0|1] "bool"  ACM
 SG_ OBJ_Lat_Distance_STD_29 : 125|11@1+ (0.05,0) [0|100] "m"  ACM
 SG_ OBJ_Lat_Distance_STD_V_29 : 136|1@1+ (1,0) [0|1] "bool"  ACM
 SG_ OBJ_Absolute_Speed_29 : 144|12@1+ (0.05,-65) [-65|65] "MPS"  ACM
 SG_ OBJ_Absolute_Speed_V_29 : 156|1@1+ (1,0) [0|1] "bool"  ACM
 SG_ OBJ_Absolute_Speed_STD_29 : 157|11@1+ (0.05,-65) [0|65] "MPS"  ACM
 SG_ OBJ_Absolute_Speed_STD_V_29 : 168|1@1+ (1,0) [0|1] "bool"  ACM
 SG_ OBJ_Heading_29 : 176|10@1+ (0.01,-3.14) [-3.14|3.14] "rad"  ACM
 SG_ OBJ_Heading_V_29 : 186|1@1+ (1,0) [0|1] "bool"  ACM
 SG_ OBJ_Heading_STD_29 : 187|9@1+ (0.01,0) [0|3.14] "rad"  ACM
 SG_ OBJ_Heading_STD_V_29 : 196|1@1+ (1,0) [0|1] "bool"  ACM
 SG_ OBJ_Angle_Rate_STD_29 : 197|11@1+ (0.002,0) [0|2.2318] "RPS"  ACM
 SG_ OBJ_Angle_Rate_STD_V_29 : 208|1@1+ (1,0) [0|1] "bool"  ACM
 SG_ OBJ_Angle_Rate_29 : 209|12@1+ (0.002,-2.234) [-2.234|2.2318] "RPS"  ACM
 SG_ OBJ_Angle_Rate_V_29 : 221|1@1+ (1,0) [0|1] "bool"  ACM
 SG_ OBJ_Angle_Right_29 : 222|14@1+ (0.0002,-1.571) [-1.571|1.571] "rad "  ACM
 SG_ OBJ_Angle_Right_V_29 : 236|1@1+ (1,0) [0|1] "bool"  ACM
 SG_ OBJ_Angle_Right_STD_29 : 240|13@1+ (0.0002,0) [0|1.571] "rad "  ACM
 SG_ OBJ_Angle_Right_STD_V_29 : 253|1@1+ (1,0) [0|1] "bool"  ACM
 SG_ OBJ_Angle_Left_29 : 254|14@1+ (0.0002,-1.571) [-1.571|1.571] "rad "  ACM
 SG_ OBJ_Angle_Left_V_29 : 268|1@1+ (1,0) [0|1] "bool"  ACM
 SG_ OBJ_Angle_Left_STD_29 : 272|13@1+ (0.0002,0) [0|1.571] "rad"  ACM
 SG_ OBJ_Angle_Left_STD_V_29 : 285|1@1+ (1,0) [0|1] "bool"  ACM
 SG_ OBJ_Angle_Side_29 : 286|14@1+ (0.0002,-1.571) [-1.571|1.571] "rad"  ACM
 SG_ OBJ_Angle_Side_V_29 : 300|1@1+ (1,0) [0|1] "bool"  ACM
 SG_ OBJ_Angle_Side_STD_29 : 304|13@1+ (0.0002,0) [0|1.571] "rad"  ACM
 SG_ OBJ_Angle_Side_STD_V_29 : 317|1@1+ (1,0) [0|1] "bool"  ACM
 SG_ OBJ_Angle_Mid_V_29 : 318|1@1+ (1,0) [0|1] "bool"  ACM
 SG_ OBJ_Angle_Mid_29 : 319|14@1+ (0.0002,-1.571) [-1.571|1.571] "rad"  ACM
 SG_ OBJ_Angle_Mid_STD_29 : 336|13@1+ (0.0002,0) [0|1.571] "rad"  ACM
 SG_ OBJ_Angle_Mid_STD_V_29 : 349|1@1+ (1,0) [0|1] "bool"  ACM
 SG_ OBJ_Angle_Bottom_V_29 : 350|1@1+ (1,0) [0|1] "bool"  ACM
 SG_ OBJ_Angle_Bottom_29 : 351|14@1+ (0.0002,-1.571) [-1.571|1.571] "rad"  ACM
 SG_ OBJ_Angle_Bottom_STD_29 : 368|13@1+ (0.0002,0) [0|1.571] "rad"  ACM
 SG_ OBJ_Angle_Bottom_STD_V_29 : 381|1@1+ (1,0) [0|1] "bool"  ACM
 SG_ OBJ_Visibility_Side_V_29 : 382|1@1+ (1,0) [0|1] "bool"  ACM
 SG_ OBJ_Visibility_Side_29 : 383|2@1+ (1,0) [0|2] "ENUM"  ACM
 SG_ OBJ_Is_In_Drivable_Area_29 : 385|1@1+ (1,0) [0|1] "bool"  ACM
 SG_ OBJ_Is_In_Drivable_Area_V_29 : 386|1@1+ (1,0) [0|1] "bool"  ACM
 SG_ OBJ_Is_VeryClose_29 : 387|1@1+ (1,0) [0|1] "bool"  ACM
 SG_ OBJ_Is_VeryClose_V_29 : 388|1@1+ (1,0) [0|1] "bool"  ACM
 SG_ OBJ_Buffer_29 : 389|11@1+ (1,0) [0|0] "NA"  ACM

BO_ 203 ICM_Object_Prot29_A: 64 MyECU
 SG_ ICM_Object_Prot29_A_Header : 0|16@1+ (1,0) [0|65535] ""  ACM
 SG_ OBJ_CRC_29 : 16|32@1+ (1,0) [0|4294967295] "NA"  ACM
 SG_ OBJ_ID_29 : 48|8@1+ (1,0) [0|255] "NA"  ACM
 SG_ OBJ_Existence_Probability_29 : 56|8@1+ (0.01,0) [0|1] "NA"  ACM
 SG_ OBJ_Fusion_Source_29 : 64|16@1+ (1,0) [0|65535] "BITWIZE"  ACM
 SG_ OBJ_Triggered_SDM_29 : 80|2@1+ (1,0) [0|2] "ENUM"  ACM
 SG_ OBJ_Motion_Category_29 : 82|4@1+ (1,0) [0|13] "ENUM "  ACM
 SG_ OBJ_Moving_IN_Probability_29 : 86|7@1+ (0.01,0) [0|0] "NA"  ACM
 SG_ OBJ_Object_Age_29 : 93|11@1+ (1,0) [0|2047] "Frame"  ACM
 SG_ OBJ_Measuring_Status_29 : 104|3@1+ (1,0) [0|7] "BITWIZE"  ACM
 SG_ OBJ_Object_Class_29 : 107|4@1+ (1,0) [0|8] "ENUM"  ACM
 SG_ OBJ_Class_Probability_29 : 112|7@1+ (0.01,0) [0|1] "NA"  ACM
 SG_ OBJ_Car_Probability_29 : 119|7@1+ (0.01,0) [0|0] "NA"  ACM
 SG_ OBJ_Truck_Probability_29 : 126|7@1+ (0.01,0) [0|0] "NA"  ACM
 SG_ OBJ_Bike_Probability_29 : 133|7@1+ (0.01,0) [0|0] "NA"  ACM
 SG_ OBJ_Camera_Source_29 : 140|4@1+ (1,0) [0|15] "ENUM"  ACM
 SG_ OBJ_Motion_Status_29 : 144|3@1+ (1,0) [0|5] "ENUM "  ACM
 SG_ OBJ_Motion_Orientation_29 : 147|4@1+ (1,0) [0|13] "ENUM "  ACM
 SG_ OBJ_Has_Cut_Lane_29 : 151|1@1+ (1,0) [0|1] "bool"  ACM
 SG_ OBJ_Has_Cut_Path_29 : 152|1@1+ (1,0) [0|1] "bool"  ACM
 SG_ OBJ_Brake_Light_29 : 153|1@1+ (1,0) [0|1] "bool"  ACM
 SG_ OBJ_Turn_Indicator_Right_29 : 154|1@1+ (1,0) [0|1] "bool"  ACM
 SG_ OBJ_Turn_Indicator_Left_29 : 155|1@1+ (1,0) [0|1] "bool"  ACM
 SG_ OBJ_Light_Indicator_Validity_29 : 156|1@1+ (1,0) [0|1] "bool"  ACM
 SG_ OBJ_Right_Out_Of_Image_29 : 157|1@1+ (1,0) [0|1] "bool"  ACM
 SG_ OBJ_Left_Out_Of_Image_29 : 158|1@1+ (1,0) [0|1] "bool"  ACM
 SG_ OBJ_Right_Out_Of_Image_V_29 : 159|1@1+ (1,0) [0|1] "bool"  ACM
 SG_ OBJ_Left_Out_Of_Image_V_29 : 160|1@1+ (1,0) [0|1] "bool"  ACM
 SG_ OBJ_Top_Out_Of_Image_29 : 161|1@1+ (1,0) [0|1] "bool"  ACM
 SG_ OBJ_Bottom_Out_Of_Image_29 : 162|1@1+ (1,0) [0|1] "bool"  ACM
 SG_ OBJ_Top_Out_Of_Image_V_29 : 163|1@1+ (1,0) [0|1] "bool"  ACM
 SG_ OBJ_Bottom_Out_Of_Image_V_29 : 164|1@1+ (1,0) [0|1] "bool"  ACM
 SG_ OBJ_Lane_Assignment_29 : 165|3@1+ (1,0) [0|5] "ENUM"  ACM
 SG_ OBJ_Lane_Assignment_V_29 : 168|1@1+ (1,0) [0|1] "bool"  ACM
 SG_ OBJ_Age_Seconds_29 : 169|7@1+ (1,0) [0|100] "s"  ACM
 SG_ OBJ_Age_Seconds_V_29 : 176|1@1+ (1,0) [0|1] "bool"  ACM
 SG_ OBJ_Width_29 : 177|9@1+ (0.01,0) [0.4|2.95] "m"  ACM
 SG_ OBJ_Width_V_29 : 186|1@1+ (1,0) [0|1] "bool"  ACM
 SG_ OBJ_Width_STD_29 : 187|8@1+ (0.01,0) [0|2] "m"  ACM
 SG_ OBJ_Width_STD_V_29 : 195|1@1+ (1,0) [0|1] "bool"  ACM
 SG_ OBJ_Length_29 : 196|9@1+ (0.05,0) [1.2|21] "m"  ACM
 SG_ OBJ_Length_V_29 : 205|1@1+ (1,0) [0|1] "bool"  ACM
 SG_ OBJ_Length_STD_29 : 208|8@1+ (0.05,0) [0|10] "m"  ACM
 SG_ OBJ_Length_STD_V_29 : 216|1@1+ (1,0) [0|1] "bool"  ACM
 SG_ OBJ_Height_29 : 217|9@1+ (0.01,0) [0|2.95] "m"  ACM
 SG_ OBJ_Height_V_29 : 226|1@1+ (1,0) [0|1] "bool"  ACM
 SG_ OBJ_Height_STD_29 : 227|8@1+ (0.01,0) [0|2] "m"  ACM
 SG_ OBJ_Height_STD_V_29 : 235|1@1+ (1,0) [0|1] "bool"  ACM
 SG_ OBJ_Abs_Long_Velocity_29 : 240|12@1+ (0.05,-30) [-30|100] "MPS"  ACM
 SG_ OBJ_Abs_Long_Velocity_V_29 : 252|1@1+ (1,0) [0|1] "bool"  ACM
 SG_ OBJ_Abs_Long_Velocity_STD_29 : 253|11@1+ (0.05,0) [0|65] "MPS"  ACM
 SG_ OBJ_Abs_Long_Vel_STD_V_29 : 264|1@1+ (1,0) [0|1] "bool"  ACM
 SG_ OBJ_Abs_Lat_Velocity_29 : 272|11@1+ (0.05,-50) [-50|50] "MPS"  ACM
 SG_ OBJ_Abs_Lat_Velocity_V_29 : 283|1@1+ (1,0) [0|1] "bool"  ACM
 SG_ OBJ_Abs_Lat_Velocity_STD_29 : 284|10@1+ (0.05,0) [0|50] "MPS"  ACM
 SG_ OBJ_Abs_Lat_Vel_STD_V_29 : 294|1@1+ (1,0) [0|1] "bool"  ACM
 SG_ OBJ_Abs_Long_Acc_29 : 295|9@1+ (0.05,-10.3) [-10.3|7.3] "MPS2"  ACM
 SG_ OBJ_Abs_Long_Acc_V_29 : 304|1@1+ (1,0) [0|1] "bool"  ACM
 SG_ OBJ_Abs_Long_Acc_STD_29 : 305|8@1+ (0.05,0) [0|7.3] "MPS2"  ACM
 SG_ OBJ_Abs_Long_Acc_STD_V_29 : 313|1@1+ (1,0) [0|1] "bool"  ACM
 SG_ OBJ_Abs_Lat_Acc_29 : 314|9@1+ (0.05,-10.3) [-10.3|7.3] "MPS2"  ACM
 SG_ OBJ_Abs_Lat_Acc_V_29 : 323|1@1+ (1,0) [0|1] "bool"  ACM
 SG_ OBJ_Abs_Lat_Acc_STD_29 : 324|8@1+ (0.05,0) [0|7.3] "MPS2"  ACM
 SG_ OBJ_Abs_Lat_Acc_STD_V_29 : 332|1@1+ (1,0) [0|1] "bool"  ACM
 SG_ OBJ_Abs_Acceleration_29 : 336|9@1+ (0.05,-10.3) [-10.3|7.3] "MPS2"  ACM
 SG_ OBJ_Abs_Acceleration_V_29 : 345|1@1+ (1,0) [0|1] "bool"  ACM
 SG_ OBJ_Abs_Acc_STD_29 : 346|8@1+ (0.05,0) [0|7.3] "MPS2"  ACM
 SG_ OBJ_Abs_Acc_STD_V_29 : 354|1@1+ (1,0) [0|1] "bool"  ACM
 SG_ OBJ_Inv_TTC_29 : 355|11@1+ (0.01,-8) [-8|8] "INV(s)"  ACM
 SG_ OBJ_Inv_TTC_V_29 : 366|1@1+ (1,0) [0|1] "bool"  ACM
 SG_ OBJ_Inv_TTC_STD_29 : 368|11@1+ (0.01,0) [0|4] "INV(s)"  ACM
 SG_ OBJ_Inv_TTC_STD_V_29 : 379|1@1+ (1,0) [0|1] "bool"  ACM
 SG_ OBJ_Relative_Long_Acc_29 : 380|9@1+ (0.05,-10.3) [-10.3|7.3] "MPS2"  ACM
 SG_ OBJ_Relative_Long_Acc_V_29 : 389|1@1+ (1,0) [0|1] "bool"  ACM
 SG_ OBJ_Relative_Long_Acc_STD_29 : 390|8@1+ (0.05,0) [0|7.3] "MPS2"  ACM
 SG_ OBJ_Rel_Long_Acc_STD_V_29 : 398|1@1+ (1,0) [0|1] "bool"  ACM

BO_ 202 ICM_Object_Prot28_B: 64 MyECU
 SG_ ICM_Object_Prot28_B_Header : 0|16@1+ (1,0) [0|65535] ""  ACM
 SG_ OBJ_Relative_Long_Velocity_28 : 16|13@1+ (0.05,-120) [-120|130] "MPS"  ACM
 SG_ OBJ_Relative_Long_Velocity_V_28 : 29|1@1+ (1,0) [0|1] "bool"  ACM
 SG_ OBJ_Relative_Long_Vel_STD_28 : 30|12@1+ (0.05,0) [0|130] "MPS"  ACM
 SG_ OBJ_Rel_Long_Vel_STD_V_28 : 42|1@1+ (1,0) [0|1] "bool"  ACM
 SG_ OBJ_Relative_Lat_Velocity_28 : 48|11@1+ (0.05,-50) [-50|50] "MPS"  ACM
 SG_ OBJ_Relative_Lat_Velocity_V_28 : 59|1@1+ (1,0) [0|1] "bool"  ACM
 SG_ OBJ_Relative_Lat_Velocity_STD_28 : 60|10@1+ (0.05,0) [0|50] "MPS"  ACM
 SG_ OBJ_Rel_Lat_Vel_STD_V_28 : 70|1@1+ (1,0) [0|1] "bool"  ACM
 SG_ OBJ_Long_Distance_28 : 80|14@1+ (0.05,-200) [-200|250] "m"  ACM
 SG_ OBJ_Long_Distance_V_28 : 94|1@1+ (1,0) [0|1] "bool"  ACM
 SG_ OBJ_Long_Distance_STD_28 : 95|13@1+ (0.05,0) [0|250] "m"  ACM
 SG_ OBJ_Long_Distance_STD_V_28 : 108|1@1+ (1,0) [0|1] "bool"  ACM
 SG_ OBJ_Lat_Distance_28 : 112|12@1+ (0.05,-100) [-100|100] "m"  ACM
 SG_ OBJ_Lat_Distance_V_28 : 124|1@1+ (1,0) [0|1] "bool"  ACM
 SG_ OBJ_Lat_Distance_STD_28 : 125|11@1+ (0.05,0) [0|100] "m"  ACM
 SG_ OBJ_Lat_Distance_STD_V_28 : 136|1@1+ (1,0) [0|1] "bool"  ACM
 SG_ OBJ_Absolute_Speed_28 : 144|12@1+ (0.05,-65) [-65|65] "MPS"  ACM
 SG_ OBJ_Absolute_Speed_V_28 : 156|1@1+ (1,0) [0|1] "bool"  ACM
 SG_ OBJ_Absolute_Speed_STD_28 : 157|11@1+ (0.05,-65) [0|65] "MPS"  ACM
 SG_ OBJ_Absolute_Speed_STD_V_28 : 168|1@1+ (1,0) [0|1] "bool"  ACM
 SG_ OBJ_Heading_28 : 176|10@1+ (0.01,-3.14) [-3.14|3.14] "rad"  ACM
 SG_ OBJ_Heading_V_28 : 186|1@1+ (1,0) [0|1] "bool"  ACM
 SG_ OBJ_Heading_STD_28 : 187|9@1+ (0.01,0) [0|3.14] "rad"  ACM
 SG_ OBJ_Heading_STD_V_28 : 196|1@1+ (1,0) [0|1] "bool"  ACM
 SG_ OBJ_Angle_Rate_STD_28 : 197|11@1+ (0.002,0) [0|2.2318] "RPS"  ACM
 SG_ OBJ_Angle_Rate_STD_V_28 : 208|1@1+ (1,0) [0|1] "bool"  ACM
 SG_ OBJ_Angle_Rate_28 : 209|12@1+ (0.002,-2.234) [-2.234|2.2318] "RPS"  ACM
 SG_ OBJ_Angle_Rate_V_28 : 221|1@1+ (1,0) [0|1] "bool"  ACM
 SG_ OBJ_Angle_Right_28 : 222|14@1+ (0.0002,-1.571) [-1.571|1.571] "rad "  ACM
 SG_ OBJ_Angle_Right_V_28 : 236|1@1+ (1,0) [0|1] "bool"  ACM
 SG_ OBJ_Angle_Right_STD_28 : 240|13@1+ (0.0002,0) [0|1.571] "rad "  ACM
 SG_ OBJ_Angle_Right_STD_V_28 : 253|1@1+ (1,0) [0|1] "bool"  ACM
 SG_ OBJ_Angle_Left_28 : 254|14@1+ (0.0002,-1.571) [-1.571|1.571] "rad "  ACM
 SG_ OBJ_Angle_Left_V_28 : 268|1@1+ (1,0) [0|1] "bool"  ACM
 SG_ OBJ_Angle_Left_STD_28 : 272|13@1+ (0.0002,0) [0|1.571] "rad"  ACM
 SG_ OBJ_Angle_Left_STD_V_28 : 285|1@1+ (1,0) [0|1] "bool"  ACM
 SG_ OBJ_Angle_Side_28 : 286|14@1+ (0.0002,-1.571) [-1.571|1.571] "rad"  ACM
 SG_ OBJ_Angle_Side_V_28 : 300|1@1+ (1,0) [0|1] "bool"  ACM
 SG_ OBJ_Angle_Side_STD_28 : 304|13@1+ (0.0002,0) [0|1.571] "rad"  ACM
 SG_ OBJ_Angle_Side_STD_V_28 : 317|1@1+ (1,0) [0|1] "bool"  ACM
 SG_ OBJ_Angle_Mid_V_28 : 318|1@1+ (1,0) [0|1] "bool"  ACM
 SG_ OBJ_Angle_Mid_28 : 319|14@1+ (0.0002,-1.571) [-1.571|1.571] "rad"  ACM
 SG_ OBJ_Angle_Mid_STD_28 : 336|13@1+ (0.0002,0) [0|1.571] "rad"  ACM
 SG_ OBJ_Angle_Mid_STD_V_28 : 349|1@1+ (1,0) [0|1] "bool"  ACM
 SG_ OBJ_Angle_Bottom_V_28 : 350|1@1+ (1,0) [0|1] "bool"  ACM
 SG_ OBJ_Angle_Bottom_28 : 351|14@1+ (0.0002,-1.571) [-1.571|1.571] "rad"  ACM
 SG_ OBJ_Angle_Bottom_STD_28 : 368|13@1+ (0.0002,0) [0|1.571] "rad"  ACM
 SG_ OBJ_Angle_Bottom_STD_V_28 : 381|1@1+ (1,0) [0|1] "bool"  ACM
 SG_ OBJ_Visibility_Side_V_28 : 382|1@1+ (1,0) [0|1] "bool"  ACM
 SG_ OBJ_Visibility_Side_28 : 383|2@1+ (1,0) [0|2] "ENUM"  ACM
 SG_ OBJ_Is_In_Drivable_Area_28 : 385|1@1+ (1,0) [0|1] "bool"  ACM
 SG_ OBJ_Is_In_Drivable_Area_V_28 : 386|1@1+ (1,0) [0|1] "bool"  ACM
 SG_ OBJ_Is_VeryClose_28 : 387|1@1+ (1,0) [0|1] "bool"  ACM
 SG_ OBJ_Is_VeryClose_V_28 : 388|1@1+ (1,0) [0|1] "bool"  ACM
 SG_ OBJ_Buffer_28 : 389|11@1+ (1,0) [0|0] "NA"  ACM

BO_ 201 ICM_Object_Prot28_A: 64 MyECU
 SG_ ICM_Object_Prot28_A_Header : 0|16@1+ (1,0) [0|65535] ""  ACM
 SG_ OBJ_CRC_28 : 16|32@1+ (1,0) [0|4294967295] "NA"  ACM
 SG_ OBJ_ID_28 : 48|8@1+ (1,0) [0|255] "NA"  ACM
 SG_ OBJ_Existence_Probability_28 : 56|8@1+ (0.01,0) [0|1] "NA"  ACM
 SG_ OBJ_Fusion_Source_28 : 64|16@1+ (1,0) [0|65535] "BITWIZE"  ACM
 SG_ OBJ_Triggered_SDM_28 : 80|2@1+ (1,0) [0|2] "ENUM"  ACM
 SG_ OBJ_Motion_Category_28 : 82|4@1+ (1,0) [0|13] "ENUM "  ACM
 SG_ OBJ_Moving_IN_Probability_28 : 86|7@1+ (0.01,0) [0|0] "NA"  ACM
 SG_ OBJ_Object_Age_28 : 93|11@1+ (1,0) [0|2047] "Frame"  ACM
 SG_ OBJ_Measuring_Status_28 : 104|3@1+ (1,0) [0|7] "BITWIZE"  ACM
 SG_ OBJ_Object_Class_28 : 107|4@1+ (1,0) [0|8] "ENUM"  ACM
 SG_ OBJ_Class_Probability_28 : 112|7@1+ (0.01,0) [0|1] "NA"  ACM
 SG_ OBJ_Car_Probability_28 : 119|7@1+ (0.01,0) [0|0] "NA"  ACM
 SG_ OBJ_Truck_Probability_28 : 126|7@1+ (0.01,0) [0|0] "NA"  ACM
 SG_ OBJ_Bike_Probability_28 : 133|7@1+ (0.01,0) [0|0] "NA"  ACM
 SG_ OBJ_Camera_Source_28 : 140|4@1+ (1,0) [0|15] "ENUM"  ACM
 SG_ OBJ_Motion_Status_28 : 144|3@1+ (1,0) [0|5] "ENUM "  ACM
 SG_ OBJ_Motion_Orientation_28 : 147|4@1+ (1,0) [0|13] "ENUM "  ACM
 SG_ OBJ_Has_Cut_Lane_28 : 151|1@1+ (1,0) [0|1] "bool"  ACM
 SG_ OBJ_Has_Cut_Path_28 : 152|1@1+ (1,0) [0|1] "bool"  ACM
 SG_ OBJ_Brake_Light_28 : 153|1@1+ (1,0) [0|1] "bool"  ACM
 SG_ OBJ_Turn_Indicator_Right_28 : 154|1@1+ (1,0) [0|1] "bool"  ACM
 SG_ OBJ_Turn_Indicator_Left_28 : 155|1@1+ (1,0) [0|1] "bool"  ACM
 SG_ OBJ_Light_Indicator_Validity_28 : 156|1@1+ (1,0) [0|1] "bool"  ACM
 SG_ OBJ_Right_Out_Of_Image_28 : 157|1@1+ (1,0) [0|1] "bool"  ACM
 SG_ OBJ_Left_Out_Of_Image_28 : 158|1@1+ (1,0) [0|1] "bool"  ACM
 SG_ OBJ_Right_Out_Of_Image_V_28 : 159|1@1+ (1,0) [0|1] "bool"  ACM
 SG_ OBJ_Left_Out_Of_Image_V_28 : 160|1@1+ (1,0) [0|1] "bool"  ACM
 SG_ OBJ_Top_Out_Of_Image_28 : 161|1@1+ (1,0) [0|1] "bool"  ACM
 SG_ OBJ_Bottom_Out_Of_Image_28 : 162|1@1+ (1,0) [0|1] "bool"  ACM
 SG_ OBJ_Top_Out_Of_Image_V_28 : 163|1@1+ (1,0) [0|1] "bool"  ACM
 SG_ OBJ_Bottom_Out_Of_Image_V_28 : 164|1@1+ (1,0) [0|1] "bool"  ACM
 SG_ OBJ_Lane_Assignment_28 : 165|3@1+ (1,0) [0|5] "ENUM"  ACM
 SG_ OBJ_Lane_Assignment_V_28 : 168|1@1+ (1,0) [0|1] "bool"  ACM
 SG_ OBJ_Age_Seconds_28 : 169|7@1+ (1,0) [0|100] "s"  ACM
 SG_ OBJ_Age_Seconds_V_28 : 176|1@1+ (1,0) [0|1] "bool"  ACM
 SG_ OBJ_Width_28 : 177|9@1+ (0.01,0) [0.4|2.95] "m"  ACM
 SG_ OBJ_Width_V_28 : 186|1@1+ (1,0) [0|1] "bool"  ACM
 SG_ OBJ_Width_STD_28 : 187|8@1+ (0.01,0) [0|2] "m"  ACM
 SG_ OBJ_Width_STD_V_28 : 195|1@1+ (1,0) [0|1] "bool"  ACM
 SG_ OBJ_Length_28 : 196|9@1+ (0.05,0) [1.2|21] "m"  ACM
 SG_ OBJ_Length_V_28 : 205|1@1+ (1,0) [0|1] "bool"  ACM
 SG_ OBJ_Length_STD_28 : 208|8@1+ (0.05,0) [0|10] "m"  ACM
 SG_ OBJ_Length_STD_V_28 : 216|1@1+ (1,0) [0|1] "bool"  ACM
 SG_ OBJ_Height_28 : 217|9@1+ (0.01,0) [0|2.95] "m"  ACM
 SG_ OBJ_Height_V_28 : 226|1@1+ (1,0) [0|1] "bool"  ACM
 SG_ OBJ_Height_STD_28 : 227|8@1+ (0.01,0) [0|2] "m"  ACM
 SG_ OBJ_Height_STD_V_28 : 235|1@1+ (1,0) [0|1] "bool"  ACM
 SG_ OBJ_Abs_Long_Velocity_28 : 240|12@1+ (0.05,-30) [-30|100] "MPS"  ACM
 SG_ OBJ_Abs_Long_Velocity_V_28 : 252|1@1+ (1,0) [0|1] "bool"  ACM
 SG_ OBJ_Abs_Long_Velocity_STD_28 : 253|11@1+ (0.05,0) [0|65] "MPS"  ACM
 SG_ OBJ_Abs_Long_Vel_STD_V_28 : 264|1@1+ (1,0) [0|1] "bool"  ACM
 SG_ OBJ_Abs_Lat_Velocity_28 : 272|11@1+ (0.05,-50) [-50|50] "MPS"  ACM
 SG_ OBJ_Abs_Lat_Velocity_V_28 : 283|1@1+ (1,0) [0|1] "bool"  ACM
 SG_ OBJ_Abs_Lat_Velocity_STD_28 : 284|10@1+ (0.05,0) [0|50] "MPS"  ACM
 SG_ OBJ_Abs_Lat_Vel_STD_V_28 : 294|1@1+ (1,0) [0|1] "bool"  ACM
 SG_ OBJ_Abs_Long_Acc_28 : 295|9@1+ (0.05,-10.3) [-10.3|7.3] "MPS2"  ACM
 SG_ OBJ_Abs_Long_Acc_V_28 : 304|1@1+ (1,0) [0|1] "bool"  ACM
 SG_ OBJ_Abs_Long_Acc_STD_28 : 305|8@1+ (0.05,0) [0|7.3] "MPS2"  ACM
 SG_ OBJ_Abs_Long_Acc_STD_V_28 : 313|1@1+ (1,0) [0|1] "bool"  ACM
 SG_ OBJ_Abs_Lat_Acc_28 : 314|9@1+ (0.05,-10.3) [-10.3|7.3] "MPS2"  ACM
 SG_ OBJ_Abs_Lat_Acc_V_28 : 323|1@1+ (1,0) [0|1] "bool"  ACM
 SG_ OBJ_Abs_Lat_Acc_STD_28 : 324|8@1+ (0.05,0) [0|7.3] "MPS2"  ACM
 SG_ OBJ_Abs_Lat_Acc_STD_V_28 : 332|1@1+ (1,0) [0|1] "bool"  ACM
 SG_ OBJ_Abs_Acceleration_28 : 336|9@1+ (0.05,-10.3) [-10.3|7.3] "MPS2"  ACM
 SG_ OBJ_Abs_Acceleration_V_28 : 345|1@1+ (1,0) [0|1] "bool"  ACM
 SG_ OBJ_Abs_Acc_STD_28 : 346|8@1+ (0.05,0) [0|7.3] "MPS2"  ACM
 SG_ OBJ_Abs_Acc_STD_V_28 : 354|1@1+ (1,0) [0|1] "bool"  ACM
 SG_ OBJ_Inv_TTC_28 : 355|11@1+ (0.01,-8) [-8|8] "INV(s)"  ACM
 SG_ OBJ_Inv_TTC_V_28 : 366|1@1+ (1,0) [0|1] "bool"  ACM
 SG_ OBJ_Inv_TTC_STD_28 : 368|11@1+ (0.01,0) [0|4] "INV(s)"  ACM
 SG_ OBJ_Inv_TTC_STD_V_28 : 379|1@1+ (1,0) [0|1] "bool"  ACM
 SG_ OBJ_Relative_Long_Acc_28 : 380|9@1+ (0.05,-10.3) [-10.3|7.3] "MPS2"  ACM
 SG_ OBJ_Relative_Long_Acc_V_28 : 389|1@1+ (1,0) [0|1] "bool"  ACM
 SG_ OBJ_Relative_Long_Acc_STD_28 : 390|8@1+ (0.05,0) [0|7.3] "MPS2"  ACM
 SG_ OBJ_Rel_Long_Acc_STD_V_28 : 398|1@1+ (1,0) [0|1] "bool"  ACM

BO_ 200 ICM_Object_Prot27_B: 64 MyECU
 SG_ ICM_Object_Prot27_B_Header : 0|16@1+ (1,0) [0|65535] ""  ACM
 SG_ OBJ_Relative_Long_Velocity_27 : 16|13@1+ (0.05,-120) [-120|130] "MPS"  ACM
 SG_ OBJ_Relative_Long_Velocity_V_27 : 29|1@1+ (1,0) [0|1] "bool"  ACM
 SG_ OBJ_Relative_Long_Vel_STD_27 : 30|12@1+ (0.05,0) [0|130] "MPS"  ACM
 SG_ OBJ_Rel_Long_Vel_STD_V_27 : 42|1@1+ (1,0) [0|1] "bool"  ACM
 SG_ OBJ_Relative_Lat_Velocity_27 : 48|11@1+ (0.05,-50) [-50|50] "MPS"  ACM
 SG_ OBJ_Relative_Lat_Velocity_V_27 : 59|1@1+ (1,0) [0|1] "bool"  ACM
 SG_ OBJ_Relative_Lat_Velocity_STD_27 : 60|10@1+ (0.05,0) [0|50] "MPS"  ACM
 SG_ OBJ_Rel_Lat_Vel_STD_V_27 : 70|1@1+ (1,0) [0|1] "bool"  ACM
 SG_ OBJ_Long_Distance_27 : 80|14@1+ (0.05,-200) [-200|250] "m"  ACM
 SG_ OBJ_Long_Distance_V_27 : 94|1@1+ (1,0) [0|1] "bool"  ACM
 SG_ OBJ_Long_Distance_STD_27 : 95|13@1+ (0.05,0) [0|250] "m"  ACM
 SG_ OBJ_Long_Distance_STD_V_27 : 108|1@1+ (1,0) [0|1] "bool"  ACM
 SG_ OBJ_Lat_Distance_27 : 112|12@1+ (0.05,-100) [-100|100] "m"  ACM
 SG_ OBJ_Lat_Distance_V_27 : 124|1@1+ (1,0) [0|1] "bool"  ACM
 SG_ OBJ_Lat_Distance_STD_27 : 125|11@1+ (0.05,0) [0|100] "m"  ACM
 SG_ OBJ_Lat_Distance_STD_V_27 : 136|1@1+ (1,0) [0|1] "bool"  ACM
 SG_ OBJ_Absolute_Speed_27 : 144|12@1+ (0.05,-65) [-65|65] "MPS"  ACM
 SG_ OBJ_Absolute_Speed_V_27 : 156|1@1+ (1,0) [0|1] "bool"  ACM
 SG_ OBJ_Absolute_Speed_STD_27 : 157|11@1+ (0.05,-65) [0|65] "MPS"  ACM
 SG_ OBJ_Absolute_Speed_STD_V_27 : 168|1@1+ (1,0) [0|1] "bool"  ACM
 SG_ OBJ_Heading_27 : 176|10@1+ (0.01,-3.14) [-3.14|3.14] "rad"  ACM
 SG_ OBJ_Heading_V_27 : 186|1@1+ (1,0) [0|1] "bool"  ACM
 SG_ OBJ_Heading_STD_27 : 187|9@1+ (0.01,0) [0|3.14] "rad"  ACM
 SG_ OBJ_Heading_STD_V_27 : 196|1@1+ (1,0) [0|1] "bool"  ACM
 SG_ OBJ_Angle_Rate_STD_27 : 197|11@1+ (0.002,0) [0|2.2318] "RPS"  ACM
 SG_ OBJ_Angle_Rate_STD_V_27 : 208|1@1+ (1,0) [0|1] "bool"  ACM
 SG_ OBJ_Angle_Rate_27 : 209|12@1+ (0.002,-2.234) [-2.234|2.2318] "RPS"  ACM
 SG_ OBJ_Angle_Rate_V_27 : 221|1@1+ (1,0) [0|1] "bool"  ACM
 SG_ OBJ_Angle_Right_27 : 222|14@1+ (0.0002,-1.571) [-1.571|1.571] "rad "  ACM
 SG_ OBJ_Angle_Right_V_27 : 236|1@1+ (1,0) [0|1] "bool"  ACM
 SG_ OBJ_Angle_Right_STD_27 : 240|13@1+ (0.0002,0) [0|1.571] "rad "  ACM
 SG_ OBJ_Angle_Right_STD_V_27 : 253|1@1+ (1,0) [0|1] "bool"  ACM
 SG_ OBJ_Angle_Left_27 : 254|14@1+ (0.0002,-1.571) [-1.571|1.571] "rad "  ACM
 SG_ OBJ_Angle_Left_V_27 : 268|1@1+ (1,0) [0|1] "bool"  ACM
 SG_ OBJ_Angle_Left_STD_27 : 272|13@1+ (0.0002,0) [0|1.571] "rad"  ACM
 SG_ OBJ_Angle_Left_STD_V_27 : 285|1@1+ (1,0) [0|1] "bool"  ACM
 SG_ OBJ_Angle_Side_27 : 286|14@1+ (0.0002,-1.571) [-1.571|1.571] "rad"  ACM
 SG_ OBJ_Angle_Side_V_27 : 300|1@1+ (1,0) [0|1] "bool"  ACM
 SG_ OBJ_Angle_Side_STD_27 : 304|13@1+ (0.0002,0) [0|1.571] "rad"  ACM
 SG_ OBJ_Angle_Side_STD_V_27 : 317|1@1+ (1,0) [0|1] "bool"  ACM
 SG_ OBJ_Angle_Mid_V_27 : 318|1@1+ (1,0) [0|1] "bool"  ACM
 SG_ OBJ_Angle_Mid_27 : 319|14@1+ (0.0002,-1.571) [-1.571|1.571] "rad"  ACM
 SG_ OBJ_Angle_Mid_STD_27 : 336|13@1+ (0.0002,0) [0|1.571] "rad"  ACM
 SG_ OBJ_Angle_Mid_STD_V_27 : 349|1@1+ (1,0) [0|1] "bool"  ACM
 SG_ OBJ_Angle_Bottom_V_27 : 350|1@1+ (1,0) [0|1] "bool"  ACM
 SG_ OBJ_Angle_Bottom_27 : 351|14@1+ (0.0002,-1.571) [-1.571|1.571] "rad"  ACM
 SG_ OBJ_Angle_Bottom_STD_27 : 368|13@1+ (0.0002,0) [0|1.571] "rad"  ACM
 SG_ OBJ_Angle_Bottom_STD_V_27 : 381|1@1+ (1,0) [0|1] "bool"  ACM
 SG_ OBJ_Visibility_Side_V_27 : 382|1@1+ (1,0) [0|1] "bool"  ACM
 SG_ OBJ_Visibility_Side_27 : 383|2@1+ (1,0) [0|2] "ENUM"  ACM
 SG_ OBJ_Is_In_Drivable_Area_27 : 385|1@1+ (1,0) [0|1] "bool"  ACM
 SG_ OBJ_Is_In_Drivable_Area_V_27 : 386|1@1+ (1,0) [0|1] "bool"  ACM
 SG_ OBJ_Is_VeryClose_27 : 387|1@1+ (1,0) [0|1] "bool"  ACM
 SG_ OBJ_Is_VeryClose_V_27 : 388|1@1+ (1,0) [0|1] "bool"  ACM
 SG_ OBJ_Buffer_27 : 389|11@1+ (1,0) [0|0] "NA"  ACM

BO_ 199 ICM_Object_Prot27_A: 64 MyECU
 SG_ ICM_Object_Prot27_A_Header : 0|16@1+ (1,0) [0|65535] ""  ACM
 SG_ OBJ_CRC_27 : 16|32@1+ (1,0) [0|4294967295] "NA"  ACM
 SG_ OBJ_ID_27 : 48|8@1+ (1,0) [0|255] "NA"  ACM
 SG_ OBJ_Existence_Probability_27 : 56|8@1+ (0.01,0) [0|1] "NA"  ACM
 SG_ OBJ_Fusion_Source_27 : 64|16@1+ (1,0) [0|65535] "BITWIZE"  ACM
 SG_ OBJ_Triggered_SDM_27 : 80|2@1+ (1,0) [0|2] "ENUM"  ACM
 SG_ OBJ_Motion_Category_27 : 82|4@1+ (1,0) [0|13] "ENUM "  ACM
 SG_ OBJ_Moving_IN_Probability_27 : 86|7@1+ (0.01,0) [0|0] "NA"  ACM
 SG_ OBJ_Object_Age_27 : 93|11@1+ (1,0) [0|2047] "Frame"  ACM
 SG_ OBJ_Measuring_Status_27 : 104|3@1+ (1,0) [0|7] "BITWIZE"  ACM
 SG_ OBJ_Object_Class_27 : 107|4@1+ (1,0) [0|8] "ENUM"  ACM
 SG_ OBJ_Class_Probability_27 : 112|7@1+ (0.01,0) [0|1] "NA"  ACM
 SG_ OBJ_Car_Probability_27 : 119|7@1+ (0.01,0) [0|0] "NA"  ACM
 SG_ OBJ_Truck_Probability_27 : 126|7@1+ (0.01,0) [0|0] "NA"  ACM
 SG_ OBJ_Bike_Probability_27 : 133|7@1+ (0.01,0) [0|0] "NA"  ACM
 SG_ OBJ_Camera_Source_27 : 140|4@1+ (1,0) [0|15] "ENUM"  ACM
 SG_ OBJ_Motion_Status_27 : 144|3@1+ (1,0) [0|5] "ENUM "  ACM
 SG_ OBJ_Motion_Orientation_27 : 147|4@1+ (1,0) [0|13] "ENUM "  ACM
 SG_ OBJ_Has_Cut_Lane_27 : 151|1@1+ (1,0) [0|1] "bool"  ACM
 SG_ OBJ_Has_Cut_Path_27 : 152|1@1+ (1,0) [0|1] "bool"  ACM
 SG_ OBJ_Brake_Light_27 : 153|1@1+ (1,0) [0|1] "bool"  ACM
 SG_ OBJ_Turn_Indicator_Right_27 : 154|1@1+ (1,0) [0|1] "bool"  ACM
 SG_ OBJ_Turn_Indicator_Left_27 : 155|1@1+ (1,0) [0|1] "bool"  ACM
 SG_ OBJ_Light_Indicator_Validity_27 : 156|1@1+ (1,0) [0|1] "bool"  ACM
 SG_ OBJ_Right_Out_Of_Image_27 : 157|1@1+ (1,0) [0|1] "bool"  ACM
 SG_ OBJ_Left_Out_Of_Image_27 : 158|1@1+ (1,0) [0|1] "bool"  ACM
 SG_ OBJ_Right_Out_Of_Image_V_27 : 159|1@1+ (1,0) [0|1] "bool"  ACM
 SG_ OBJ_Left_Out_Of_Image_V_27 : 160|1@1+ (1,0) [0|1] "bool"  ACM
 SG_ OBJ_Top_Out_Of_Image_27 : 161|1@1+ (1,0) [0|1] "bool"  ACM
 SG_ OBJ_Bottom_Out_Of_Image_27 : 162|1@1+ (1,0) [0|1] "bool"  ACM
 SG_ OBJ_Top_Out_Of_Image_V_27 : 163|1@1+ (1,0) [0|1] "bool"  ACM
 SG_ OBJ_Bottom_Out_Of_Image_V_27 : 164|1@1+ (1,0) [0|1] "bool"  ACM
 SG_ OBJ_Lane_Assignment_27 : 165|3@1+ (1,0) [0|5] "ENUM"  ACM
 SG_ OBJ_Lane_Assignment_V_27 : 168|1@1+ (1,0) [0|1] "bool"  ACM
 SG_ OBJ_Age_Seconds_27 : 169|7@1+ (1,0) [0|100] "s"  ACM
 SG_ OBJ_Age_Seconds_V_27 : 176|1@1+ (1,0) [0|1] "bool"  ACM
 SG_ OBJ_Width_27 : 177|9@1+ (0.01,0) [0.4|2.95] "m"  ACM
 SG_ OBJ_Width_V_27 : 186|1@1+ (1,0) [0|1] "bool"  ACM
 SG_ OBJ_Width_STD_27 : 187|8@1+ (0.01,0) [0|2] "m"  ACM
 SG_ OBJ_Width_STD_V_27 : 195|1@1+ (1,0) [0|1] "bool"  ACM
 SG_ OBJ_Length_27 : 196|9@1+ (0.05,0) [1.2|21] "m"  ACM
 SG_ OBJ_Length_V_27 : 205|1@1+ (1,0) [0|1] "bool"  ACM
 SG_ OBJ_Length_STD_27 : 208|8@1+ (0.05,0) [0|10] "m"  ACM
 SG_ OBJ_Length_STD_V_27 : 216|1@1+ (1,0) [0|1] "bool"  ACM
 SG_ OBJ_Height_27 : 217|9@1+ (0.01,0) [0|2.95] "m"  ACM
 SG_ OBJ_Height_V_27 : 226|1@1+ (1,0) [0|1] "bool"  ACM
 SG_ OBJ_Height_STD_27 : 227|8@1+ (0.01,0) [0|2] "m"  ACM
 SG_ OBJ_Height_STD_V_27 : 235|1@1+ (1,0) [0|1] "bool"  ACM
 SG_ OBJ_Abs_Long_Velocity_27 : 240|12@1+ (0.05,-30) [-30|100] "MPS"  ACM
 SG_ OBJ_Abs_Long_Velocity_V_27 : 252|1@1+ (1,0) [0|1] "bool"  ACM
 SG_ OBJ_Abs_Long_Velocity_STD_27 : 253|11@1+ (0.05,0) [0|65] "MPS"  ACM
 SG_ OBJ_Abs_Long_Vel_STD_V_27 : 264|1@1+ (1,0) [0|1] "bool"  ACM
 SG_ OBJ_Abs_Lat_Velocity_27 : 272|11@1+ (0.05,-50) [-50|50] "MPS"  ACM
 SG_ OBJ_Abs_Lat_Velocity_V_27 : 283|1@1+ (1,0) [0|1] "bool"  ACM
 SG_ OBJ_Abs_Lat_Velocity_STD_27 : 284|10@1+ (0.05,0) [0|50] "MPS"  ACM
 SG_ OBJ_Abs_Lat_Vel_STD_V_27 : 294|1@1+ (1,0) [0|1] "bool"  ACM
 SG_ OBJ_Abs_Long_Acc_27 : 295|9@1+ (0.05,-10.3) [-10.3|7.3] "MPS2"  ACM
 SG_ OBJ_Abs_Long_Acc_V_27 : 304|1@1+ (1,0) [0|1] "bool"  ACM
 SG_ OBJ_Abs_Long_Acc_STD_27 : 305|8@1+ (0.05,0) [0|7.3] "MPS2"  ACM
 SG_ OBJ_Abs_Long_Acc_STD_V_27 : 313|1@1+ (1,0) [0|1] "bool"  ACM
 SG_ OBJ_Abs_Lat_Acc_27 : 314|9@1+ (0.05,-10.3) [-10.3|7.3] "MPS2"  ACM
 SG_ OBJ_Abs_Lat_Acc_V_27 : 323|1@1+ (1,0) [0|1] "bool"  ACM
 SG_ OBJ_Abs_Lat_Acc_STD_27 : 324|8@1+ (0.05,0) [0|7.3] "MPS2"  ACM
 SG_ OBJ_Abs_Lat_Acc_STD_V_27 : 332|1@1+ (1,0) [0|1] "bool"  ACM
 SG_ OBJ_Abs_Acceleration_27 : 336|9@1+ (0.05,-10.3) [-10.3|7.3] "MPS2"  ACM
 SG_ OBJ_Abs_Acceleration_V_27 : 345|1@1+ (1,0) [0|1] "bool"  ACM
 SG_ OBJ_Abs_Acc_STD_27 : 346|8@1+ (0.05,0) [0|7.3] "MPS2"  ACM
 SG_ OBJ_Abs_Acc_STD_V_27 : 354|1@1+ (1,0) [0|1] "bool"  ACM
 SG_ OBJ_Inv_TTC_27 : 355|11@1+ (0.01,-8) [-8|8] "INV(s)"  ACM
 SG_ OBJ_Inv_TTC_V_27 : 366|1@1+ (1,0) [0|1] "bool"  ACM
 SG_ OBJ_Inv_TTC_STD_27 : 368|11@1+ (0.01,0) [0|4] "INV(s)"  ACM
 SG_ OBJ_Inv_TTC_STD_V_27 : 379|1@1+ (1,0) [0|1] "bool"  ACM
 SG_ OBJ_Relative_Long_Acc_27 : 380|9@1+ (0.05,-10.3) [-10.3|7.3] "MPS2"  ACM
 SG_ OBJ_Relative_Long_Acc_V_27 : 389|1@1+ (1,0) [0|1] "bool"  ACM
 SG_ OBJ_Relative_Long_Acc_STD_27 : 390|8@1+ (0.05,0) [0|7.3] "MPS2"  ACM
 SG_ OBJ_Rel_Long_Acc_STD_V_27 : 398|1@1+ (1,0) [0|1] "bool"  ACM

BO_ 198 ICM_Object_Prot26_B: 64 MyECU
 SG_ ICM_Object_Prot26_B_Header : 0|16@1+ (1,0) [0|65535] ""  ACM
 SG_ OBJ_Relative_Long_Velocity_26 : 16|13@1+ (0.05,-120) [-120|130] "MPS"  ACM
 SG_ OBJ_Relative_Long_Velocity_V_26 : 29|1@1+ (1,0) [0|1] "bool"  ACM
 SG_ OBJ_Relative_Long_Vel_STD_26 : 30|12@1+ (0.05,0) [0|130] "MPS"  ACM
 SG_ OBJ_Rel_Long_Vel_STD_V_26 : 42|1@1+ (1,0) [0|1] "bool"  ACM
 SG_ OBJ_Relative_Lat_Velocity_26 : 48|11@1+ (0.05,-50) [-50|50] "MPS"  ACM
 SG_ OBJ_Relative_Lat_Velocity_V_26 : 59|1@1+ (1,0) [0|1] "bool"  ACM
 SG_ OBJ_Relative_Lat_Velocity_STD_26 : 60|10@1+ (0.05,0) [0|50] "MPS"  ACM
 SG_ OBJ_Rel_Lat_Vel_STD_V_26 : 70|1@1+ (1,0) [0|1] "bool"  ACM
 SG_ OBJ_Long_Distance_26 : 80|14@1+ (0.05,-200) [-200|250] "m"  ACM
 SG_ OBJ_Long_Distance_V_26 : 94|1@1+ (1,0) [0|1] "bool"  ACM
 SG_ OBJ_Long_Distance_STD_26 : 95|13@1+ (0.05,0) [0|250] "m"  ACM
 SG_ OBJ_Long_Distance_STD_V_26 : 108|1@1+ (1,0) [0|1] "bool"  ACM
 SG_ OBJ_Lat_Distance_26 : 112|12@1+ (0.05,-100) [-100|100] "m"  ACM
 SG_ OBJ_Lat_Distance_V_26 : 124|1@1+ (1,0) [0|1] "bool"  ACM
 SG_ OBJ_Lat_Distance_STD_26 : 125|11@1+ (0.05,0) [0|100] "m"  ACM
 SG_ OBJ_Lat_Distance_STD_V_26 : 136|1@1+ (1,0) [0|1] "bool"  ACM
 SG_ OBJ_Absolute_Speed_26 : 144|12@1+ (0.05,-65) [-65|65] "MPS"  ACM
 SG_ OBJ_Absolute_Speed_V_26 : 156|1@1+ (1,0) [0|1] "bool"  ACM
 SG_ OBJ_Absolute_Speed_STD_26 : 157|11@1+ (0.05,-65) [0|65] "MPS"  ACM
 SG_ OBJ_Absolute_Speed_STD_V_26 : 168|1@1+ (1,0) [0|1] "bool"  ACM
 SG_ OBJ_Heading_26 : 176|10@1+ (0.01,-3.14) [-3.14|3.14] "rad"  ACM
 SG_ OBJ_Heading_V_26 : 186|1@1+ (1,0) [0|1] "bool"  ACM
 SG_ OBJ_Heading_STD_26 : 187|9@1+ (0.01,0) [0|3.14] "rad"  ACM
 SG_ OBJ_Heading_STD_V_26 : 196|1@1+ (1,0) [0|1] "bool"  ACM
 SG_ OBJ_Angle_Rate_STD_26 : 197|11@1+ (0.002,0) [0|2.2318] "RPS"  ACM
 SG_ OBJ_Angle_Rate_STD_V_26 : 208|1@1+ (1,0) [0|1] "bool"  ACM
 SG_ OBJ_Angle_Rate_26 : 209|12@1+ (0.002,-2.234) [-2.234|2.2318] "RPS"  ACM
 SG_ OBJ_Angle_Rate_V_26 : 221|1@1+ (1,0) [0|1] "bool"  ACM
 SG_ OBJ_Angle_Right_26 : 222|14@1+ (0.0002,-1.571) [-1.571|1.571] "rad "  ACM
 SG_ OBJ_Angle_Right_V_26 : 236|1@1+ (1,0) [0|1] "bool"  ACM
 SG_ OBJ_Angle_Right_STD_26 : 240|13@1+ (0.0002,0) [0|1.571] "rad "  ACM
 SG_ OBJ_Angle_Right_STD_V_26 : 253|1@1+ (1,0) [0|1] "bool"  ACM
 SG_ OBJ_Angle_Left_26 : 254|14@1+ (0.0002,-1.571) [-1.571|1.571] "rad "  ACM
 SG_ OBJ_Angle_Left_V_26 : 268|1@1+ (1,0) [0|1] "bool"  ACM
 SG_ OBJ_Angle_Left_STD_26 : 272|13@1+ (0.0002,0) [0|1.571] "rad"  ACM
 SG_ OBJ_Angle_Left_STD_V_26 : 285|1@1+ (1,0) [0|1] "bool"  ACM
 SG_ OBJ_Angle_Side_26 : 286|14@1+ (0.0002,-1.571) [-1.571|1.571] "rad"  ACM
 SG_ OBJ_Angle_Side_V_26 : 300|1@1+ (1,0) [0|1] "bool"  ACM
 SG_ OBJ_Angle_Side_STD_26 : 304|13@1+ (0.0002,0) [0|1.571] "rad"  ACM
 SG_ OBJ_Angle_Side_STD_V_26 : 317|1@1+ (1,0) [0|1] "bool"  ACM
 SG_ OBJ_Angle_Mid_V_26 : 318|1@1+ (1,0) [0|1] "bool"  ACM
 SG_ OBJ_Angle_Mid_26 : 319|14@1+ (0.0002,-1.571) [-1.571|1.571] "rad"  ACM
 SG_ OBJ_Angle_Mid_STD_26 : 336|13@1+ (0.0002,0) [0|1.571] "rad"  ACM
 SG_ OBJ_Angle_Mid_STD_V_26 : 349|1@1+ (1,0) [0|1] "bool"  ACM
 SG_ OBJ_Angle_Bottom_V_26 : 350|1@1+ (1,0) [0|1] "bool"  ACM
 SG_ OBJ_Angle_Bottom_26 : 351|14@1+ (0.0002,-1.571) [-1.571|1.571] "rad"  ACM
 SG_ OBJ_Angle_Bottom_STD_26 : 368|13@1+ (0.0002,0) [0|1.571] "rad"  ACM
 SG_ OBJ_Angle_Bottom_STD_V_26 : 381|1@1+ (1,0) [0|1] "bool"  ACM
 SG_ OBJ_Visibility_Side_V_26 : 382|1@1+ (1,0) [0|1] "bool"  ACM
 SG_ OBJ_Visibility_Side_26 : 383|2@1+ (1,0) [0|2] "ENUM"  ACM
 SG_ OBJ_Is_In_Drivable_Area_26 : 385|1@1+ (1,0) [0|1] "bool"  ACM
 SG_ OBJ_Is_In_Drivable_Area_V_26 : 386|1@1+ (1,0) [0|1] "bool"  ACM
 SG_ OBJ_Is_VeryClose_26 : 387|1@1+ (1,0) [0|1] "bool"  ACM
 SG_ OBJ_Is_VeryClose_V_26 : 388|1@1+ (1,0) [0|1] "bool"  ACM
 SG_ OBJ_Buffer_26 : 389|11@1+ (1,0) [0|0] "NA"  ACM

BO_ 197 ICM_Object_Prot26_A: 64 MyECU
 SG_ ICM_Object_Prot26_A_Header : 0|16@1+ (1,0) [0|65535] ""  ACM
 SG_ OBJ_CRC_26 : 16|32@1+ (1,0) [0|4294967295] "NA"  ACM
 SG_ OBJ_ID_26 : 48|8@1+ (1,0) [0|255] "NA"  ACM
 SG_ OBJ_Existence_Probability_26 : 56|8@1+ (0.01,0) [0|1] "NA"  ACM
 SG_ OBJ_Fusion_Source_26 : 64|16@1+ (1,0) [0|65535] "BITWIZE"  ACM
 SG_ OBJ_Triggered_SDM_26 : 80|2@1+ (1,0) [0|2] "ENUM"  ACM
 SG_ OBJ_Motion_Category_26 : 82|4@1+ (1,0) [0|13] "ENUM "  ACM
 SG_ OBJ_Moving_IN_Probability_26 : 86|7@1+ (0.01,0) [0|0] "NA"  ACM
 SG_ OBJ_Object_Age_26 : 93|11@1+ (1,0) [0|2047] "Frame"  ACM
 SG_ OBJ_Measuring_Status_26 : 104|3@1+ (1,0) [0|7] "BITWIZE"  ACM
 SG_ OBJ_Object_Class_26 : 107|4@1+ (1,0) [0|8] "ENUM"  ACM
 SG_ OBJ_Class_Probability_26 : 112|7@1+ (0.01,0) [0|1] "NA"  ACM
 SG_ OBJ_Car_Probability_26 : 119|7@1+ (0.01,0) [0|0] "NA"  ACM
 SG_ OBJ_Truck_Probability_26 : 126|7@1+ (0.01,0) [0|0] "NA"  ACM
 SG_ OBJ_Bike_Probability_26 : 133|7@1+ (0.01,0) [0|0] "NA"  ACM
 SG_ OBJ_Camera_Source_26 : 140|4@1+ (1,0) [0|15] "ENUM"  ACM
 SG_ OBJ_Motion_Status_26 : 144|3@1+ (1,0) [0|5] "ENUM "  ACM
 SG_ OBJ_Motion_Orientation_26 : 147|4@1+ (1,0) [0|13] "ENUM "  ACM
 SG_ OBJ_Has_Cut_Lane_26 : 151|1@1+ (1,0) [0|1] "bool"  ACM
 SG_ OBJ_Has_Cut_Path_26 : 152|1@1+ (1,0) [0|1] "bool"  ACM
 SG_ OBJ_Brake_Light_26 : 153|1@1+ (1,0) [0|1] "bool"  ACM
 SG_ OBJ_Turn_Indicator_Right_26 : 154|1@1+ (1,0) [0|1] "bool"  ACM
 SG_ OBJ_Turn_Indicator_Left_26 : 155|1@1+ (1,0) [0|1] "bool"  ACM
 SG_ OBJ_Light_Indicator_Validity_26 : 156|1@1+ (1,0) [0|1] "bool"  ACM
 SG_ OBJ_Right_Out_Of_Image_26 : 157|1@1+ (1,0) [0|1] "bool"  ACM
 SG_ OBJ_Left_Out_Of_Image_26 : 158|1@1+ (1,0) [0|1] "bool"  ACM
 SG_ OBJ_Right_Out_Of_Image_V_26 : 159|1@1+ (1,0) [0|1] "bool"  ACM
 SG_ OBJ_Left_Out_Of_Image_V_26 : 160|1@1+ (1,0) [0|1] "bool"  ACM
 SG_ OBJ_Top_Out_Of_Image_26 : 161|1@1+ (1,0) [0|1] "bool"  ACM
 SG_ OBJ_Bottom_Out_Of_Image_26 : 162|1@1+ (1,0) [0|1] "bool"  ACM
 SG_ OBJ_Top_Out_Of_Image_V_26 : 163|1@1+ (1,0) [0|1] "bool"  ACM
 SG_ OBJ_Bottom_Out_Of_Image_V_26 : 164|1@1+ (1,0) [0|1] "bool"  ACM
 SG_ OBJ_Lane_Assignment_26 : 165|3@1+ (1,0) [0|5] "ENUM"  ACM
 SG_ OBJ_Lane_Assignment_V_26 : 168|1@1+ (1,0) [0|1] "bool"  ACM
 SG_ OBJ_Age_Seconds_26 : 169|7@1+ (1,0) [0|100] "s"  ACM
 SG_ OBJ_Age_Seconds_V_26 : 176|1@1+ (1,0) [0|1] "bool"  ACM
 SG_ OBJ_Width_26 : 177|9@1+ (0.01,0) [0.4|2.95] "m"  ACM
 SG_ OBJ_Width_V_26 : 186|1@1+ (1,0) [0|1] "bool"  ACM
 SG_ OBJ_Width_STD_26 : 187|8@1+ (0.01,0) [0|2] "m"  ACM
 SG_ OBJ_Width_STD_V_26 : 195|1@1+ (1,0) [0|1] "bool"  ACM
 SG_ OBJ_Length_26 : 196|9@1+ (0.05,0) [1.2|21] "m"  ACM
 SG_ OBJ_Length_V_26 : 205|1@1+ (1,0) [0|1] "bool"  ACM
 SG_ OBJ_Length_STD_26 : 208|8@1+ (0.05,0) [0|10] "m"  ACM
 SG_ OBJ_Length_STD_V_26 : 216|1@1+ (1,0) [0|1] "bool"  ACM
 SG_ OBJ_Height_26 : 217|9@1+ (0.01,0) [0|2.95] "m"  ACM
 SG_ OBJ_Height_V_26 : 226|1@1+ (1,0) [0|1] "bool"  ACM
 SG_ OBJ_Height_STD_26 : 227|8@1+ (0.01,0) [0|2] "m"  ACM
 SG_ OBJ_Height_STD_V_26 : 235|1@1+ (1,0) [0|1] "bool"  ACM
 SG_ OBJ_Abs_Long_Velocity_26 : 240|12@1+ (0.05,-30) [-30|100] "MPS"  ACM
 SG_ OBJ_Abs_Long_Velocity_V_26 : 252|1@1+ (1,0) [0|1] "bool"  ACM
 SG_ OBJ_Abs_Long_Velocity_STD_26 : 253|11@1+ (0.05,0) [0|65] "MPS"  ACM
 SG_ OBJ_Abs_Long_Vel_STD_V_26 : 264|1@1+ (1,0) [0|1] "bool"  ACM
 SG_ OBJ_Abs_Lat_Velocity_26 : 272|11@1+ (0.05,-50) [-50|50] "MPS"  ACM
 SG_ OBJ_Abs_Lat_Velocity_V_26 : 283|1@1+ (1,0) [0|1] "bool"  ACM
 SG_ OBJ_Abs_Lat_Velocity_STD_26 : 284|10@1+ (0.05,0) [0|50] "MPS"  ACM
 SG_ OBJ_Abs_Lat_Vel_STD_V_26 : 294|1@1+ (1,0) [0|1] "bool"  ACM
 SG_ OBJ_Abs_Long_Acc_26 : 295|9@1+ (0.05,-10.3) [-10.3|7.3] "MPS2"  ACM
 SG_ OBJ_Abs_Long_Acc_V_26 : 304|1@1+ (1,0) [0|1] "bool"  ACM
 SG_ OBJ_Abs_Long_Acc_STD_26 : 305|8@1+ (0.05,0) [0|7.3] "MPS2"  ACM
 SG_ OBJ_Abs_Long_Acc_STD_V_26 : 313|1@1+ (1,0) [0|1] "bool"  ACM
 SG_ OBJ_Abs_Lat_Acc_26 : 314|9@1+ (0.05,-10.3) [-10.3|7.3] "MPS2"  ACM
 SG_ OBJ_Abs_Lat_Acc_V_26 : 323|1@1+ (1,0) [0|1] "bool"  ACM
 SG_ OBJ_Abs_Lat_Acc_STD_26 : 324|8@1+ (0.05,0) [0|7.3] "MPS2"  ACM
 SG_ OBJ_Abs_Lat_Acc_STD_V_26 : 332|1@1+ (1,0) [0|1] "bool"  ACM
 SG_ OBJ_Abs_Acceleration_26 : 336|9@1+ (0.05,-10.3) [-10.3|7.3] "MPS2"  ACM
 SG_ OBJ_Abs_Acceleration_V_26 : 345|1@1+ (1,0) [0|1] "bool"  ACM
 SG_ OBJ_Abs_Acc_STD_26 : 346|8@1+ (0.05,0) [0|7.3] "MPS2"  ACM
 SG_ OBJ_Abs_Acc_STD_V_26 : 354|1@1+ (1,0) [0|1] "bool"  ACM
 SG_ OBJ_Inv_TTC_26 : 355|11@1+ (0.01,-8) [-8|8] "INV(s)"  ACM
 SG_ OBJ_Inv_TTC_V_26 : 366|1@1+ (1,0) [0|1] "bool"  ACM
 SG_ OBJ_Inv_TTC_STD_26 : 368|11@1+ (0.01,0) [0|4] "INV(s)"  ACM
 SG_ OBJ_Inv_TTC_STD_V_26 : 379|1@1+ (1,0) [0|1] "bool"  ACM
 SG_ OBJ_Relative_Long_Acc_26 : 380|9@1+ (0.05,-10.3) [-10.3|7.3] "MPS2"  ACM
 SG_ OBJ_Relative_Long_Acc_V_26 : 389|1@1+ (1,0) [0|1] "bool"  ACM
 SG_ OBJ_Relative_Long_Acc_STD_26 : 390|8@1+ (0.05,0) [0|7.3] "MPS2"  ACM
 SG_ OBJ_Rel_Long_Acc_STD_V_26 : 398|1@1+ (1,0) [0|1] "bool"  ACM

BA_DEF_ BO_  "VFrameFormat" ENUM  "StandardCAN","ExtendedCAN","reserved","reserved","reserved","reserved","reserved","reserved","reserved","reserved","reserved","reserved","reserved","reserved","StandardCAN_FD","ExtendedCAN_FD";
BA_DEF_ BO_  "GenMsgSendType" ENUM  "Cyclic","NotUsed","NotUsed","NotUsed","NotUsed","NotUsed","NotUsed","NotUsed","NoMsgSendType";
BA_DEF_ SG_  "GenSigSendType" ENUM  "NotUsed","OnWrite","OnWriteWithRepetition","OnChange","OnChangeWithRepetition","IfActive","IfActiveWithRepeition","NoSigSendType";
BA_DEF_ BO_  "GenMsgCycleTime" INT 0 0;
BA_DEF_ BO_  "GenMsgILSupport" ENUM  "no","yes";
BA_DEF_ SG_  "GenSigStartValue" INT 0 0;
BA_DEF_DEF_  "VFrameFormat" "ExtendedCAN_FD";
BA_DEF_DEF_  "GenMsgSendType" "NoMsgSendType";
BA_DEF_DEF_  "GenSigSendType" "OnWrite";
BA_DEF_DEF_  "GenMsgCycleTime" 0;
BA_DEF_DEF_  "GenMsgILSupport" "yes";
BA_DEF_DEF_  "GenSigStartValue" 0;
BA_ "VFrameFormat" BO_ 216 14;
BA_ "VFrameFormat" BO_ 215 14;
BA_ "VFrameFormat" BO_ 214 14;
BA_ "VFrameFormat" BO_ 213 14;
BA_ "VFrameFormat" BO_ 212 14;
BA_ "VFrameFormat" BO_ 211 14;
BA_ "VFrameFormat" BO_ 210 14;
BA_ "VFrameFormat" BO_ 209 14;
BA_ "VFrameFormat" BO_ 208 14;
BA_ "VFrameFormat" BO_ 207 14;
BA_ "VFrameFormat" BO_ 206 14;
BA_ "VFrameFormat" BO_ 205 14;
BA_ "VFrameFormat" BO_ 204 14;
BA_ "VFrameFormat" BO_ 203 14;
BA_ "VFrameFormat" BO_ 202 14;
BA_ "VFrameFormat" BO_ 201 14;
BA_ "VFrameFormat" BO_ 200 14;
BA_ "VFrameFormat" BO_ 199 14;
BA_ "VFrameFormat" BO_ 198 14;
BA_ "VFrameFormat" BO_ 197 14;
BA_ "GenSigStartValue" SG_ 216 OBJ_Absolute_Speed_STD_35 1300;
BA_ "GenSigStartValue" SG_ 215 OBJ_Width_35 40;
BA_ "GenSigStartValue" SG_ 215 OBJ_Length_35 24;
BA_ "GenSigStartValue" SG_ 214 OBJ_Absolute_Speed_STD_34 1300;
BA_ "GenSigStartValue" SG_ 213 OBJ_Width_34 40;
BA_ "GenSigStartValue" SG_ 213 OBJ_Length_34 24;
BA_ "GenSigStartValue" SG_ 212 OBJ_Absolute_Speed_STD_33 1300;
BA_ "GenSigStartValue" SG_ 211 OBJ_Width_33 40;
BA_ "GenSigStartValue" SG_ 211 OBJ_Length_33 24;
BA_ "GenSigStartValue" SG_ 210 OBJ_Absolute_Speed_STD_32 1300;
BA_ "GenSigStartValue" SG_ 209 OBJ_Width_32 40;
BA_ "GenSigStartValue" SG_ 209 OBJ_Length_32 24;
BA_ "GenSigStartValue" SG_ 208 OBJ_Absolute_Speed_STD_31 1300;
BA_ "GenSigStartValue" SG_ 207 OBJ_Width_31 40;
BA_ "GenSigStartValue" SG_ 207 OBJ_Length_31 24;
BA_ "GenSigStartValue" SG_ 206 OBJ_Absolute_Speed_STD_30 1300;
BA_ "GenSigStartValue" SG_ 205 OBJ_Width_30 40;
BA_ "GenSigStartValue" SG_ 205 OBJ_Length_30 24;
BA_ "GenSigStartValue" SG_ 204 OBJ_Absolute_Speed_STD_29 1300;
BA_ "GenSigStartValue" SG_ 203 OBJ_Width_29 40;
BA_ "GenSigStartValue" SG_ 203 OBJ_Length_29 24;
BA_ "GenSigStartValue" SG_ 202 OBJ_Absolute_Speed_STD_28 1300;
BA_ "GenSigStartValue" SG_ 201 OBJ_Width_28 40;
BA_ "GenSigStartValue" SG_ 201 OBJ_Length_28 24;
BA_ "GenSigStartValue" SG_ 200 OBJ_Absolute_Speed_STD_27 1300;
BA_ "GenSigStartValue" SG_ 199 OBJ_Width_27 40;
BA_ "GenSigStartValue" SG_ 199 OBJ_Length_27 24;
BA_ "GenSigStartValue" SG_ 198 OBJ_Absolute_Speed_STD_26 1300;
BA_ "GenSigStartValue" SG_ 197 OBJ_Width_26 40;
BA_ "GenSigStartValue" SG_ 197 OBJ_Length_26 24;
VAL_ 216 OBJ_Relative_Long_Velocity_V_35 1 "VALID" 0 "INVALID" ;
VAL_ 216 OBJ_Rel_Long_Vel_STD_V_35 1 "VALID" 0 "INVALID" ;
VAL_ 216 OBJ_Relative_Lat_Velocity_V_35 1 "VALID" 0 "INVALID" ;
VAL_ 216 OBJ_Rel_Lat_Vel_STD_V_35 1 "VALID" 0 "INVALID" ;
VAL_ 216 OBJ_Long_Distance_V_35 1 "VALID" 0 "INVALID" ;
VAL_ 216 OBJ_Long_Distance_STD_V_35 1 "VALID" 0 "INVALID" ;
VAL_ 216 OBJ_Lat_Distance_V_35 1 "VALID" 0 "INVALID" ;
VAL_ 216 OBJ_Lat_Distance_STD_V_35 1 "VALID" 0 "INVALID" ;
VAL_ 216 OBJ_Absolute_Speed_V_35 1 "VALID" 0 "INVALID" ;
VAL_ 216 OBJ_Absolute_Speed_STD_V_35 1 "VALID" 0 "INVALID" ;
VAL_ 216 OBJ_Heading_V_35 1 "VALID" 0 "INVALID" ;
VAL_ 216 OBJ_Heading_STD_V_35 1 "VALID" 0 "INVALID" ;
VAL_ 216 OBJ_Angle_Rate_STD_V_35 1 "VALID" 0 "INVALID" ;
VAL_ 216 OBJ_Angle_Rate_V_35 1 "VALID" 0 "INVALID" ;
VAL_ 216 OBJ_Angle_Right_V_35 1 "VALID" 0 "INVALID" ;
VAL_ 216 OBJ_Angle_Right_STD_V_35 1 "VALID" 0 "INVALID" ;
VAL_ 216 OBJ_Angle_Left_V_35 1 "VALID" 0 "INVALID" ;
VAL_ 216 OBJ_Angle_Left_STD_V_35 1 "VALID" 0 "INVALID" ;
VAL_ 216 OBJ_Angle_Side_V_35 1 "VALID" 0 "INVALID" ;
VAL_ 216 OBJ_Angle_Side_STD_V_35 1 "VALID" 0 "INVALID" ;
VAL_ 216 OBJ_Angle_Mid_V_35 1 "VALID" 0 "INVALID" ;
VAL_ 216 OBJ_Angle_Mid_STD_V_35 1 "VALID" 0 "INVALID" ;
VAL_ 216 OBJ_Angle_Bottom_V_35 1 "VALID" 0 "INVALID" ;
VAL_ 216 OBJ_Angle_Bottom_STD_V_35 1 "VALID" 0 "INVALID" ;
VAL_ 216 OBJ_Visibility_Side_V_35 1 "VALID" 0 "INVALID" ;
VAL_ 216 OBJ_Visibility_Side_35 2 "REAR" 1 "FRONT" 0 "NOT_VISIBLE" ;
VAL_ 216 OBJ_Is_In_Drivable_Area_35 1 "TRUE" 0 "FALSE" ;
VAL_ 216 OBJ_Is_In_Drivable_Area_V_35 1 "VALID" 0 "INVALID" ;
VAL_ 216 OBJ_Is_VeryClose_35 1 "TRUE" 0 "FALSE" ;
VAL_ 216 OBJ_Is_VeryClose_V_35 1 "VALID" 0 "INVALID" ;
VAL_ 215 OBJ_Triggered_SDM_35 2 "NOT_TRIGGERED" 1 "TRIGGERED" 0 "NOT_AVAILABLE" ;
VAL_ 215 OBJ_Motion_Category_35 13 "ONCOMING" 12 "PRECEEDING" 11 "MOVING" 10 "RTAP" 9 "LTAP" 8 "CROSSING" 7 "MOVING_OUT" 6 "MOVING_IN" 5 "CLOSE_CUT_IN" 4 "PASSING_OUT" 3 "PASSING_IN" 2 "PASSING" 1 "UNDEFINED" 0 "INVALID" ;
VAL_ 215 OBJ_Measuring_Status_35 2 "(BIT_2)NOT_VALID_OR_VALID" 1 "(BIT_1)PREDICTED_OR_MEASURED" 0 "(BIT_0)OLD_OR_NEW" ;
VAL_ 215 OBJ_Object_Class_35 8 "UNCERTAIN_VCL" 7 "ANIMAL" 6 "GENERAL_OBJECT" 5 "PEDESTRIAN" 4 "BICYCLE" 3 "MOTOR_BIKE" 2 "TRUCK" 1 "CAR" 0 "INVALID" ;
VAL_ 215 OBJ_Camera_Source_35 11 "PARKING_RIGHT" 10 "PARKING_LEFT" 9 "PARKING_REAR" 8 "PARKING_FRONT" 7 "FRONT_CORNER_RIGHT" 6 "FRONT_CORNER_LEFT" 5 "REAR_CORNER_RIGHT" 4 "REAR_CORNER_LEFT" 3 "REAR" 2 "FRONT_FISHEYE" 1 "FRONT_NARROW" 0 "FRONT_MAIN" ;
VAL_ 215 OBJ_Motion_Status_35 5 "MOVING_SLOWLY" 4 "STOPPED" 3 "STATIONARY" 2 "MOVING" 1 "UNKNOWN" 0 "INVALID" ;
VAL_ 215 OBJ_Motion_Orientation_35 13 "UNKNOWN" 12 "PRECEEDING" 11 "DRIFTING_LEFT" 9 "CROSSING_LEFT" 7 "OC_DRIFTING_LEFT" 6 "ONCOMING" 5 "OC_DRIFTING_RIGHT" 3 "CROSSING_RIGHT" 1 "DRIFTING_RIGHT" 0 "INVALID" ;
VAL_ 215 OBJ_Has_Cut_Lane_35 1 "TRUE" 0 "FALSE" ;
VAL_ 215 OBJ_Has_Cut_Path_35 1 "TRUE" 0 "FALSE" ;
VAL_ 215 OBJ_Brake_Light_35 1 "TRUE" 0 "FALSE" ;
VAL_ 215 OBJ_Turn_Indicator_Right_35 1 "TRUE" 0 "FALSE" ;
VAL_ 215 OBJ_Turn_Indicator_Left_35 1 "TRUE" 0 "FALSE" ;
VAL_ 215 OBJ_Light_Indicator_Validity_35 1 "TRUE" 0 "FALSE" ;
VAL_ 215 OBJ_Right_Out_Of_Image_35 1 "TRUE" 0 "FALSE" ;
VAL_ 215 OBJ_Left_Out_Of_Image_35 1 "TRUE" 0 "FALSE" ;
VAL_ 215 OBJ_Right_Out_Of_Image_V_35 1 "TRUE" 0 "FALSE" ;
VAL_ 215 OBJ_Left_Out_Of_Image_V_35 1 "TRUE" 0 "FALSE" ;
VAL_ 215 OBJ_Top_Out_Of_Image_35 1 "TRUE" 0 "FALSE" ;
VAL_ 215 OBJ_Bottom_Out_Of_Image_35 1 "TRUE" 0 "FALSE" ;
VAL_ 215 OBJ_Top_Out_Of_Image_V_35 1 "VALID" 0 "INVALID" ;
VAL_ 215 OBJ_Bottom_Out_Of_Image_V_35 1 "VALID" 0 "INVALID" ;
VAL_ 215 OBJ_Lane_Assignment_35 5 "RIGHT_RIGHT" 4 "RIGHT" 3 "HOST" 2 "LEFT" 1 "LEFT_LEFT" 0 "UNKNOWN" ;
VAL_ 215 OBJ_Lane_Assignment_V_35 1 "VALID" 0 "INVALID" ;
VAL_ 215 OBJ_Age_Seconds_V_35 1 "VALID" 0 "INVALID" ;
VAL_ 215 OBJ_Width_V_35 1 "VALID" 0 "INVALID" ;
VAL_ 215 OBJ_Width_STD_V_35 1 "VALID" 0 "INVALID" ;
VAL_ 215 OBJ_Length_V_35 1 "VALID" 0 "INVALID" ;
VAL_ 215 OBJ_Length_STD_V_35 1 "VALID" 0 "INVALID" ;
VAL_ 215 OBJ_Height_V_35 1 "VALID" 0 "INVALID" ;
VAL_ 215 OBJ_Height_STD_V_35 1 "VALID" 0 "INVALID" ;
VAL_ 215 OBJ_Abs_Long_Velocity_V_35 1 "VALID" 0 "INVALID" ;
VAL_ 215 OBJ_Abs_Long_Vel_STD_V_35 1 "VALID" 0 "INVALID" ;
VAL_ 215 OBJ_Abs_Lat_Velocity_V_35 1 "VALID" 0 "INVALID" ;
VAL_ 215 OBJ_Abs_Lat_Vel_STD_V_35 1 "VALID" 0 "INVALID" ;
VAL_ 215 OBJ_Abs_Long_Acc_V_35 1 "VALID" 0 "INVALID" ;
VAL_ 215 OBJ_Abs_Long_Acc_STD_V_35 1 "VALID" 0 "INVALID" ;
VAL_ 215 OBJ_Abs_Lat_Acc_V_35 1 "VALID" 0 "INVALID" ;
VAL_ 215 OBJ_Abs_Lat_Acc_STD_V_35 1 "VALID" 0 "INVALID" ;
VAL_ 215 OBJ_Abs_Acceleration_V_35 1 "VALID" 0 "INVALID" ;
VAL_ 215 OBJ_Abs_Acc_STD_V_35 1 "VALID" 0 "INVALID" ;
VAL_ 215 OBJ_Inv_TTC_V_35 1 "VALID" 0 "INVALID" ;
VAL_ 215 OBJ_Inv_TTC_STD_V_35 1 "VALID" 0 "INVALID" ;
VAL_ 215 OBJ_Relative_Long_Acc_V_35 1 "VALID" 0 "INVALID" ;
VAL_ 215 OBJ_Rel_Long_Acc_STD_V_35 1 "VALID" 0 "INVALID" ;
VAL_ 214 OBJ_Relative_Long_Velocity_V_34 1 "VALID" 0 "INVALID" ;
VAL_ 214 OBJ_Rel_Long_Vel_STD_V_34 1 "VALID" 0 "INVALID" ;
VAL_ 214 OBJ_Relative_Lat_Velocity_V_34 1 "VALID" 0 "INVALID" ;
VAL_ 214 OBJ_Rel_Lat_Vel_STD_V_34 1 "VALID" 0 "INVALID" ;
VAL_ 214 OBJ_Long_Distance_V_34 1 "VALID" 0 "INVALID" ;
VAL_ 214 OBJ_Long_Distance_STD_V_34 1 "VALID" 0 "INVALID" ;
VAL_ 214 OBJ_Lat_Distance_V_34 1 "VALID" 0 "INVALID" ;
VAL_ 214 OBJ_Lat_Distance_STD_V_34 1 "VALID" 0 "INVALID" ;
VAL_ 214 OBJ_Absolute_Speed_V_34 1 "VALID" 0 "INVALID" ;
VAL_ 214 OBJ_Absolute_Speed_STD_V_34 1 "VALID" 0 "INVALID" ;
VAL_ 214 OBJ_Heading_V_34 1 "VALID" 0 "INVALID" ;
VAL_ 214 OBJ_Heading_STD_V_34 1 "VALID" 0 "INVALID" ;
VAL_ 214 OBJ_Angle_Rate_STD_V_34 1 "VALID" 0 "INVALID" ;
VAL_ 214 OBJ_Angle_Rate_V_34 1 "VALID" 0 "INVALID" ;
VAL_ 214 OBJ_Angle_Right_V_34 1 "VALID" 0 "INVALID" ;
VAL_ 214 OBJ_Angle_Right_STD_V_34 1 "VALID" 0 "INVALID" ;
VAL_ 214 OBJ_Angle_Left_V_34 1 "VALID" 0 "INVALID" ;
VAL_ 214 OBJ_Angle_Left_STD_V_34 1 "VALID" 0 "INVALID" ;
VAL_ 214 OBJ_Angle_Side_V_34 1 "VALID" 0 "INVALID" ;
VAL_ 214 OBJ_Angle_Side_STD_V_34 1 "VALID" 0 "INVALID" ;
VAL_ 214 OBJ_Angle_Mid_V_34 1 "VALID" 0 "INVALID" ;
VAL_ 214 OBJ_Angle_Mid_STD_V_34 1 "VALID" 0 "INVALID" ;
VAL_ 214 OBJ_Angle_Bottom_V_34 1 "VALID" 0 "INVALID" ;
VAL_ 214 OBJ_Angle_Bottom_STD_V_34 1 "VALID" 0 "INVALID" ;
VAL_ 214 OBJ_Visibility_Side_V_34 1 "VALID" 0 "INVALID" ;
VAL_ 214 OBJ_Visibility_Side_34 2 "REAR" 1 "FRONT" 0 "NOT_VISIBLE" ;
VAL_ 214 OBJ_Is_In_Drivable_Area_34 1 "TRUE" 0 "FALSE" ;
VAL_ 214 OBJ_Is_In_Drivable_Area_V_34 1 "VALID" 0 "INVALID" ;
VAL_ 214 OBJ_Is_VeryClose_34 1 "TRUE" 0 "FALSE" ;
VAL_ 214 OBJ_Is_VeryClose_V_34 1 "VALID" 0 "INVALID" ;
VAL_ 213 OBJ_Triggered_SDM_34 2 "NOT_TRIGGERED" 1 "TRIGGERED" 0 "NOT_AVAILABLE" ;
VAL_ 213 OBJ_Motion_Category_34 13 "ONCOMING" 12 "PRECEEDING" 11 "MOVING" 10 "RTAP" 9 "LTAP" 8 "CROSSING" 7 "MOVING_OUT" 6 "MOVING_IN" 5 "CLOSE_CUT_IN" 4 "PASSING_OUT" 3 "PASSING_IN" 2 "PASSING" 1 "UNDEFINED" 0 "INVALID" ;
VAL_ 213 OBJ_Measuring_Status_34 2 "(BIT_2)NOT_VALID_OR_VALID" 1 "(BIT_1)PREDICTED_OR_MEASURED" 0 "(BIT_0)OLD_OR_NEW" ;
VAL_ 213 OBJ_Object_Class_34 8 "UNCERTAIN_VCL" 7 "ANIMAL" 6 "GENERAL_OBJECT" 5 "PEDESTRIAN" 4 "BICYCLE" 3 "MOTOR_BIKE" 2 "TRUCK" 1 "CAR" 0 "INVALID" ;
VAL_ 213 OBJ_Camera_Source_34 11 "PARKING_RIGHT" 10 "PARKING_LEFT" 9 "PARKING_REAR" 8 "PARKING_FRONT" 7 "FRONT_CORNER_RIGHT" 6 "FRONT_CORNER_LEFT" 5 "REAR_CORNER_RIGHT" 4 "REAR_CORNER_LEFT" 3 "REAR" 2 "FRONT_FISHEYE" 1 "FRONT_NARROW" 0 "FRONT_MAIN" ;
VAL_ 213 OBJ_Motion_Status_34 5 "MOVING_SLOWLY" 4 "STOPPED" 3 "STATIONARY" 2 "MOVING" 1 "UNKNOWN" 0 "INVALID" ;
VAL_ 213 OBJ_Motion_Orientation_34 13 "UNKNOWN" 12 "PRECEEDING" 11 "DRIFTING_LEFT" 9 "CROSSING_LEFT" 7 "OC_DRIFTING_LEFT" 6 "ONCOMING" 5 "OC_DRIFTING_RIGHT" 3 "CROSSING_RIGHT" 1 "DRIFTING_RIGHT" 0 "INVALID" ;
VAL_ 213 OBJ_Has_Cut_Lane_34 1 "TRUE" 0 "FALSE" ;
VAL_ 213 OBJ_Has_Cut_Path_34 1 "TRUE" 0 "FALSE" ;
VAL_ 213 OBJ_Brake_Light_34 1 "TRUE" 0 "FALSE" ;
VAL_ 213 OBJ_Turn_Indicator_Right_34 1 "TRUE" 0 "FALSE" ;
VAL_ 213 OBJ_Turn_Indicator_Left_34 1 "TRUE" 0 "FALSE" ;
VAL_ 213 OBJ_Light_Indicator_Validity_34 1 "TRUE" 0 "FALSE" ;
VAL_ 213 OBJ_Right_Out_Of_Image_34 1 "TRUE" 0 "FALSE" ;
VAL_ 213 OBJ_Left_Out_Of_Image_34 1 "TRUE" 0 "FALSE" ;
VAL_ 213 OBJ_Right_Out_Of_Image_V_34 1 "TRUE" 0 "FALSE" ;
VAL_ 213 OBJ_Left_Out_Of_Image_V_34 1 "TRUE" 0 "FALSE" ;
VAL_ 213 OBJ_Top_Out_Of_Image_34 1 "TRUE" 0 "FALSE" ;
VAL_ 213 OBJ_Bottom_Out_Of_Image_34 1 "TRUE" 0 "FALSE" ;
VAL_ 213 OBJ_Top_Out_Of_Image_V_34 1 "VALID" 0 "INVALID" ;
VAL_ 213 OBJ_Bottom_Out_Of_Image_V_34 1 "VALID" 0 "INVALID" ;
VAL_ 213 OBJ_Lane_Assignment_34 5 "RIGHT_RIGHT" 4 "RIGHT" 3 "HOST" 2 "LEFT" 1 "LEFT_LEFT" 0 "UNKNOWN" ;
VAL_ 213 OBJ_Lane_Assignment_V_34 1 "VALID" 0 "INVALID" ;
VAL_ 213 OBJ_Age_Seconds_V_34 1 "VALID" 0 "INVALID" ;
VAL_ 213 OBJ_Width_V_34 1 "VALID" 0 "INVALID" ;
VAL_ 213 OBJ_Width_STD_V_34 1 "VALID" 0 "INVALID" ;
VAL_ 213 OBJ_Length_V_34 1 "VALID" 0 "INVALID" ;
VAL_ 213 OBJ_Length_STD_V_34 1 "VALID" 0 "INVALID" ;
VAL_ 213 OBJ_Height_V_34 1 "VALID" 0 "INVALID" ;
VAL_ 213 OBJ_Height_STD_V_34 1 "VALID" 0 "INVALID" ;
VAL_ 213 OBJ_Abs_Long_Velocity_V_34 1 "VALID" 0 "INVALID" ;
VAL_ 213 OBJ_Abs_Long_Vel_STD_V_34 1 "VALID" 0 "INVALID" ;
VAL_ 213 OBJ_Abs_Lat_Velocity_V_34 1 "VALID" 0 "INVALID" ;
VAL_ 213 OBJ_Abs_Lat_Vel_STD_V_34 1 "VALID" 0 "INVALID" ;
VAL_ 213 OBJ_Abs_Long_Acc_V_34 1 "VALID" 0 "INVALID" ;
VAL_ 213 OBJ_Abs_Long_Acc_STD_V_34 1 "VALID" 0 "INVALID" ;
VAL_ 213 OBJ_Abs_Lat_Acc_V_34 1 "VALID" 0 "INVALID" ;
VAL_ 213 OBJ_Abs_Lat_Acc_STD_V_34 1 "VALID" 0 "INVALID" ;
VAL_ 213 OBJ_Abs_Acceleration_V_34 1 "VALID" 0 "INVALID" ;
VAL_ 213 OBJ_Abs_Acc_STD_V_34 1 "VALID" 0 "INVALID" ;
VAL_ 213 OBJ_Inv_TTC_V_34 1 "VALID" 0 "INVALID" ;
VAL_ 213 OBJ_Inv_TTC_STD_V_34 1 "VALID" 0 "INVALID" ;
VAL_ 213 OBJ_Relative_Long_Acc_V_34 1 "VALID" 0 "INVALID" ;
VAL_ 213 OBJ_Rel_Long_Acc_STD_V_34 1 "VALID" 0 "INVALID" ;
VAL_ 212 OBJ_Relative_Long_Velocity_V_33 1 "VALID" 0 "INVALID" ;
VAL_ 212 OBJ_Rel_Long_Vel_STD_V_33 1 "VALID" 0 "INVALID" ;
VAL_ 212 OBJ_Relative_Lat_Velocity_V_33 1 "VALID" 0 "INVALID" ;
VAL_ 212 OBJ_Rel_Lat_Vel_STD_V_33 1 "VALID" 0 "INVALID" ;
VAL_ 212 OBJ_Long_Distance_V_33 1 "VALID" 0 "INVALID" ;
VAL_ 212 OBJ_Long_Distance_STD_V_33 1 "VALID" 0 "INVALID" ;
VAL_ 212 OBJ_Lat_Distance_V_33 1 "VALID" 0 "INVALID" ;
VAL_ 212 OBJ_Lat_Distance_STD_V_33 1 "VALID" 0 "INVALID" ;
VAL_ 212 OBJ_Absolute_Speed_V_33 1 "VALID" 0 "INVALID" ;
VAL_ 212 OBJ_Absolute_Speed_STD_V_33 1 "VALID" 0 "INVALID" ;
VAL_ 212 OBJ_Heading_V_33 1 "VALID" 0 "INVALID" ;
VAL_ 212 OBJ_Heading_STD_V_33 1 "VALID" 0 "INVALID" ;
VAL_ 212 OBJ_Angle_Rate_STD_V_33 1 "VALID" 0 "INVALID" ;
VAL_ 212 OBJ_Angle_Rate_V_33 1 "VALID" 0 "INVALID" ;
VAL_ 212 OBJ_Angle_Right_V_33 1 "VALID" 0 "INVALID" ;
VAL_ 212 OBJ_Angle_Right_STD_V_33 1 "VALID" 0 "INVALID" ;
VAL_ 212 OBJ_Angle_Left_V_33 1 "VALID" 0 "INVALID" ;
VAL_ 212 OBJ_Angle_Left_STD_V_33 1 "VALID" 0 "INVALID" ;
VAL_ 212 OBJ_Angle_Side_V_33 1 "VALID" 0 "INVALID" ;
VAL_ 212 OBJ_Angle_Side_STD_V_33 1 "VALID" 0 "INVALID" ;
VAL_ 212 OBJ_Angle_Mid_V_33 1 "VALID" 0 "INVALID" ;
VAL_ 212 OBJ_Angle_Mid_STD_V_33 1 "VALID" 0 "INVALID" ;
VAL_ 212 OBJ_Angle_Bottom_V_33 1 "VALID" 0 "INVALID" ;
VAL_ 212 OBJ_Angle_Bottom_STD_V_33 1 "VALID" 0 "INVALID" ;
VAL_ 212 OBJ_Visibility_Side_V_33 1 "VALID" 0 "INVALID" ;
VAL_ 212 OBJ_Visibility_Side_33 2 "REAR" 1 "FRONT" 0 "NOT_VISIBLE" ;
VAL_ 212 OBJ_Is_In_Drivable_Area_33 1 "TRUE" 0 "FALSE" ;
VAL_ 212 OBJ_Is_In_Drivable_Area_V_33 1 "VALID" 0 "INVALID" ;
VAL_ 212 OBJ_Is_VeryClose_33 1 "TRUE" 0 "FALSE" ;
VAL_ 212 OBJ_Is_VeryClose_V_33 1 "VALID" 0 "INVALID" ;
VAL_ 211 OBJ_Triggered_SDM_33 2 "NOT_TRIGGERED" 1 "TRIGGERED" 0 "NOT_AVAILABLE" ;
VAL_ 211 OBJ_Motion_Category_33 13 "ONCOMING" 12 "PRECEEDING" 11 "MOVING" 10 "RTAP" 9 "LTAP" 8 "CROSSING" 7 "MOVING_OUT" 6 "MOVING_IN" 5 "CLOSE_CUT_IN" 4 "PASSING_OUT" 3 "PASSING_IN" 2 "PASSING" 1 "UNDEFINED" 0 "INVALID" ;
VAL_ 211 OBJ_Measuring_Status_33 2 "(BIT_2)NOT_VALID_OR_VALID" 1 "(BIT_1)PREDICTED_OR_MEASURED" 0 "(BIT_0)OLD_OR_NEW" ;
VAL_ 211 OBJ_Object_Class_33 8 "UNCERTAIN_VCL" 7 "ANIMAL" 6 "GENERAL_OBJECT" 5 "PEDESTRIAN" 4 "BICYCLE" 3 "MOTOR_BIKE" 2 "TRUCK" 1 "CAR" 0 "INVALID" ;
VAL_ 211 OBJ_Camera_Source_33 11 "PARKING_RIGHT" 10 "PARKING_LEFT" 9 "PARKING_REAR" 8 "PARKING_FRONT" 7 "FRONT_CORNER_RIGHT" 6 "FRONT_CORNER_LEFT" 5 "REAR_CORNER_RIGHT" 4 "REAR_CORNER_LEFT" 3 "REAR" 2 "FRONT_FISHEYE" 1 "FRONT_NARROW" 0 "FRONT_MAIN" ;
VAL_ 211 OBJ_Motion_Status_33 5 "MOVING_SLOWLY" 4 "STOPPED" 3 "STATIONARY" 2 "MOVING" 1 "UNKNOWN" 0 "INVALID" ;
VAL_ 211 OBJ_Motion_Orientation_33 13 "UNKNOWN" 12 "PRECEEDING" 11 "DRIFTING_LEFT" 9 "CROSSING_LEFT" 7 "OC_DRIFTING_LEFT" 6 "ONCOMING" 5 "OC_DRIFTING_RIGHT" 3 "CROSSING_RIGHT" 1 "DRIFTING_RIGHT" 0 "INVALID" ;
VAL_ 211 OBJ_Has_Cut_Lane_33 1 "TRUE" 0 "FALSE" ;
VAL_ 211 OBJ_Has_Cut_Path_33 1 "TRUE" 0 "FALSE" ;
VAL_ 211 OBJ_Brake_Light_33 1 "TRUE" 0 "FALSE" ;
VAL_ 211 OBJ_Turn_Indicator_Right_33 1 "TRUE" 0 "FALSE" ;
VAL_ 211 OBJ_Turn_Indicator_Left_33 1 "TRUE" 0 "FALSE" ;
VAL_ 211 OBJ_Light_Indicator_Validity_33 1 "TRUE" 0 "FALSE" ;
VAL_ 211 OBJ_Right_Out_Of_Image_33 1 "TRUE" 0 "FALSE" ;
VAL_ 211 OBJ_Left_Out_Of_Image_33 1 "TRUE" 0 "FALSE" ;
VAL_ 211 OBJ_Right_Out_Of_Image_V_33 1 "TRUE" 0 "FALSE" ;
VAL_ 211 OBJ_Left_Out_Of_Image_V_33 1 "TRUE" 0 "FALSE" ;
VAL_ 211 OBJ_Top_Out_Of_Image_33 1 "TRUE" 0 "FALSE" ;
VAL_ 211 OBJ_Bottom_Out_Of_Image_33 1 "TRUE" 0 "FALSE" ;
VAL_ 211 OBJ_Top_Out_Of_Image_V_33 1 "VALID" 0 "INVALID" ;
VAL_ 211 OBJ_Bottom_Out_Of_Image_V_33 1 "VALID" 0 "INVALID" ;
VAL_ 211 OBJ_Lane_Assignment_33 5 "RIGHT_RIGHT" 4 "RIGHT" 3 "HOST" 2 "LEFT" 1 "LEFT_LEFT" 0 "UNKNOWN" ;
VAL_ 211 OBJ_Lane_Assignment_V_33 1 "VALID" 0 "INVALID" ;
VAL_ 211 OBJ_Age_Seconds_V_33 1 "VALID" 0 "INVALID" ;
VAL_ 211 OBJ_Width_V_33 1 "VALID" 0 "INVALID" ;
VAL_ 211 OBJ_Width_STD_V_33 1 "VALID" 0 "INVALID" ;
VAL_ 211 OBJ_Length_V_33 1 "VALID" 0 "INVALID" ;
VAL_ 211 OBJ_Length_STD_V_33 1 "VALID" 0 "INVALID" ;
VAL_ 211 OBJ_Height_V_33 1 "VALID" 0 "INVALID" ;
VAL_ 211 OBJ_Height_STD_V_33 1 "VALID" 0 "INVALID" ;
VAL_ 211 OBJ_Abs_Long_Velocity_V_33 1 "VALID" 0 "INVALID" ;
VAL_ 211 OBJ_Abs_Long_Vel_STD_V_33 1 "VALID" 0 "INVALID" ;
VAL_ 211 OBJ_Abs_Lat_Velocity_V_33 1 "VALID" 0 "INVALID" ;
VAL_ 211 OBJ_Abs_Lat_Vel_STD_V_33 1 "VALID" 0 "INVALID" ;
VAL_ 211 OBJ_Abs_Long_Acc_V_33 1 "VALID" 0 "INVALID" ;
VAL_ 211 OBJ_Abs_Long_Acc_STD_V_33 1 "VALID" 0 "INVALID" ;
VAL_ 211 OBJ_Abs_Lat_Acc_V_33 1 "VALID" 0 "INVALID" ;
VAL_ 211 OBJ_Abs_Lat_Acc_STD_V_33 1 "VALID" 0 "INVALID" ;
VAL_ 211 OBJ_Abs_Acceleration_V_33 1 "VALID" 0 "INVALID" ;
VAL_ 211 OBJ_Abs_Acc_STD_V_33 1 "VALID" 0 "INVALID" ;
VAL_ 211 OBJ_Inv_TTC_V_33 1 "VALID" 0 "INVALID" ;
VAL_ 211 OBJ_Inv_TTC_STD_V_33 1 "VALID" 0 "INVALID" ;
VAL_ 211 OBJ_Relative_Long_Acc_V_33 1 "VALID" 0 "INVALID" ;
VAL_ 211 OBJ_Rel_Long_Acc_STD_V_33 1 "VALID" 0 "INVALID" ;
VAL_ 210 OBJ_Relative_Long_Velocity_V_32 1 "VALID" 0 "INVALID" ;
VAL_ 210 OBJ_Rel_Long_Vel_STD_V_32 1 "VALID" 0 "INVALID" ;
VAL_ 210 OBJ_Relative_Lat_Velocity_V_32 1 "VALID" 0 "INVALID" ;
VAL_ 210 OBJ_Rel_Lat_Vel_STD_V_32 1 "VALID" 0 "INVALID" ;
VAL_ 210 OBJ_Long_Distance_V_32 1 "VALID" 0 "INVALID" ;
VAL_ 210 OBJ_Long_Distance_STD_V_32 1 "VALID" 0 "INVALID" ;
VAL_ 210 OBJ_Lat_Distance_V_32 1 "VALID" 0 "INVALID" ;
VAL_ 210 OBJ_Lat_Distance_STD_V_32 1 "VALID" 0 "INVALID" ;
VAL_ 210 OBJ_Absolute_Speed_V_32 1 "VALID" 0 "INVALID" ;
VAL_ 210 OBJ_Absolute_Speed_STD_V_32 1 "VALID" 0 "INVALID" ;
VAL_ 210 OBJ_Heading_V_32 1 "VALID" 0 "INVALID" ;
VAL_ 210 OBJ_Heading_STD_V_32 1 "VALID" 0 "INVALID" ;
VAL_ 210 OBJ_Angle_Rate_STD_V_32 1 "VALID" 0 "INVALID" ;
VAL_ 210 OBJ_Angle_Rate_V_32 1 "VALID" 0 "INVALID" ;
VAL_ 210 OBJ_Angle_Right_V_32 1 "VALID" 0 "INVALID" ;
VAL_ 210 OBJ_Angle_Right_STD_V_32 1 "VALID" 0 "INVALID" ;
VAL_ 210 OBJ_Angle_Left_V_32 1 "VALID" 0 "INVALID" ;
VAL_ 210 OBJ_Angle_Left_STD_V_32 1 "VALID" 0 "INVALID" ;
VAL_ 210 OBJ_Angle_Side_V_32 1 "VALID" 0 "INVALID" ;
VAL_ 210 OBJ_Angle_Side_STD_V_32 1 "VALID" 0 "INVALID" ;
VAL_ 210 OBJ_Angle_Mid_V_32 1 "VALID" 0 "INVALID" ;
VAL_ 210 OBJ_Angle_Mid_STD_V_32 1 "VALID" 0 "INVALID" ;
VAL_ 210 OBJ_Angle_Bottom_V_32 1 "VALID" 0 "INVALID" ;
VAL_ 210 OBJ_Angle_Bottom_STD_V_32 1 "VALID" 0 "INVALID" ;
VAL_ 210 OBJ_Visibility_Side_V_32 1 "VALID" 0 "INVALID" ;
VAL_ 210 OBJ_Visibility_Side_32 2 "REAR" 1 "FRONT" 0 "NOT_VISIBLE" ;
VAL_ 210 OBJ_Is_In_Drivable_Area_32 1 "TRUE" 0 "FALSE" ;
VAL_ 210 OBJ_Is_In_Drivable_Area_V_32 1 "VALID" 0 "INVALID" ;
VAL_ 210 OBJ_Is_VeryClose_32 1 "TRUE" 0 "FALSE" ;
VAL_ 210 OBJ_Is_VeryClose_V_32 1 "VALID" 0 "INVALID" ;
VAL_ 209 OBJ_Triggered_SDM_32 2 "NOT_TRIGGERED" 1 "TRIGGERED" 0 "NOT_AVAILABLE" ;
VAL_ 209 OBJ_Motion_Category_32 13 "ONCOMING" 12 "PRECEEDING" 11 "MOVING" 10 "RTAP" 9 "LTAP" 8 "CROSSING" 7 "MOVING_OUT" 6 "MOVING_IN" 5 "CLOSE_CUT_IN" 4 "PASSING_OUT" 3 "PASSING_IN" 2 "PASSING" 1 "UNDEFINED" 0 "INVALID" ;
VAL_ 209 OBJ_Measuring_Status_32 2 "(BIT_2)NOT_VALID_OR_VALID" 1 "(BIT_1)PREDICTED_OR_MEASURED" 0 "(BIT_0)OLD_OR_NEW" ;
VAL_ 209 OBJ_Object_Class_32 8 "UNCERTAIN_VCL" 7 "ANIMAL" 6 "GENERAL_OBJECT" 5 "PEDESTRIAN" 4 "BICYCLE" 3 "MOTOR_BIKE" 2 "TRUCK" 1 "CAR" 0 "INVALID" ;
VAL_ 209 OBJ_Camera_Source_32 11 "PARKING_RIGHT" 10 "PARKING_LEFT" 9 "PARKING_REAR" 8 "PARKING_FRONT" 7 "FRONT_CORNER_RIGHT" 6 "FRONT_CORNER_LEFT" 5 "REAR_CORNER_RIGHT" 4 "REAR_CORNER_LEFT" 3 "REAR" 2 "FRONT_FISHEYE" 1 "FRONT_NARROW" 0 "FRONT_MAIN" ;
VAL_ 209 OBJ_Motion_Status_32 5 "MOVING_SLOWLY" 4 "STOPPED" 3 "STATIONARY" 2 "MOVING" 1 "UNKNOWN" 0 "INVALID" ;
VAL_ 209 OBJ_Motion_Orientation_32 13 "UNKNOWN" 12 "PRECEEDING" 11 "DRIFTING_LEFT" 9 "CROSSING_LEFT" 7 "OC_DRIFTING_LEFT" 6 "ONCOMING" 5 "OC_DRIFTING_RIGHT" 3 "CROSSING_RIGHT" 1 "DRIFTING_RIGHT" 0 "INVALID" ;
VAL_ 209 OBJ_Has_Cut_Lane_32 1 "TRUE" 0 "FALSE" ;
VAL_ 209 OBJ_Has_Cut_Path_32 1 "TRUE" 0 "FALSE" ;
VAL_ 209 OBJ_Brake_Light_32 1 "TRUE" 0 "FALSE" ;
VAL_ 209 OBJ_Turn_Indicator_Right_32 1 "TRUE" 0 "FALSE" ;
VAL_ 209 OBJ_Turn_Indicator_Left_32 1 "TRUE" 0 "FALSE" ;
VAL_ 209 OBJ_Light_Indicator_Validity_32 1 "TRUE" 0 "FALSE" ;
VAL_ 209 OBJ_Right_Out_Of_Image_32 1 "TRUE" 0 "FALSE" ;
VAL_ 209 OBJ_Left_Out_Of_Image_32 1 "TRUE" 0 "FALSE" ;
VAL_ 209 OBJ_Right_Out_Of_Image_V_32 1 "TRUE" 0 "FALSE" ;
VAL_ 209 OBJ_Left_Out_Of_Image_V_32 1 "TRUE" 0 "FALSE" ;
VAL_ 209 OBJ_Top_Out_Of_Image_32 1 "TRUE" 0 "FALSE" ;
VAL_ 209 OBJ_Bottom_Out_Of_Image_32 1 "TRUE" 0 "FALSE" ;
VAL_ 209 OBJ_Top_Out_Of_Image_V_32 1 "VALID" 0 "INVALID" ;
VAL_ 209 OBJ_Bottom_Out_Of_Image_V_32 1 "VALID" 0 "INVALID" ;
VAL_ 209 OBJ_Lane_Assignment_32 5 "RIGHT_RIGHT" 4 "RIGHT" 3 "HOST" 2 "LEFT" 1 "LEFT_LEFT" 0 "UNKNOWN" ;
VAL_ 209 OBJ_Lane_Assignment_V_32 1 "VALID" 0 "INVALID" ;
VAL_ 209 OBJ_Age_Seconds_V_32 1 "VALID" 0 "INVALID" ;
VAL_ 209 OBJ_Width_V_32 1 "VALID" 0 "INVALID" ;
VAL_ 209 OBJ_Width_STD_V_32 1 "VALID" 0 "INVALID" ;
VAL_ 209 OBJ_Length_V_32 1 "VALID" 0 "INVALID" ;
VAL_ 209 OBJ_Length_STD_V_32 1 "VALID" 0 "INVALID" ;
VAL_ 209 OBJ_Height_V_32 1 "VALID" 0 "INVALID" ;
VAL_ 209 OBJ_Height_STD_V_32 1 "VALID" 0 "INVALID" ;
VAL_ 209 OBJ_Abs_Long_Velocity_V_32 1 "VALID" 0 "INVALID" ;
VAL_ 209 OBJ_Abs_Long_Vel_STD_V_32 1 "VALID" 0 "INVALID" ;
VAL_ 209 OBJ_Abs_Lat_Velocity_V_32 1 "VALID" 0 "INVALID" ;
VAL_ 209 OBJ_Abs_Lat_Vel_STD_V_32 1 "VALID" 0 "INVALID" ;
VAL_ 209 OBJ_Abs_Long_Acc_V_32 1 "VALID" 0 "INVALID" ;
VAL_ 209 OBJ_Abs_Long_Acc_STD_V_32 1 "VALID" 0 "INVALID" ;
VAL_ 209 OBJ_Abs_Lat_Acc_V_32 1 "VALID" 0 "INVALID" ;
VAL_ 209 OBJ_Abs_Lat_Acc_STD_V_32 1 "VALID" 0 "INVALID" ;
VAL_ 209 OBJ_Abs_Acceleration_V_32 1 "VALID" 0 "INVALID" ;
VAL_ 209 OBJ_Abs_Acc_STD_V_32 1 "VALID" 0 "INVALID" ;
VAL_ 209 OBJ_Inv_TTC_V_32 1 "VALID" 0 "INVALID" ;
VAL_ 209 OBJ_Inv_TTC_STD_V_32 1 "VALID" 0 "INVALID" ;
VAL_ 209 OBJ_Relative_Long_Acc_V_32 1 "VALID" 0 "INVALID" ;
VAL_ 209 OBJ_Rel_Long_Acc_STD_V_32 1 "VALID" 0 "INVALID" ;
VAL_ 208 OBJ_Relative_Long_Velocity_V_31 1 "VALID" 0 "INVALID" ;
VAL_ 208 OBJ_Rel_Long_Vel_STD_V_31 1 "VALID" 0 "INVALID" ;
VAL_ 208 OBJ_Relative_Lat_Velocity_V_31 1 "VALID" 0 "INVALID" ;
VAL_ 208 OBJ_Rel_Lat_Vel_STD_V_31 1 "VALID" 0 "INVALID" ;
VAL_ 208 OBJ_Long_Distance_V_31 1 "VALID" 0 "INVALID" ;
VAL_ 208 OBJ_Long_Distance_STD_V_31 1 "VALID" 0 "INVALID" ;
VAL_ 208 OBJ_Lat_Distance_V_31 1 "VALID" 0 "INVALID" ;
VAL_ 208 OBJ_Lat_Distance_STD_V_31 1 "VALID" 0 "INVALID" ;
VAL_ 208 OBJ_Absolute_Speed_V_31 1 "VALID" 0 "INVALID" ;
VAL_ 208 OBJ_Absolute_Speed_STD_V_31 1 "VALID" 0 "INVALID" ;
VAL_ 208 OBJ_Heading_V_31 1 "VALID" 0 "INVALID" ;
VAL_ 208 OBJ_Heading_STD_V_31 1 "VALID" 0 "INVALID" ;
VAL_ 208 OBJ_Angle_Rate_STD_V_31 1 "VALID" 0 "INVALID" ;
VAL_ 208 OBJ_Angle_Rate_V_31 1 "VALID" 0 "INVALID" ;
VAL_ 208 OBJ_Angle_Right_V_31 1 "VALID" 0 "INVALID" ;
VAL_ 208 OBJ_Angle_Right_STD_V_31 1 "VALID" 0 "INVALID" ;
VAL_ 208 OBJ_Angle_Left_V_31 1 "VALID" 0 "INVALID" ;
VAL_ 208 OBJ_Angle_Left_STD_V_31 1 "VALID" 0 "INVALID" ;
VAL_ 208 OBJ_Angle_Side_V_31 1 "VALID" 0 "INVALID" ;
VAL_ 208 OBJ_Angle_Side_STD_V_31 1 "VALID" 0 "INVALID" ;
VAL_ 208 OBJ_Angle_Mid_V_31 1 "VALID" 0 "INVALID" ;
VAL_ 208 OBJ_Angle_Mid_STD_V_31 1 "VALID" 0 "INVALID" ;
VAL_ 208 OBJ_Angle_Bottom_V_31 1 "VALID" 0 "INVALID" ;
VAL_ 208 OBJ_Angle_Bottom_STD_V_31 1 "VALID" 0 "INVALID" ;
VAL_ 208 OBJ_Visibility_Side_V_31 1 "VALID" 0 "INVALID" ;
VAL_ 208 OBJ_Visibility_Side_31 2 "REAR" 1 "FRONT" 0 "NOT_VISIBLE" ;
VAL_ 208 OBJ_Is_In_Drivable_Area_31 1 "TRUE" 0 "FALSE" ;
VAL_ 208 OBJ_Is_In_Drivable_Area_V_31 1 "VALID" 0 "INVALID" ;
VAL_ 208 OBJ_Is_VeryClose_31 1 "TRUE" 0 "FALSE" ;
VAL_ 208 OBJ_Is_VeryClose_V_31 1 "VALID" 0 "INVALID" ;
VAL_ 207 OBJ_Triggered_SDM_31 2 "NOT_TRIGGERED" 1 "TRIGGERED" 0 "NOT_AVAILABLE" ;
VAL_ 207 OBJ_Motion_Category_31 13 "ONCOMING" 12 "PRECEEDING" 11 "MOVING" 10 "RTAP" 9 "LTAP" 8 "CROSSING" 7 "MOVING_OUT" 6 "MOVING_IN" 5 "CLOSE_CUT_IN" 4 "PASSING_OUT" 3 "PASSING_IN" 2 "PASSING" 1 "UNDEFINED" 0 "INVALID" ;
VAL_ 207 OBJ_Measuring_Status_31 2 "(BIT_2)NOT_VALID_OR_VALID" 1 "(BIT_1)PREDICTED_OR_MEASURED" 0 "(BIT_0)OLD_OR_NEW" ;
VAL_ 207 OBJ_Object_Class_31 8 "UNCERTAIN_VCL" 7 "ANIMAL" 6 "GENERAL_OBJECT" 5 "PEDESTRIAN" 4 "BICYCLE" 3 "MOTOR_BIKE" 2 "TRUCK" 1 "CAR" 0 "INVALID" ;
VAL_ 207 OBJ_Camera_Source_31 11 "PARKING_RIGHT" 10 "PARKING_LEFT" 9 "PARKING_REAR" 8 "PARKING_FRONT" 7 "FRONT_CORNER_RIGHT" 6 "FRONT_CORNER_LEFT" 5 "REAR_CORNER_RIGHT" 4 "REAR_CORNER_LEFT" 3 "REAR" 2 "FRONT_FISHEYE" 1 "FRONT_NARROW" 0 "FRONT_MAIN" ;
VAL_ 207 OBJ_Motion_Status_31 5 "MOVING_SLOWLY" 4 "STOPPED" 3 "STATIONARY" 2 "MOVING" 1 "UNKNOWN" 0 "INVALID" ;
VAL_ 207 OBJ_Motion_Orientation_31 13 "UNKNOWN" 12 "PRECEEDING" 11 "DRIFTING_LEFT" 9 "CROSSING_LEFT" 7 "OC_DRIFTING_LEFT" 6 "ONCOMING" 5 "OC_DRIFTING_RIGHT" 3 "CROSSING_RIGHT" 1 "DRIFTING_RIGHT" 0 "INVALID" ;
VAL_ 207 OBJ_Has_Cut_Lane_31 1 "TRUE" 0 "FALSE" ;
VAL_ 207 OBJ_Has_Cut_Path_31 1 "TRUE" 0 "FALSE" ;
VAL_ 207 OBJ_Brake_Light_31 1 "TRUE" 0 "FALSE" ;
VAL_ 207 OBJ_Turn_Indicator_Right_31 1 "TRUE" 0 "FALSE" ;
VAL_ 207 OBJ_Turn_Indicator_Left_31 1 "TRUE" 0 "FALSE" ;
VAL_ 207 OBJ_Light_Indicator_Validity_31 1 "TRUE" 0 "FALSE" ;
VAL_ 207 OBJ_Right_Out_Of_Image_31 1 "TRUE" 0 "FALSE" ;
VAL_ 207 OBJ_Left_Out_Of_Image_31 1 "TRUE" 0 "FALSE" ;
VAL_ 207 OBJ_Right_Out_Of_Image_V_31 1 "TRUE" 0 "FALSE" ;
VAL_ 207 OBJ_Left_Out_Of_Image_V_31 1 "TRUE" 0 "FALSE" ;
VAL_ 207 OBJ_Top_Out_Of_Image_31 1 "TRUE" 0 "FALSE" ;
VAL_ 207 OBJ_Bottom_Out_Of_Image_31 1 "TRUE" 0 "FALSE" ;
VAL_ 207 OBJ_Top_Out_Of_Image_V_31 1 "VALID" 0 "INVALID" ;
VAL_ 207 OBJ_Bottom_Out_Of_Image_V_31 1 "VALID" 0 "INVALID" ;
VAL_ 207 OBJ_Lane_Assignment_31 5 "RIGHT_RIGHT" 4 "RIGHT" 3 "HOST" 2 "LEFT" 1 "LEFT_LEFT" 0 "UNKNOWN" ;
VAL_ 207 OBJ_Lane_Assignment_V_31 1 "VALID" 0 "INVALID" ;
VAL_ 207 OBJ_Age_Seconds_V_31 1 "VALID" 0 "INVALID" ;
VAL_ 207 OBJ_Width_V_31 1 "VALID" 0 "INVALID" ;
VAL_ 207 OBJ_Width_STD_V_31 1 "VALID" 0 "INVALID" ;
VAL_ 207 OBJ_Length_V_31 1 "VALID" 0 "INVALID" ;
VAL_ 207 OBJ_Length_STD_V_31 1 "VALID" 0 "INVALID" ;
VAL_ 207 OBJ_Height_V_31 1 "VALID" 0 "INVALID" ;
VAL_ 207 OBJ_Height_STD_V_31 1 "VALID" 0 "INVALID" ;
VAL_ 207 OBJ_Abs_Long_Velocity_V_31 1 "VALID" 0 "INVALID" ;
VAL_ 207 OBJ_Abs_Long_Vel_STD_V_31 1 "VALID" 0 "INVALID" ;
VAL_ 207 OBJ_Abs_Lat_Velocity_V_31 1 "VALID" 0 "INVALID" ;
VAL_ 207 OBJ_Abs_Lat_Vel_STD_V_31 1 "VALID" 0 "INVALID" ;
VAL_ 207 OBJ_Abs_Long_Acc_V_31 1 "VALID" 0 "INVALID" ;
VAL_ 207 OBJ_Abs_Long_Acc_STD_V_31 1 "VALID" 0 "INVALID" ;
VAL_ 207 OBJ_Abs_Lat_Acc_V_31 1 "VALID" 0 "INVALID" ;
VAL_ 207 OBJ_Abs_Lat_Acc_STD_V_31 1 "VALID" 0 "INVALID" ;
VAL_ 207 OBJ_Abs_Acceleration_V_31 1 "VALID" 0 "INVALID" ;
VAL_ 207 OBJ_Abs_Acc_STD_V_31 1 "VALID" 0 "INVALID" ;
VAL_ 207 OBJ_Inv_TTC_V_31 1 "VALID" 0 "INVALID" ;
VAL_ 207 OBJ_Inv_TTC_STD_V_31 1 "VALID" 0 "INVALID" ;
VAL_ 207 OBJ_Relative_Long_Acc_V_31 1 "VALID" 0 "INVALID" ;
VAL_ 207 OBJ_Rel_Long_Acc_STD_V_31 1 "VALID" 0 "INVALID" ;
VAL_ 206 OBJ_Relative_Long_Velocity_V_30 1 "VALID" 0 "INVALID" ;
VAL_ 206 OBJ_Rel_Long_Vel_STD_V_30 1 "VALID" 0 "INVALID" ;
VAL_ 206 OBJ_Relative_Lat_Velocity_V_30 1 "VALID" 0 "INVALID" ;
VAL_ 206 OBJ_Rel_Lat_Vel_STD_V_30 1 "VALID" 0 "INVALID" ;
VAL_ 206 OBJ_Long_Distance_V_30 1 "VALID" 0 "INVALID" ;
VAL_ 206 OBJ_Long_Distance_STD_V_30 1 "VALID" 0 "INVALID" ;
VAL_ 206 OBJ_Lat_Distance_V_30 1 "VALID" 0 "INVALID" ;
VAL_ 206 OBJ_Lat_Distance_STD_V_30 1 "VALID" 0 "INVALID" ;
VAL_ 206 OBJ_Absolute_Speed_V_30 1 "VALID" 0 "INVALID" ;
VAL_ 206 OBJ_Absolute_Speed_STD_V_30 1 "VALID" 0 "INVALID" ;
VAL_ 206 OBJ_Heading_V_30 1 "VALID" 0 "INVALID" ;
VAL_ 206 OBJ_Heading_STD_V_30 1 "VALID" 0 "INVALID" ;
VAL_ 206 OBJ_Angle_Rate_STD_V_30 1 "VALID" 0 "INVALID" ;
VAL_ 206 OBJ_Angle_Rate_V_30 1 "VALID" 0 "INVALID" ;
VAL_ 206 OBJ_Angle_Right_V_30 1 "VALID" 0 "INVALID" ;
VAL_ 206 OBJ_Angle_Right_STD_V_30 1 "VALID" 0 "INVALID" ;
VAL_ 206 OBJ_Angle_Left_V_30 1 "VALID" 0 "INVALID" ;
VAL_ 206 OBJ_Angle_Left_STD_V_30 1 "VALID" 0 "INVALID" ;
VAL_ 206 OBJ_Angle_Side_V_30 1 "VALID" 0 "INVALID" ;
VAL_ 206 OBJ_Angle_Side_STD_V_30 1 "VALID" 0 "INVALID" ;
VAL_ 206 OBJ_Angle_Mid_V_30 1 "VALID" 0 "INVALID" ;
VAL_ 206 OBJ_Angle_Mid_STD_V_30 1 "VALID" 0 "INVALID" ;
VAL_ 206 OBJ_Angle_Bottom_V_30 1 "VALID" 0 "INVALID" ;
VAL_ 206 OBJ_Angle_Bottom_STD_V_30 1 "VALID" 0 "INVALID" ;
VAL_ 206 OBJ_Visibility_Side_V_30 1 "VALID" 0 "INVALID" ;
VAL_ 206 OBJ_Visibility_Side_30 2 "REAR" 1 "FRONT" 0 "NOT_VISIBLE" ;
VAL_ 206 OBJ_Is_In_Drivable_Area_30 1 "TRUE" 0 "FALSE" ;
VAL_ 206 OBJ_Is_In_Drivable_Area_V_30 1 "VALID" 0 "INVALID" ;
VAL_ 206 OBJ_Is_VeryClose_30 1 "TRUE" 0 "FALSE" ;
VAL_ 206 OBJ_Is_VeryClose_V_30 1 "VALID" 0 "INVALID" ;
VAL_ 205 OBJ_Triggered_SDM_30 2 "NOT_TRIGGERED" 1 "TRIGGERED" 0 "NOT_AVAILABLE" ;
VAL_ 205 OBJ_Motion_Category_30 13 "ONCOMING" 12 "PRECEEDING" 11 "MOVING" 10 "RTAP" 9 "LTAP" 8 "CROSSING" 7 "MOVING_OUT" 6 "MOVING_IN" 5 "CLOSE_CUT_IN" 4 "PASSING_OUT" 3 "PASSING_IN" 2 "PASSING" 1 "UNDEFINED" 0 "INVALID" ;
VAL_ 205 OBJ_Measuring_Status_30 2 "(BIT_2)NOT_VALID_OR_VALID" 1 "(BIT_1)PREDICTED_OR_MEASURED" 0 "(BIT_0)OLD_OR_NEW" ;
VAL_ 205 OBJ_Object_Class_30 8 "UNCERTAIN_VCL" 7 "ANIMAL" 6 "GENERAL_OBJECT" 5 "PEDESTRIAN" 4 "BICYCLE" 3 "MOTOR_BIKE" 2 "TRUCK" 1 "CAR" 0 "INVALID" ;
VAL_ 205 OBJ_Camera_Source_30 11 "PARKING_RIGHT" 10 "PARKING_LEFT" 9 "PARKING_REAR" 8 "PARKING_FRONT" 7 "FRONT_CORNER_RIGHT" 6 "FRONT_CORNER_LEFT" 5 "REAR_CORNER_RIGHT" 4 "REAR_CORNER_LEFT" 3 "REAR" 2 "FRONT_FISHEYE" 1 "FRONT_NARROW" 0 "FRONT_MAIN" ;
VAL_ 205 OBJ_Motion_Status_30 5 "MOVING_SLOWLY" 4 "STOPPED" 3 "STATIONARY" 2 "MOVING" 1 "UNKNOWN" 0 "INVALID" ;
VAL_ 205 OBJ_Motion_Orientation_30 13 "UNKNOWN" 12 "PRECEEDING" 11 "DRIFTING_LEFT" 9 "CROSSING_LEFT" 7 "OC_DRIFTING_LEFT" 6 "ONCOMING" 5 "OC_DRIFTING_RIGHT" 3 "CROSSING_RIGHT" 1 "DRIFTING_RIGHT" 0 "INVALID" ;
VAL_ 205 OBJ_Has_Cut_Lane_30 1 "TRUE" 0 "FALSE" ;
VAL_ 205 OBJ_Has_Cut_Path_30 1 "TRUE" 0 "FALSE" ;
VAL_ 205 OBJ_Brake_Light_30 1 "TRUE" 0 "FALSE" ;
VAL_ 205 OBJ_Turn_Indicator_Right_30 1 "TRUE" 0 "FALSE" ;
VAL_ 205 OBJ_Turn_Indicator_Left_30 1 "TRUE" 0 "FALSE" ;
VAL_ 205 OBJ_Light_Indicator_Validity_30 1 "TRUE" 0 "FALSE" ;
VAL_ 205 OBJ_Right_Out_Of_Image_30 1 "TRUE" 0 "FALSE" ;
VAL_ 205 OBJ_Left_Out_Of_Image_30 1 "TRUE" 0 "FALSE" ;
VAL_ 205 OBJ_Right_Out_Of_Image_V_30 1 "TRUE" 0 "FALSE" ;
VAL_ 205 OBJ_Left_Out_Of_Image_V_30 1 "TRUE" 0 "FALSE" ;
VAL_ 205 OBJ_Top_Out_Of_Image_30 1 "TRUE" 0 "FALSE" ;
VAL_ 205 OBJ_Bottom_Out_Of_Image_30 1 "TRUE" 0 "FALSE" ;
VAL_ 205 OBJ_Top_Out_Of_Image_V_30 1 "VALID" 0 "INVALID" ;
VAL_ 205 OBJ_Bottom_Out_Of_Image_V_30 1 "VALID" 0 "INVALID" ;
VAL_ 205 OBJ_Lane_Assignment_30 5 "RIGHT_RIGHT" 4 "RIGHT" 3 "HOST" 2 "LEFT" 1 "LEFT_LEFT" 0 "UNKNOWN" ;
VAL_ 205 OBJ_Lane_Assignment_V_30 1 "VALID" 0 "INVALID" ;
VAL_ 205 OBJ_Age_Seconds_V_30 1 "VALID" 0 "INVALID" ;
VAL_ 205 OBJ_Width_V_30 1 "VALID" 0 "INVALID" ;
VAL_ 205 OBJ_Width_STD_V_30 1 "VALID" 0 "INVALID" ;
VAL_ 205 OBJ_Length_V_30 1 "VALID" 0 "INVALID" ;
VAL_ 205 OBJ_Length_STD_V_30 1 "VALID" 0 "INVALID" ;
VAL_ 205 OBJ_Height_V_30 1 "VALID" 0 "INVALID" ;
VAL_ 205 OBJ_Height_STD_V_30 1 "VALID" 0 "INVALID" ;
VAL_ 205 OBJ_Abs_Long_Velocity_V_30 1 "VALID" 0 "INVALID" ;
VAL_ 205 OBJ_Abs_Long_Vel_STD_V_30 1 "VALID" 0 "INVALID" ;
VAL_ 205 OBJ_Abs_Lat_Velocity_V_30 1 "VALID" 0 "INVALID" ;
VAL_ 205 OBJ_Abs_Lat_Vel_STD_V_30 1 "VALID" 0 "INVALID" ;
VAL_ 205 OBJ_Abs_Long_Acc_V_30 1 "VALID" 0 "INVALID" ;
VAL_ 205 OBJ_Abs_Long_Acc_STD_V_30 1 "VALID" 0 "INVALID" ;
VAL_ 205 OBJ_Abs_Lat_Acc_V_30 1 "VALID" 0 "INVALID" ;
VAL_ 205 OBJ_Abs_Lat_Acc_STD_V_30 1 "VALID" 0 "INVALID" ;
VAL_ 205 OBJ_Abs_Acceleration_V_30 1 "VALID" 0 "INVALID" ;
VAL_ 205 OBJ_Abs_Acc_STD_V_30 1 "VALID" 0 "INVALID" ;
VAL_ 205 OBJ_Inv_TTC_V_30 1 "VALID" 0 "INVALID" ;
VAL_ 205 OBJ_Inv_TTC_STD_V_30 1 "VALID" 0 "INVALID" ;
VAL_ 205 OBJ_Relative_Long_Acc_V_30 1 "VALID" 0 "INVALID" ;
VAL_ 205 OBJ_Rel_Long_Acc_STD_V_30 1 "VALID" 0 "INVALID" ;
VAL_ 204 OBJ_Relative_Long_Velocity_V_29 1 "VALID" 0 "INVALID" ;
VAL_ 204 OBJ_Rel_Long_Vel_STD_V_29 1 "VALID" 0 "INVALID" ;
VAL_ 204 OBJ_Relative_Lat_Velocity_V_29 1 "VALID" 0 "INVALID" ;
VAL_ 204 OBJ_Rel_Lat_Vel_STD_V_29 1 "VALID" 0 "INVALID" ;
VAL_ 204 OBJ_Long_Distance_V_29 1 "VALID" 0 "INVALID" ;
VAL_ 204 OBJ_Long_Distance_STD_V_29 1 "VALID" 0 "INVALID" ;
VAL_ 204 OBJ_Lat_Distance_V_29 1 "VALID" 0 "INVALID" ;
VAL_ 204 OBJ_Lat_Distance_STD_V_29 1 "VALID" 0 "INVALID" ;
VAL_ 204 OBJ_Absolute_Speed_V_29 1 "VALID" 0 "INVALID" ;
VAL_ 204 OBJ_Absolute_Speed_STD_V_29 1 "VALID" 0 "INVALID" ;
VAL_ 204 OBJ_Heading_V_29 1 "VALID" 0 "INVALID" ;
VAL_ 204 OBJ_Heading_STD_V_29 1 "VALID" 0 "INVALID" ;
VAL_ 204 OBJ_Angle_Rate_STD_V_29 1 "VALID" 0 "INVALID" ;
VAL_ 204 OBJ_Angle_Rate_V_29 1 "VALID" 0 "INVALID" ;
VAL_ 204 OBJ_Angle_Right_V_29 1 "VALID" 0 "INVALID" ;
VAL_ 204 OBJ_Angle_Right_STD_V_29 1 "VALID" 0 "INVALID" ;
VAL_ 204 OBJ_Angle_Left_V_29 1 "VALID" 0 "INVALID" ;
VAL_ 204 OBJ_Angle_Left_STD_V_29 1 "VALID" 0 "INVALID" ;
VAL_ 204 OBJ_Angle_Side_V_29 1 "VALID" 0 "INVALID" ;
VAL_ 204 OBJ_Angle_Side_STD_V_29 1 "VALID" 0 "INVALID" ;
VAL_ 204 OBJ_Angle_Mid_V_29 1 "VALID" 0 "INVALID" ;
VAL_ 204 OBJ_Angle_Mid_STD_V_29 1 "VALID" 0 "INVALID" ;
VAL_ 204 OBJ_Angle_Bottom_V_29 1 "VALID" 0 "INVALID" ;
VAL_ 204 OBJ_Angle_Bottom_STD_V_29 1 "VALID" 0 "INVALID" ;
VAL_ 204 OBJ_Visibility_Side_V_29 1 "VALID" 0 "INVALID" ;
VAL_ 204 OBJ_Visibility_Side_29 2 "REAR" 1 "FRONT" 0 "NOT_VISIBLE" ;
VAL_ 204 OBJ_Is_In_Drivable_Area_29 1 "TRUE" 0 "FALSE" ;
VAL_ 204 OBJ_Is_In_Drivable_Area_V_29 1 "VALID" 0 "INVALID" ;
VAL_ 204 OBJ_Is_VeryClose_29 1 "TRUE" 0 "FALSE" ;
VAL_ 204 OBJ_Is_VeryClose_V_29 1 "VALID" 0 "INVALID" ;
VAL_ 203 OBJ_Triggered_SDM_29 2 "NOT_TRIGGERED" 1 "TRIGGERED" 0 "NOT_AVAILABLE" ;
VAL_ 203 OBJ_Motion_Category_29 13 "ONCOMING" 12 "PRECEEDING" 11 "MOVING" 10 "RTAP" 9 "LTAP" 8 "CROSSING" 7 "MOVING_OUT" 6 "MOVING_IN" 5 "CLOSE_CUT_IN" 4 "PASSING_OUT" 3 "PASSING_IN" 2 "PASSING" 1 "UNDEFINED" 0 "INVALID" ;
VAL_ 203 OBJ_Measuring_Status_29 2 "(BIT_2)NOT_VALID_OR_VALID" 1 "(BIT_1)PREDICTED_OR_MEASURED" 0 "(BIT_0)OLD_OR_NEW" ;
VAL_ 203 OBJ_Object_Class_29 8 "UNCERTAIN_VCL" 7 "ANIMAL" 6 "GENERAL_OBJECT" 5 "PEDESTRIAN" 4 "BICYCLE" 3 "MOTOR_BIKE" 2 "TRUCK" 1 "CAR" 0 "INVALID" ;
VAL_ 203 OBJ_Camera_Source_29 11 "PARKING_RIGHT" 10 "PARKING_LEFT" 9 "PARKING_REAR" 8 "PARKING_FRONT" 7 "FRONT_CORNER_RIGHT" 6 "FRONT_CORNER_LEFT" 5 "REAR_CORNER_RIGHT" 4 "REAR_CORNER_LEFT" 3 "REAR" 2 "FRONT_FISHEYE" 1 "FRONT_NARROW" 0 "FRONT_MAIN" ;
VAL_ 203 OBJ_Motion_Status_29 5 "MOVING_SLOWLY" 4 "STOPPED" 3 "STATIONARY" 2 "MOVING" 1 "UNKNOWN" 0 "INVALID" ;
VAL_ 203 OBJ_Motion_Orientation_29 13 "UNKNOWN" 12 "PRECEEDING" 11 "DRIFTING_LEFT" 9 "CROSSING_LEFT" 7 "OC_DRIFTING_LEFT" 6 "ONCOMING" 5 "OC_DRIFTING_RIGHT" 3 "CROSSING_RIGHT" 1 "DRIFTING_RIGHT" 0 "INVALID" ;
VAL_ 203 OBJ_Has_Cut_Lane_29 1 "TRUE" 0 "FALSE" ;
VAL_ 203 OBJ_Has_Cut_Path_29 1 "TRUE" 0 "FALSE" ;
VAL_ 203 OBJ_Brake_Light_29 1 "TRUE" 0 "FALSE" ;
VAL_ 203 OBJ_Turn_Indicator_Right_29 1 "TRUE" 0 "FALSE" ;
VAL_ 203 OBJ_Turn_Indicator_Left_29 1 "TRUE" 0 "FALSE" ;
VAL_ 203 OBJ_Light_Indicator_Validity_29 1 "TRUE" 0 "FALSE" ;
VAL_ 203 OBJ_Right_Out_Of_Image_29 1 "TRUE" 0 "FALSE" ;
VAL_ 203 OBJ_Left_Out_Of_Image_29 1 "TRUE" 0 "FALSE" ;
VAL_ 203 OBJ_Right_Out_Of_Image_V_29 1 "TRUE" 0 "FALSE" ;
VAL_ 203 OBJ_Left_Out_Of_Image_V_29 1 "TRUE" 0 "FALSE" ;
VAL_ 203 OBJ_Top_Out_Of_Image_29 1 "TRUE" 0 "FALSE" ;
VAL_ 203 OBJ_Bottom_Out_Of_Image_29 1 "TRUE" 0 "FALSE" ;
VAL_ 203 OBJ_Top_Out_Of_Image_V_29 1 "VALID" 0 "INVALID" ;
VAL_ 203 OBJ_Bottom_Out_Of_Image_V_29 1 "VALID" 0 "INVALID" ;
VAL_ 203 OBJ_Lane_Assignment_29 5 "RIGHT_RIGHT" 4 "RIGHT" 3 "HOST" 2 "LEFT" 1 "LEFT_LEFT" 0 "UNKNOWN" ;
VAL_ 203 OBJ_Lane_Assignment_V_29 1 "VALID" 0 "INVALID" ;
VAL_ 203 OBJ_Age_Seconds_V_29 1 "VALID" 0 "INVALID" ;
VAL_ 203 OBJ_Width_V_29 1 "VALID" 0 "INVALID" ;
VAL_ 203 OBJ_Width_STD_V_29 1 "VALID" 0 "INVALID" ;
VAL_ 203 OBJ_Length_V_29 1 "VALID" 0 "INVALID" ;
VAL_ 203 OBJ_Length_STD_V_29 1 "VALID" 0 "INVALID" ;
VAL_ 203 OBJ_Height_V_29 1 "VALID" 0 "INVALID" ;
VAL_ 203 OBJ_Height_STD_V_29 1 "VALID" 0 "INVALID" ;
VAL_ 203 OBJ_Abs_Long_Velocity_V_29 1 "VALID" 0 "INVALID" ;
VAL_ 203 OBJ_Abs_Long_Vel_STD_V_29 1 "VALID" 0 "INVALID" ;
VAL_ 203 OBJ_Abs_Lat_Velocity_V_29 1 "VALID" 0 "INVALID" ;
VAL_ 203 OBJ_Abs_Lat_Vel_STD_V_29 1 "VALID" 0 "INVALID" ;
VAL_ 203 OBJ_Abs_Long_Acc_V_29 1 "VALID" 0 "INVALID" ;
VAL_ 203 OBJ_Abs_Long_Acc_STD_V_29 1 "VALID" 0 "INVALID" ;
VAL_ 203 OBJ_Abs_Lat_Acc_V_29 1 "VALID" 0 "INVALID" ;
VAL_ 203 OBJ_Abs_Lat_Acc_STD_V_29 1 "VALID" 0 "INVALID" ;
VAL_ 203 OBJ_Abs_Acceleration_V_29 1 "VALID" 0 "INVALID" ;
VAL_ 203 OBJ_Abs_Acc_STD_V_29 1 "VALID" 0 "INVALID" ;
VAL_ 203 OBJ_Inv_TTC_V_29 1 "VALID" 0 "INVALID" ;
VAL_ 203 OBJ_Inv_TTC_STD_V_29 1 "VALID" 0 "INVALID" ;
VAL_ 203 OBJ_Relative_Long_Acc_V_29 1 "VALID" 0 "INVALID" ;
VAL_ 203 OBJ_Rel_Long_Acc_STD_V_29 1 "VALID" 0 "INVALID" ;
VAL_ 202 OBJ_Relative_Long_Velocity_V_28 1 "VALID" 0 "INVALID" ;
VAL_ 202 OBJ_Rel_Long_Vel_STD_V_28 1 "VALID" 0 "INVALID" ;
VAL_ 202 OBJ_Relative_Lat_Velocity_V_28 1 "VALID" 0 "INVALID" ;
VAL_ 202 OBJ_Rel_Lat_Vel_STD_V_28 1 "VALID" 0 "INVALID" ;
VAL_ 202 OBJ_Long_Distance_V_28 1 "VALID" 0 "INVALID" ;
VAL_ 202 OBJ_Long_Distance_STD_V_28 1 "VALID" 0 "INVALID" ;
VAL_ 202 OBJ_Lat_Distance_V_28 1 "VALID" 0 "INVALID" ;
VAL_ 202 OBJ_Lat_Distance_STD_V_28 1 "VALID" 0 "INVALID" ;
VAL_ 202 OBJ_Absolute_Speed_V_28 1 "VALID" 0 "INVALID" ;
VAL_ 202 OBJ_Absolute_Speed_STD_V_28 1 "VALID" 0 "INVALID" ;
VAL_ 202 OBJ_Heading_V_28 1 "VALID" 0 "INVALID" ;
VAL_ 202 OBJ_Heading_STD_V_28 1 "VALID" 0 "INVALID" ;
VAL_ 202 OBJ_Angle_Rate_STD_V_28 1 "VALID" 0 "INVALID" ;
VAL_ 202 OBJ_Angle_Rate_V_28 1 "VALID" 0 "INVALID" ;
VAL_ 202 OBJ_Angle_Right_V_28 1 "VALID" 0 "INVALID" ;
VAL_ 202 OBJ_Angle_Right_STD_V_28 1 "VALID" 0 "INVALID" ;
VAL_ 202 OBJ_Angle_Left_V_28 1 "VALID" 0 "INVALID" ;
VAL_ 202 OBJ_Angle_Left_STD_V_28 1 "VALID" 0 "INVALID" ;
VAL_ 202 OBJ_Angle_Side_V_28 1 "VALID" 0 "INVALID" ;
VAL_ 202 OBJ_Angle_Side_STD_V_28 1 "VALID" 0 "INVALID" ;
VAL_ 202 OBJ_Angle_Mid_V_28 1 "VALID" 0 "INVALID" ;
VAL_ 202 OBJ_Angle_Mid_STD_V_28 1 "VALID" 0 "INVALID" ;
VAL_ 202 OBJ_Angle_Bottom_V_28 1 "VALID" 0 "INVALID" ;
VAL_ 202 OBJ_Angle_Bottom_STD_V_28 1 "VALID" 0 "INVALID" ;
VAL_ 202 OBJ_Visibility_Side_V_28 1 "VALID" 0 "INVALID" ;
VAL_ 202 OBJ_Visibility_Side_28 2 "REAR" 1 "FRONT" 0 "NOT_VISIBLE" ;
VAL_ 202 OBJ_Is_In_Drivable_Area_28 1 "TRUE" 0 "FALSE" ;
VAL_ 202 OBJ_Is_In_Drivable_Area_V_28 1 "VALID" 0 "INVALID" ;
VAL_ 202 OBJ_Is_VeryClose_28 1 "TRUE" 0 "FALSE" ;
VAL_ 202 OBJ_Is_VeryClose_V_28 1 "VALID" 0 "INVALID" ;
VAL_ 201 OBJ_Triggered_SDM_28 2 "NOT_TRIGGERED" 1 "TRIGGERED" 0 "NOT_AVAILABLE" ;
VAL_ 201 OBJ_Motion_Category_28 13 "ONCOMING" 12 "PRECEEDING" 11 "MOVING" 10 "RTAP" 9 "LTAP" 8 "CROSSING" 7 "MOVING_OUT" 6 "MOVING_IN" 5 "CLOSE_CUT_IN" 4 "PASSING_OUT" 3 "PASSING_IN" 2 "PASSING" 1 "UNDEFINED" 0 "INVALID" ;
VAL_ 201 OBJ_Measuring_Status_28 2 "(BIT_2)NOT_VALID_OR_VALID" 1 "(BIT_1)PREDICTED_OR_MEASURED" 0 "(BIT_0)OLD_OR_NEW" ;
VAL_ 201 OBJ_Object_Class_28 8 "UNCERTAIN_VCL" 7 "ANIMAL" 6 "GENERAL_OBJECT" 5 "PEDESTRIAN" 4 "BICYCLE" 3 "MOTOR_BIKE" 2 "TRUCK" 1 "CAR" 0 "INVALID" ;
VAL_ 201 OBJ_Camera_Source_28 11 "PARKING_RIGHT" 10 "PARKING_LEFT" 9 "PARKING_REAR" 8 "PARKING_FRONT" 7 "FRONT_CORNER_RIGHT" 6 "FRONT_CORNER_LEFT" 5 "REAR_CORNER_RIGHT" 4 "REAR_CORNER_LEFT" 3 "REAR" 2 "FRONT_FISHEYE" 1 "FRONT_NARROW" 0 "FRONT_MAIN" ;
VAL_ 201 OBJ_Motion_Status_28 5 "MOVING_SLOWLY" 4 "STOPPED" 3 "STATIONARY" 2 "MOVING" 1 "UNKNOWN" 0 "INVALID" ;
VAL_ 201 OBJ_Motion_Orientation_28 13 "UNKNOWN" 12 "PRECEEDING" 11 "DRIFTING_LEFT" 9 "CROSSING_LEFT" 7 "OC_DRIFTING_LEFT" 6 "ONCOMING" 5 "OC_DRIFTING_RIGHT" 3 "CROSSING_RIGHT" 1 "DRIFTING_RIGHT" 0 "INVALID" ;
VAL_ 201 OBJ_Has_Cut_Lane_28 1 "TRUE" 0 "FALSE" ;
VAL_ 201 OBJ_Has_Cut_Path_28 1 "TRUE" 0 "FALSE" ;
VAL_ 201 OBJ_Brake_Light_28 1 "TRUE" 0 "FALSE" ;
VAL_ 201 OBJ_Turn_Indicator_Right_28 1 "TRUE" 0 "FALSE" ;
VAL_ 201 OBJ_Turn_Indicator_Left_28 1 "TRUE" 0 "FALSE" ;
VAL_ 201 OBJ_Light_Indicator_Validity_28 1 "TRUE" 0 "FALSE" ;
VAL_ 201 OBJ_Right_Out_Of_Image_28 1 "TRUE" 0 "FALSE" ;
VAL_ 201 OBJ_Left_Out_Of_Image_28 1 "TRUE" 0 "FALSE" ;
VAL_ 201 OBJ_Right_Out_Of_Image_V_28 1 "TRUE" 0 "FALSE" ;
VAL_ 201 OBJ_Left_Out_Of_Image_V_28 1 "TRUE" 0 "FALSE" ;
VAL_ 201 OBJ_Top_Out_Of_Image_28 1 "TRUE" 0 "FALSE" ;
VAL_ 201 OBJ_Bottom_Out_Of_Image_28 1 "TRUE" 0 "FALSE" ;
VAL_ 201 OBJ_Top_Out_Of_Image_V_28 1 "VALID" 0 "INVALID" ;
VAL_ 201 OBJ_Bottom_Out_Of_Image_V_28 1 "VALID" 0 "INVALID" ;
VAL_ 201 OBJ_Lane_Assignment_28 5 "RIGHT_RIGHT" 4 "RIGHT" 3 "HOST" 2 "LEFT" 1 "LEFT_LEFT" 0 "UNKNOWN" ;
VAL_ 201 OBJ_Lane_Assignment_V_28 1 "VALID" 0 "INVALID" ;
VAL_ 201 OBJ_Age_Seconds_V_28 1 "VALID" 0 "INVALID" ;
VAL_ 201 OBJ_Width_V_28 1 "VALID" 0 "INVALID" ;
VAL_ 201 OBJ_Width_STD_V_28 1 "VALID" 0 "INVALID" ;
VAL_ 201 OBJ_Length_V_28 1 "VALID" 0 "INVALID" ;
VAL_ 201 OBJ_Length_STD_V_28 1 "VALID" 0 "INVALID" ;
VAL_ 201 OBJ_Height_V_28 1 "VALID" 0 "INVALID" ;
VAL_ 201 OBJ_Height_STD_V_28 1 "VALID" 0 "INVALID" ;
VAL_ 201 OBJ_Abs_Long_Velocity_V_28 1 "VALID" 0 "INVALID" ;
VAL_ 201 OBJ_Abs_Long_Vel_STD_V_28 1 "VALID" 0 "INVALID" ;
VAL_ 201 OBJ_Abs_Lat_Velocity_V_28 1 "VALID" 0 "INVALID" ;
VAL_ 201 OBJ_Abs_Lat_Vel_STD_V_28 1 "VALID" 0 "INVALID" ;
VAL_ 201 OBJ_Abs_Long_Acc_V_28 1 "VALID" 0 "INVALID" ;
VAL_ 201 OBJ_Abs_Long_Acc_STD_V_28 1 "VALID" 0 "INVALID" ;
VAL_ 201 OBJ_Abs_Lat_Acc_V_28 1 "VALID" 0 "INVALID" ;
VAL_ 201 OBJ_Abs_Lat_Acc_STD_V_28 1 "VALID" 0 "INVALID" ;
VAL_ 201 OBJ_Abs_Acceleration_V_28 1 "VALID" 0 "INVALID" ;
VAL_ 201 OBJ_Abs_Acc_STD_V_28 1 "VALID" 0 "INVALID" ;
VAL_ 201 OBJ_Inv_TTC_V_28 1 "VALID" 0 "INVALID" ;
VAL_ 201 OBJ_Inv_TTC_STD_V_28 1 "VALID" 0 "INVALID" ;
VAL_ 201 OBJ_Relative_Long_Acc_V_28 1 "VALID" 0 "INVALID" ;
VAL_ 201 OBJ_Rel_Long_Acc_STD_V_28 1 "VALID" 0 "INVALID" ;
VAL_ 200 OBJ_Relative_Long_Velocity_V_27 1 "VALID" 0 "INVALID" ;
VAL_ 200 OBJ_Rel_Long_Vel_STD_V_27 1 "VALID" 0 "INVALID" ;
VAL_ 200 OBJ_Relative_Lat_Velocity_V_27 1 "VALID" 0 "INVALID" ;
VAL_ 200 OBJ_Rel_Lat_Vel_STD_V_27 1 "VALID" 0 "INVALID" ;
VAL_ 200 OBJ_Long_Distance_V_27 1 "VALID" 0 "INVALID" ;
VAL_ 200 OBJ_Long_Distance_STD_V_27 1 "VALID" 0 "INVALID" ;
VAL_ 200 OBJ_Lat_Distance_V_27 1 "VALID" 0 "INVALID" ;
VAL_ 200 OBJ_Lat_Distance_STD_V_27 1 "VALID" 0 "INVALID" ;
VAL_ 200 OBJ_Absolute_Speed_V_27 1 "VALID" 0 "INVALID" ;
VAL_ 200 OBJ_Absolute_Speed_STD_V_27 1 "VALID" 0 "INVALID" ;
VAL_ 200 OBJ_Heading_V_27 1 "VALID" 0 "INVALID" ;
VAL_ 200 OBJ_Heading_STD_V_27 1 "VALID" 0 "INVALID" ;
VAL_ 200 OBJ_Angle_Rate_STD_V_27 1 "VALID" 0 "INVALID" ;
VAL_ 200 OBJ_Angle_Rate_V_27 1 "VALID" 0 "INVALID" ;
VAL_ 200 OBJ_Angle_Right_V_27 1 "VALID" 0 "INVALID" ;
VAL_ 200 OBJ_Angle_Right_STD_V_27 1 "VALID" 0 "INVALID" ;
VAL_ 200 OBJ_Angle_Left_V_27 1 "VALID" 0 "INVALID" ;
VAL_ 200 OBJ_Angle_Left_STD_V_27 1 "VALID" 0 "INVALID" ;
VAL_ 200 OBJ_Angle_Side_V_27 1 "VALID" 0 "INVALID" ;
VAL_ 200 OBJ_Angle_Side_STD_V_27 1 "VALID" 0 "INVALID" ;
VAL_ 200 OBJ_Angle_Mid_V_27 1 "VALID" 0 "INVALID" ;
VAL_ 200 OBJ_Angle_Mid_STD_V_27 1 "VALID" 0 "INVALID" ;
VAL_ 200 OBJ_Angle_Bottom_V_27 1 "VALID" 0 "INVALID" ;
VAL_ 200 OBJ_Angle_Bottom_STD_V_27 1 "VALID" 0 "INVALID" ;
VAL_ 200 OBJ_Visibility_Side_V_27 1 "VALID" 0 "INVALID" ;
VAL_ 200 OBJ_Visibility_Side_27 2 "REAR" 1 "FRONT" 0 "NOT_VISIBLE" ;
VAL_ 200 OBJ_Is_In_Drivable_Area_27 1 "TRUE" 0 "FALSE" ;
VAL_ 200 OBJ_Is_In_Drivable_Area_V_27 1 "VALID" 0 "INVALID" ;
VAL_ 200 OBJ_Is_VeryClose_27 1 "TRUE" 0 "FALSE" ;
VAL_ 200 OBJ_Is_VeryClose_V_27 1 "VALID" 0 "INVALID" ;
VAL_ 199 OBJ_Triggered_SDM_27 2 "NOT_TRIGGERED" 1 "TRIGGERED" 0 "NOT_AVAILABLE" ;
VAL_ 199 OBJ_Motion_Category_27 13 "ONCOMING" 12 "PRECEEDING" 11 "MOVING" 10 "RTAP" 9 "LTAP" 8 "CROSSING" 7 "MOVING_OUT" 6 "MOVING_IN" 5 "CLOSE_CUT_IN" 4 "PASSING_OUT" 3 "PASSING_IN" 2 "PASSING" 1 "UNDEFINED" 0 "INVALID" ;
VAL_ 199 OBJ_Measuring_Status_27 2 "(BIT_2)NOT_VALID_OR_VALID" 1 "(BIT_1)PREDICTED_OR_MEASURED" 0 "(BIT_0)OLD_OR_NEW" ;
VAL_ 199 OBJ_Object_Class_27 8 "UNCERTAIN_VCL" 7 "ANIMAL" 6 "GENERAL_OBJECT" 5 "PEDESTRIAN" 4 "BICYCLE" 3 "MOTOR_BIKE" 2 "TRUCK" 1 "CAR" 0 "INVALID" ;
VAL_ 199 OBJ_Camera_Source_27 11 "PARKING_RIGHT" 10 "PARKING_LEFT" 9 "PARKING_REAR" 8 "PARKING_FRONT" 7 "FRONT_CORNER_RIGHT" 6 "FRONT_CORNER_LEFT" 5 "REAR_CORNER_RIGHT" 4 "REAR_CORNER_LEFT" 3 "REAR" 2 "FRONT_FISHEYE" 1 "FRONT_NARROW" 0 "FRONT_MAIN" ;
VAL_ 199 OBJ_Motion_Status_27 5 "MOVING_SLOWLY" 4 "STOPPED" 3 "STATIONARY" 2 "MOVING" 1 "UNKNOWN" 0 "INVALID" ;
VAL_ 199 OBJ_Motion_Orientation_27 13 "UNKNOWN" 12 "PRECEEDING" 11 "DRIFTING_LEFT" 9 "CROSSING_LEFT" 7 "OC_DRIFTING_LEFT" 6 "ONCOMING" 5 "OC_DRIFTING_RIGHT" 3 "CROSSING_RIGHT" 1 "DRIFTING_RIGHT" 0 "INVALID" ;
VAL_ 199 OBJ_Has_Cut_Lane_27 1 "TRUE" 0 "FALSE" ;
VAL_ 199 OBJ_Has_Cut_Path_27 1 "TRUE" 0 "FALSE" ;
VAL_ 199 OBJ_Brake_Light_27 1 "TRUE" 0 "FALSE" ;
VAL_ 199 OBJ_Turn_Indicator_Right_27 1 "TRUE" 0 "FALSE" ;
VAL_ 199 OBJ_Turn_Indicator_Left_27 1 "TRUE" 0 "FALSE" ;
VAL_ 199 OBJ_Light_Indicator_Validity_27 1 "TRUE" 0 "FALSE" ;
VAL_ 199 OBJ_Right_Out_Of_Image_27 1 "TRUE" 0 "FALSE" ;
VAL_ 199 OBJ_Left_Out_Of_Image_27 1 "TRUE" 0 "FALSE" ;
VAL_ 199 OBJ_Right_Out_Of_Image_V_27 1 "TRUE" 0 "FALSE" ;
VAL_ 199 OBJ_Left_Out_Of_Image_V_27 1 "TRUE" 0 "FALSE" ;
VAL_ 199 OBJ_Top_Out_Of_Image_27 1 "TRUE" 0 "FALSE" ;
VAL_ 199 OBJ_Bottom_Out_Of_Image_27 1 "TRUE" 0 "FALSE" ;
VAL_ 199 OBJ_Top_Out_Of_Image_V_27 1 "VALID" 0 "INVALID" ;
VAL_ 199 OBJ_Bottom_Out_Of_Image_V_27 1 "VALID" 0 "INVALID" ;
VAL_ 199 OBJ_Lane_Assignment_27 5 "RIGHT_RIGHT" 4 "RIGHT" 3 "HOST" 2 "LEFT" 1 "LEFT_LEFT" 0 "UNKNOWN" ;
VAL_ 199 OBJ_Lane_Assignment_V_27 1 "VALID" 0 "INVALID" ;
VAL_ 199 OBJ_Age_Seconds_V_27 1 "VALID" 0 "INVALID" ;
VAL_ 199 OBJ_Width_V_27 1 "VALID" 0 "INVALID" ;
VAL_ 199 OBJ_Width_STD_V_27 1 "VALID" 0 "INVALID" ;
VAL_ 199 OBJ_Length_V_27 1 "VALID" 0 "INVALID" ;
VAL_ 199 OBJ_Length_STD_V_27 1 "VALID" 0 "INVALID" ;
VAL_ 199 OBJ_Height_V_27 1 "VALID" 0 "INVALID" ;
VAL_ 199 OBJ_Height_STD_V_27 1 "VALID" 0 "INVALID" ;
VAL_ 199 OBJ_Abs_Long_Velocity_V_27 1 "VALID" 0 "INVALID" ;
VAL_ 199 OBJ_Abs_Long_Vel_STD_V_27 1 "VALID" 0 "INVALID" ;
VAL_ 199 OBJ_Abs_Lat_Velocity_V_27 1 "VALID" 0 "INVALID" ;
VAL_ 199 OBJ_Abs_Lat_Vel_STD_V_27 1 "VALID" 0 "INVALID" ;
VAL_ 199 OBJ_Abs_Long_Acc_V_27 1 "VALID" 0 "INVALID" ;
VAL_ 199 OBJ_Abs_Long_Acc_STD_V_27 1 "VALID" 0 "INVALID" ;
VAL_ 199 OBJ_Abs_Lat_Acc_V_27 1 "VALID" 0 "INVALID" ;
VAL_ 199 OBJ_Abs_Lat_Acc_STD_V_27 1 "VALID" 0 "INVALID" ;
VAL_ 199 OBJ_Abs_Acceleration_V_27 1 "VALID" 0 "INVALID" ;
VAL_ 199 OBJ_Abs_Acc_STD_V_27 1 "VALID" 0 "INVALID" ;
VAL_ 199 OBJ_Inv_TTC_V_27 1 "VALID" 0 "INVALID" ;
VAL_ 199 OBJ_Inv_TTC_STD_V_27 1 "VALID" 0 "INVALID" ;
VAL_ 199 OBJ_Relative_Long_Acc_V_27 1 "VALID" 0 "INVALID" ;
VAL_ 199 OBJ_Rel_Long_Acc_STD_V_27 1 "VALID" 0 "INVALID" ;
VAL_ 198 OBJ_Relative_Long_Velocity_V_26 1 "VALID" 0 "INVALID" ;
VAL_ 198 OBJ_Rel_Long_Vel_STD_V_26 1 "VALID" 0 "INVALID" ;
VAL_ 198 OBJ_Relative_Lat_Velocity_V_26 1 "VALID" 0 "INVALID" ;
VAL_ 198 OBJ_Rel_Lat_Vel_STD_V_26 1 "VALID" 0 "INVALID" ;
VAL_ 198 OBJ_Long_Distance_V_26 1 "VALID" 0 "INVALID" ;
VAL_ 198 OBJ_Long_Distance_STD_V_26 1 "VALID" 0 "INVALID" ;
VAL_ 198 OBJ_Lat_Distance_V_26 1 "VALID" 0 "INVALID" ;
VAL_ 198 OBJ_Lat_Distance_STD_V_26 1 "VALID" 0 "INVALID" ;
VAL_ 198 OBJ_Absolute_Speed_V_26 1 "VALID" 0 "INVALID" ;
VAL_ 198 OBJ_Absolute_Speed_STD_V_26 1 "VALID" 0 "INVALID" ;
VAL_ 198 OBJ_Heading_V_26 1 "VALID" 0 "INVALID" ;
VAL_ 198 OBJ_Heading_STD_V_26 1 "VALID" 0 "INVALID" ;
VAL_ 198 OBJ_Angle_Rate_STD_V_26 1 "VALID" 0 "INVALID" ;
VAL_ 198 OBJ_Angle_Rate_V_26 1 "VALID" 0 "INVALID" ;
VAL_ 198 OBJ_Angle_Right_V_26 1 "VALID" 0 "INVALID" ;
VAL_ 198 OBJ_Angle_Right_STD_V_26 1 "VALID" 0 "INVALID" ;
VAL_ 198 OBJ_Angle_Left_V_26 1 "VALID" 0 "INVALID" ;
VAL_ 198 OBJ_Angle_Left_STD_V_26 1 "VALID" 0 "INVALID" ;
VAL_ 198 OBJ_Angle_Side_V_26 1 "VALID" 0 "INVALID" ;
VAL_ 198 OBJ_Angle_Side_STD_V_26 1 "VALID" 0 "INVALID" ;
VAL_ 198 OBJ_Angle_Mid_V_26 1 "VALID" 0 "INVALID" ;
VAL_ 198 OBJ_Angle_Mid_STD_V_26 1 "VALID" 0 "INVALID" ;
VAL_ 198 OBJ_Angle_Bottom_V_26 1 "VALID" 0 "INVALID" ;
VAL_ 198 OBJ_Angle_Bottom_STD_V_26 1 "VALID" 0 "INVALID" ;
VAL_ 198 OBJ_Visibility_Side_V_26 1 "VALID" 0 "INVALID" ;
VAL_ 198 OBJ_Visibility_Side_26 2 "REAR" 1 "FRONT" 0 "NOT_VISIBLE" ;
VAL_ 198 OBJ_Is_In_Drivable_Area_26 1 "TRUE" 0 "FALSE" ;
VAL_ 198 OBJ_Is_In_Drivable_Area_V_26 1 "VALID" 0 "INVALID" ;
VAL_ 198 OBJ_Is_VeryClose_26 1 "TRUE" 0 "FALSE" ;
VAL_ 198 OBJ_Is_VeryClose_V_26 1 "VALID" 0 "INVALID" ;
VAL_ 197 OBJ_Triggered_SDM_26 2 "NOT_TRIGGERED" 1 "TRIGGERED" 0 "NOT_AVAILABLE" ;
VAL_ 197 OBJ_Motion_Category_26 13 "ONCOMING" 12 "PRECEEDING" 11 "MOVING" 10 "RTAP" 9 "LTAP" 8 "CROSSING" 7 "MOVING_OUT" 6 "MOVING_IN" 5 "CLOSE_CUT_IN" 4 "PASSING_OUT" 3 "PASSING_IN" 2 "PASSING" 1 "UNDEFINED" 0 "INVALID" ;
VAL_ 197 OBJ_Measuring_Status_26 2 "(BIT_2)NOT_VALID_OR_VALID" 1 "(BIT_1)PREDICTED_OR_MEASURED" 0 "(BIT_0)OLD_OR_NEW" ;
VAL_ 197 OBJ_Object_Class_26 8 "UNCERTAIN_VCL" 7 "ANIMAL" 6 "GENERAL_OBJECT" 5 "PEDESTRIAN" 4 "BICYCLE" 3 "MOTOR_BIKE" 2 "TRUCK" 1 "CAR" 0 "INVALID" ;
VAL_ 197 OBJ_Camera_Source_26 11 "PARKING_RIGHT" 10 "PARKING_LEFT" 9 "PARKING_REAR" 8 "PARKING_FRONT" 7 "FRONT_CORNER_RIGHT" 6 "FRONT_CORNER_LEFT" 5 "REAR_CORNER_RIGHT" 4 "REAR_CORNER_LEFT" 3 "REAR" 2 "FRONT_FISHEYE" 1 "FRONT_NARROW" 0 "FRONT_MAIN" ;
VAL_ 197 OBJ_Motion_Status_26 5 "MOVING_SLOWLY" 4 "STOPPED" 3 "STATIONARY" 2 "MOVING" 1 "UNKNOWN" 0 "INVALID" ;
VAL_ 197 OBJ_Motion_Orientation_26 13 "UNKNOWN" 12 "PRECEEDING" 11 "DRIFTING_LEFT" 9 "CROSSING_LEFT" 7 "OC_DRIFTING_LEFT" 6 "ONCOMING" 5 "OC_DRIFTING_RIGHT" 3 "CROSSING_RIGHT" 1 "DRIFTING_RIGHT" 0 "INVALID" ;
VAL_ 197 OBJ_Has_Cut_Lane_26 1 "TRUE" 0 "FALSE" ;
VAL_ 197 OBJ_Has_Cut_Path_26 1 "TRUE" 0 "FALSE" ;
VAL_ 197 OBJ_Brake_Light_26 1 "TRUE" 0 "FALSE" ;
VAL_ 197 OBJ_Turn_Indicator_Right_26 1 "TRUE" 0 "FALSE" ;
VAL_ 197 OBJ_Turn_Indicator_Left_26 1 "TRUE" 0 "FALSE" ;
VAL_ 197 OBJ_Light_Indicator_Validity_26 1 "TRUE" 0 "FALSE" ;
VAL_ 197 OBJ_Right_Out_Of_Image_26 1 "TRUE" 0 "FALSE" ;
VAL_ 197 OBJ_Left_Out_Of_Image_26 1 "TRUE" 0 "FALSE" ;
VAL_ 197 OBJ_Right_Out_Of_Image_V_26 1 "TRUE" 0 "FALSE" ;
VAL_ 197 OBJ_Left_Out_Of_Image_V_26 1 "TRUE" 0 "FALSE" ;
VAL_ 197 OBJ_Top_Out_Of_Image_26 1 "TRUE" 0 "FALSE" ;
VAL_ 197 OBJ_Bottom_Out_Of_Image_26 1 "TRUE" 0 "FALSE" ;
VAL_ 197 OBJ_Top_Out_Of_Image_V_26 1 "VALID" 0 "INVALID" ;
VAL_ 197 OBJ_Bottom_Out_Of_Image_V_26 1 "VALID" 0 "INVALID" ;
VAL_ 197 OBJ_Lane_Assignment_26 5 "RIGHT_RIGHT" 4 "RIGHT" 3 "HOST" 2 "LEFT" 1 "LEFT_LEFT" 0 "UNKNOWN" ;
VAL_ 197 OBJ_Lane_Assignment_V_26 1 "VALID" 0 "INVALID" ;
VAL_ 197 OBJ_Age_Seconds_V_26 1 "VALID" 0 "INVALID" ;
VAL_ 197 OBJ_Width_V_26 1 "VALID" 0 "INVALID" ;
VAL_ 197 OBJ_Width_STD_V_26 1 "VALID" 0 "INVALID" ;
VAL_ 197 OBJ_Length_V_26 1 "VALID" 0 "INVALID" ;
VAL_ 197 OBJ_Length_STD_V_26 1 "VALID" 0 "INVALID" ;
VAL_ 197 OBJ_Height_V_26 1 "VALID" 0 "INVALID" ;
VAL_ 197 OBJ_Height_STD_V_26 1 "VALID" 0 "INVALID" ;
VAL_ 197 OBJ_Abs_Long_Velocity_V_26 1 "VALID" 0 "INVALID" ;
VAL_ 197 OBJ_Abs_Long_Vel_STD_V_26 1 "VALID" 0 "INVALID" ;
VAL_ 197 OBJ_Abs_Lat_Velocity_V_26 1 "VALID" 0 "INVALID" ;
VAL_ 197 OBJ_Abs_Lat_Vel_STD_V_26 1 "VALID" 0 "INVALID" ;
VAL_ 197 OBJ_Abs_Long_Acc_V_26 1 "VALID" 0 "INVALID" ;
VAL_ 197 OBJ_Abs_Long_Acc_STD_V_26 1 "VALID" 0 "INVALID" ;
VAL_ 197 OBJ_Abs_Lat_Acc_V_26 1 "VALID" 0 "INVALID" ;
VAL_ 197 OBJ_Abs_Lat_Acc_STD_V_26 1 "VALID" 0 "INVALID" ;
VAL_ 197 OBJ_Abs_Acceleration_V_26 1 "VALID" 0 "INVALID" ;
VAL_ 197 OBJ_Abs_Acc_STD_V_26 1 "VALID" 0 "INVALID" ;
VAL_ 197 OBJ_Inv_TTC_V_26 1 "VALID" 0 "INVALID" ;
VAL_ 197 OBJ_Inv_TTC_STD_V_26 1 "VALID" 0 "INVALID" ;
VAL_ 197 OBJ_Relative_Long_Acc_V_26 1 "VALID" 0 "INVALID" ;
VAL_ 197 OBJ_Rel_Long_Acc_STD_V_26 1 "VALID" 0 "INVALID" ;
SIG_GROUP_ 216 ICM_Object_Prot35_B 1 : OBJ_Buffer_35 OBJ_Is_VeryClose_V_35 OBJ_Is_VeryClose_35 OBJ_Is_In_Drivable_Area_V_35 OBJ_Is_In_Drivable_Area_35 OBJ_Visibility_Side_35 OBJ_Visibility_Side_V_35 OBJ_Angle_Bottom_STD_V_35 OBJ_Angle_Bottom_STD_35 OBJ_Angle_Bottom_35 OBJ_Angle_Bottom_V_35 OBJ_Angle_Mid_STD_V_35 OBJ_Angle_Mid_STD_35 OBJ_Angle_Mid_35 OBJ_Angle_Mid_V_35 OBJ_Angle_Side_STD_V_35 OBJ_Angle_Side_STD_35 OBJ_Angle_Side_V_35 OBJ_Angle_Side_35 OBJ_Angle_Left_STD_V_35 OBJ_Angle_Left_STD_35 OBJ_Angle_Left_V_35 OBJ_Angle_Left_35 OBJ_Angle_Right_STD_V_35 OBJ_Angle_Right_STD_35 OBJ_Angle_Right_V_35 OBJ_Angle_Right_35 OBJ_Angle_Rate_V_35 OBJ_Angle_Rate_35 OBJ_Angle_Rate_STD_V_35 OBJ_Angle_Rate_STD_35 OBJ_Heading_STD_V_35 OBJ_Heading_STD_35 OBJ_Heading_V_35 OBJ_Heading_35 OBJ_Absolute_Speed_STD_V_35 OBJ_Absolute_Speed_STD_35 OBJ_Absolute_Speed_V_35 OBJ_Absolute_Speed_35 OBJ_Lat_Distance_STD_V_35 OBJ_Lat_Distance_STD_35 OBJ_Lat_Distance_V_35 OBJ_Lat_Distance_35 OBJ_Long_Distance_STD_V_35 OBJ_Long_Distance_STD_35 OBJ_Long_Distance_V_35 OBJ_Long_Distance_35 OBJ_Rel_Lat_Vel_STD_V_35 OBJ_Relative_Lat_Velocity_STD_35 OBJ_Relative_Lat_Velocity_V_35 OBJ_Relative_Lat_Velocity_35 OBJ_Rel_Long_Vel_STD_V_35 OBJ_Relative_Long_Vel_STD_35 OBJ_Relative_Long_Velocity_V_35 OBJ_Relative_Long_Velocity_35 ICM_Object_Prot35_B_Header;
SIG_GROUP_ 215 ICM_Object_Prot35_A 1 : OBJ_Rel_Long_Acc_STD_V_35 OBJ_Relative_Long_Acc_STD_35 OBJ_Relative_Long_Acc_V_35 OBJ_Relative_Long_Acc_35 OBJ_Inv_TTC_STD_V_35 OBJ_Inv_TTC_STD_35 OBJ_Inv_TTC_V_35 OBJ_Inv_TTC_35 OBJ_Abs_Acc_STD_V_35 OBJ_Abs_Acc_STD_35 OBJ_Abs_Acceleration_V_35 OBJ_Abs_Acceleration_35 OBJ_Abs_Lat_Acc_STD_V_35 OBJ_Abs_Lat_Acc_STD_35 OBJ_Abs_Lat_Acc_V_35 OBJ_Abs_Lat_Acc_35 OBJ_Abs_Long_Acc_STD_V_35 OBJ_Abs_Long_Acc_STD_35 OBJ_Abs_Long_Acc_V_35 OBJ_Abs_Long_Acc_35 OBJ_Abs_Lat_Vel_STD_V_35 OBJ_Abs_Lat_Velocity_STD_35 OBJ_Abs_Lat_Velocity_V_35 OBJ_Abs_Lat_Velocity_35 OBJ_Abs_Long_Vel_STD_V_35 OBJ_Abs_Long_Velocity_STD_35 OBJ_Abs_Long_Velocity_V_35 OBJ_Abs_Long_Velocity_35 OBJ_Height_STD_V_35 OBJ_Height_STD_35 OBJ_Height_V_35 OBJ_Height_35 OBJ_Length_STD_V_35 OBJ_Length_STD_35 OBJ_Length_V_35 OBJ_Length_35 OBJ_Width_STD_V_35 OBJ_Width_STD_35 OBJ_Width_V_35 OBJ_Width_35 OBJ_Age_Seconds_V_35 OBJ_Age_Seconds_35 OBJ_Lane_Assignment_V_35 OBJ_Lane_Assignment_35 OBJ_Bottom_Out_Of_Image_V_35 OBJ_Top_Out_Of_Image_V_35 OBJ_Bottom_Out_Of_Image_35 OBJ_Top_Out_Of_Image_35 OBJ_Left_Out_Of_Image_V_35 OBJ_Right_Out_Of_Image_V_35 OBJ_Left_Out_Of_Image_35 OBJ_Right_Out_Of_Image_35 OBJ_Light_Indicator_Validity_35 OBJ_Turn_Indicator_Left_35 OBJ_Turn_Indicator_Right_35 OBJ_Brake_Light_35 OBJ_Has_Cut_Path_35 OBJ_Has_Cut_Lane_35 OBJ_Motion_Orientation_35 OBJ_Motion_Status_35 OBJ_Camera_Source_35 OBJ_Bike_Probability_35 OBJ_Truck_Probability_35 OBJ_Car_Probability_35 OBJ_Class_Probability_35 OBJ_Object_Class_35 OBJ_Measuring_Status_35 OBJ_Object_Age_35 OBJ_Moving_IN_Probability_35 OBJ_Motion_Category_35 OBJ_Triggered_SDM_35 OBJ_Fusion_Source_35 OBJ_Existence_Probability_35 OBJ_ID_35 OBJ_CRC_35 ICM_Object_Prot35_A_Header;
SIG_GROUP_ 214 ICM_Object_Prot34_B 1 : OBJ_Buffer_34 OBJ_Is_VeryClose_V_34 OBJ_Is_VeryClose_34 OBJ_Is_In_Drivable_Area_V_34 OBJ_Is_In_Drivable_Area_34 OBJ_Visibility_Side_34 OBJ_Visibility_Side_V_34 OBJ_Angle_Bottom_STD_V_34 OBJ_Angle_Bottom_STD_34 OBJ_Angle_Bottom_34 OBJ_Angle_Bottom_V_34 OBJ_Angle_Mid_STD_V_34 OBJ_Angle_Mid_STD_34 OBJ_Angle_Mid_34 OBJ_Angle_Mid_V_34 OBJ_Angle_Side_STD_V_34 OBJ_Angle_Side_STD_34 OBJ_Angle_Side_V_34 OBJ_Angle_Side_34 OBJ_Angle_Left_STD_V_34 OBJ_Angle_Left_STD_34 OBJ_Angle_Left_V_34 OBJ_Angle_Left_34 OBJ_Angle_Right_STD_V_34 OBJ_Angle_Right_STD_34 OBJ_Angle_Right_V_34 OBJ_Angle_Right_34 OBJ_Angle_Rate_V_34 OBJ_Angle_Rate_34 OBJ_Angle_Rate_STD_V_34 OBJ_Angle_Rate_STD_34 OBJ_Heading_STD_V_34 OBJ_Heading_STD_34 OBJ_Heading_V_34 OBJ_Heading_34 OBJ_Absolute_Speed_STD_V_34 OBJ_Absolute_Speed_STD_34 OBJ_Absolute_Speed_V_34 OBJ_Absolute_Speed_34 OBJ_Lat_Distance_STD_V_34 OBJ_Lat_Distance_STD_34 OBJ_Lat_Distance_V_34 OBJ_Lat_Distance_34 OBJ_Long_Distance_STD_V_34 OBJ_Long_Distance_STD_34 OBJ_Long_Distance_V_34 OBJ_Long_Distance_34 OBJ_Rel_Lat_Vel_STD_V_34 OBJ_Relative_Lat_Velocity_STD_34 OBJ_Relative_Lat_Velocity_V_34 OBJ_Relative_Lat_Velocity_34 OBJ_Rel_Long_Vel_STD_V_34 OBJ_Relative_Long_Vel_STD_34 OBJ_Relative_Long_Velocity_V_34 OBJ_Relative_Long_Velocity_34 ICM_Object_Prot34_B_Header;
SIG_GROUP_ 213 ICM_Object_Prot34_A 1 : OBJ_Rel_Long_Acc_STD_V_34 OBJ_Relative_Long_Acc_STD_34 OBJ_Relative_Long_Acc_V_34 OBJ_Relative_Long_Acc_34 OBJ_Inv_TTC_STD_V_34 OBJ_Inv_TTC_STD_34 OBJ_Inv_TTC_V_34 OBJ_Inv_TTC_34 OBJ_Abs_Acc_STD_V_34 OBJ_Abs_Acc_STD_34 OBJ_Abs_Acceleration_V_34 OBJ_Abs_Acceleration_34 OBJ_Abs_Lat_Acc_STD_V_34 OBJ_Abs_Lat_Acc_STD_34 OBJ_Abs_Lat_Acc_V_34 OBJ_Abs_Lat_Acc_34 OBJ_Abs_Long_Acc_STD_V_34 OBJ_Abs_Long_Acc_STD_34 OBJ_Abs_Long_Acc_V_34 OBJ_Abs_Long_Acc_34 OBJ_Abs_Lat_Vel_STD_V_34 OBJ_Abs_Lat_Velocity_STD_34 OBJ_Abs_Lat_Velocity_V_34 OBJ_Abs_Lat_Velocity_34 OBJ_Abs_Long_Vel_STD_V_34 OBJ_Abs_Long_Velocity_STD_34 OBJ_Abs_Long_Velocity_V_34 OBJ_Abs_Long_Velocity_34 OBJ_Height_STD_V_34 OBJ_Height_STD_34 OBJ_Height_V_34 OBJ_Height_34 OBJ_Length_STD_V_34 OBJ_Length_STD_34 OBJ_Length_V_34 OBJ_Length_34 OBJ_Width_STD_V_34 OBJ_Width_STD_34 OBJ_Width_V_34 OBJ_Width_34 OBJ_Age_Seconds_V_34 OBJ_Age_Seconds_34 OBJ_Lane_Assignment_V_34 OBJ_Lane_Assignment_34 OBJ_Bottom_Out_Of_Image_V_34 OBJ_Top_Out_Of_Image_V_34 OBJ_Bottom_Out_Of_Image_34 OBJ_Top_Out_Of_Image_34 OBJ_Left_Out_Of_Image_V_34 OBJ_Right_Out_Of_Image_V_34 OBJ_Left_Out_Of_Image_34 OBJ_Right_Out_Of_Image_34 OBJ_Light_Indicator_Validity_34 OBJ_Turn_Indicator_Left_34 OBJ_Turn_Indicator_Right_34 OBJ_Brake_Light_34 OBJ_Has_Cut_Path_34 OBJ_Has_Cut_Lane_34 OBJ_Motion_Orientation_34 OBJ_Motion_Status_34 OBJ_Camera_Source_34 OBJ_Bike_Probability_34 OBJ_Truck_Probability_34 OBJ_Car_Probability_34 OBJ_Class_Probability_34 OBJ_Object_Class_34 OBJ_Measuring_Status_34 OBJ_Object_Age_34 OBJ_Moving_IN_Probability_34 OBJ_Motion_Category_34 OBJ_Triggered_SDM_34 OBJ_Fusion_Source_34 OBJ_Existence_Probability_34 OBJ_ID_34 OBJ_CRC_34 ICM_Object_Prot34_A_Header;
SIG_GROUP_ 212 ICM_Object_Prot33_B 1 : OBJ_Buffer_33 OBJ_Is_VeryClose_V_33 OBJ_Is_VeryClose_33 OBJ_Is_In_Drivable_Area_V_33 OBJ_Is_In_Drivable_Area_33 OBJ_Visibility_Side_33 OBJ_Visibility_Side_V_33 OBJ_Angle_Bottom_STD_V_33 OBJ_Angle_Bottom_STD_33 OBJ_Angle_Bottom_33 OBJ_Angle_Bottom_V_33 OBJ_Angle_Mid_STD_V_33 OBJ_Angle_Mid_STD_33 OBJ_Angle_Mid_33 OBJ_Angle_Mid_V_33 OBJ_Angle_Side_STD_V_33 OBJ_Angle_Side_STD_33 OBJ_Angle_Side_V_33 OBJ_Angle_Side_33 OBJ_Angle_Left_STD_V_33 OBJ_Angle_Left_STD_33 OBJ_Angle_Left_V_33 OBJ_Angle_Left_33 OBJ_Angle_Right_STD_V_33 OBJ_Angle_Right_STD_33 OBJ_Angle_Right_V_33 OBJ_Angle_Right_33 OBJ_Angle_Rate_V_33 OBJ_Angle_Rate_33 OBJ_Angle_Rate_STD_V_33 OBJ_Angle_Rate_STD_33 OBJ_Heading_STD_V_33 OBJ_Heading_STD_33 OBJ_Heading_V_33 OBJ_Heading_33 OBJ_Absolute_Speed_STD_V_33 OBJ_Absolute_Speed_STD_33 OBJ_Absolute_Speed_V_33 OBJ_Absolute_Speed_33 OBJ_Lat_Distance_STD_V_33 OBJ_Lat_Distance_STD_33 OBJ_Lat_Distance_V_33 OBJ_Lat_Distance_33 OBJ_Long_Distance_STD_V_33 OBJ_Long_Distance_STD_33 OBJ_Long_Distance_V_33 OBJ_Long_Distance_33 OBJ_Rel_Lat_Vel_STD_V_33 OBJ_Relative_Lat_Velocity_STD_33 OBJ_Relative_Lat_Velocity_V_33 OBJ_Relative_Lat_Velocity_33 OBJ_Rel_Long_Vel_STD_V_33 OBJ_Relative_Long_Vel_STD_33 OBJ_Relative_Long_Velocity_V_33 OBJ_Relative_Long_Velocity_33 ICM_Object_Prot33_B_Header;
SIG_GROUP_ 211 ICM_Object_Prot33_A 1 : OBJ_Rel_Long_Acc_STD_V_33 OBJ_Relative_Long_Acc_STD_33 OBJ_Relative_Long_Acc_V_33 OBJ_Relative_Long_Acc_33 OBJ_Inv_TTC_STD_V_33 OBJ_Inv_TTC_STD_33 OBJ_Inv_TTC_V_33 OBJ_Inv_TTC_33 OBJ_Abs_Acc_STD_V_33 OBJ_Abs_Acc_STD_33 OBJ_Abs_Acceleration_V_33 OBJ_Abs_Acceleration_33 OBJ_Abs_Lat_Acc_STD_V_33 OBJ_Abs_Lat_Acc_STD_33 OBJ_Abs_Lat_Acc_V_33 OBJ_Abs_Lat_Acc_33 OBJ_Abs_Long_Acc_STD_V_33 OBJ_Abs_Long_Acc_STD_33 OBJ_Abs_Long_Acc_V_33 OBJ_Abs_Long_Acc_33 OBJ_Abs_Lat_Vel_STD_V_33 OBJ_Abs_Lat_Velocity_STD_33 OBJ_Abs_Lat_Velocity_V_33 OBJ_Abs_Lat_Velocity_33 OBJ_Abs_Long_Vel_STD_V_33 OBJ_Abs_Long_Velocity_STD_33 OBJ_Abs_Long_Velocity_V_33 OBJ_Abs_Long_Velocity_33 OBJ_Height_STD_V_33 OBJ_Height_STD_33 OBJ_Height_V_33 OBJ_Height_33 OBJ_Length_STD_V_33 OBJ_Length_STD_33 OBJ_Length_V_33 OBJ_Length_33 OBJ_Width_STD_V_33 OBJ_Width_STD_33 OBJ_Width_V_33 OBJ_Width_33 OBJ_Age_Seconds_V_33 OBJ_Age_Seconds_33 OBJ_Lane_Assignment_V_33 OBJ_Lane_Assignment_33 OBJ_Bottom_Out_Of_Image_V_33 OBJ_Top_Out_Of_Image_V_33 OBJ_Bottom_Out_Of_Image_33 OBJ_Top_Out_Of_Image_33 OBJ_Left_Out_Of_Image_V_33 OBJ_Right_Out_Of_Image_V_33 OBJ_Left_Out_Of_Image_33 OBJ_Right_Out_Of_Image_33 OBJ_Light_Indicator_Validity_33 OBJ_Turn_Indicator_Left_33 OBJ_Turn_Indicator_Right_33 OBJ_Brake_Light_33 OBJ_Has_Cut_Path_33 OBJ_Has_Cut_Lane_33 OBJ_Motion_Orientation_33 OBJ_Motion_Status_33 OBJ_Camera_Source_33 OBJ_Bike_Probability_33 OBJ_Truck_Probability_33 OBJ_Car_Probability_33 OBJ_Class_Probability_33 OBJ_Object_Class_33 OBJ_Measuring_Status_33 OBJ_Object_Age_33 OBJ_Moving_IN_Probability_33 OBJ_Motion_Category_33 OBJ_Triggered_SDM_33 OBJ_Fusion_Source_33 OBJ_Existence_Probability_33 OBJ_ID_33 OBJ_CRC_33 ICM_Object_Prot33_A_Header;
SIG_GROUP_ 210 ICM_Object_Prot32_B 1 : OBJ_Buffer_32 OBJ_Is_VeryClose_V_32 OBJ_Is_VeryClose_32 OBJ_Is_In_Drivable_Area_V_32 OBJ_Is_In_Drivable_Area_32 OBJ_Visibility_Side_32 OBJ_Visibility_Side_V_32 OBJ_Angle_Bottom_STD_V_32 OBJ_Angle_Bottom_STD_32 OBJ_Angle_Bottom_32 OBJ_Angle_Bottom_V_32 OBJ_Angle_Mid_STD_V_32 OBJ_Angle_Mid_STD_32 OBJ_Angle_Mid_32 OBJ_Angle_Mid_V_32 OBJ_Angle_Side_STD_V_32 OBJ_Angle_Side_STD_32 OBJ_Angle_Side_V_32 OBJ_Angle_Side_32 OBJ_Angle_Left_STD_V_32 OBJ_Angle_Left_STD_32 OBJ_Angle_Left_V_32 OBJ_Angle_Left_32 OBJ_Angle_Right_STD_V_32 OBJ_Angle_Right_STD_32 OBJ_Angle_Right_V_32 OBJ_Angle_Right_32 OBJ_Angle_Rate_V_32 OBJ_Angle_Rate_32 OBJ_Angle_Rate_STD_V_32 OBJ_Angle_Rate_STD_32 OBJ_Heading_STD_V_32 OBJ_Heading_STD_32 OBJ_Heading_V_32 OBJ_Heading_32 OBJ_Absolute_Speed_STD_V_32 OBJ_Absolute_Speed_STD_32 OBJ_Absolute_Speed_V_32 OBJ_Absolute_Speed_32 OBJ_Lat_Distance_STD_V_32 OBJ_Lat_Distance_STD_32 OBJ_Lat_Distance_V_32 OBJ_Lat_Distance_32 OBJ_Long_Distance_STD_V_32 OBJ_Long_Distance_STD_32 OBJ_Long_Distance_V_32 OBJ_Long_Distance_32 OBJ_Rel_Lat_Vel_STD_V_32 OBJ_Relative_Lat_Velocity_STD_32 OBJ_Relative_Lat_Velocity_V_32 OBJ_Relative_Lat_Velocity_32 OBJ_Rel_Long_Vel_STD_V_32 OBJ_Relative_Long_Vel_STD_32 OBJ_Relative_Long_Velocity_V_32 OBJ_Relative_Long_Velocity_32 ICM_Object_Prot32_B_Header;
SIG_GROUP_ 209 ICM_Object_Prot32_A 1 : OBJ_Rel_Long_Acc_STD_V_32 OBJ_Relative_Long_Acc_STD_32 OBJ_Relative_Long_Acc_V_32 OBJ_Relative_Long_Acc_32 OBJ_Inv_TTC_STD_V_32 OBJ_Inv_TTC_STD_32 OBJ_Inv_TTC_V_32 OBJ_Inv_TTC_32 OBJ_Abs_Acc_STD_V_32 OBJ_Abs_Acc_STD_32 OBJ_Abs_Acceleration_V_32 OBJ_Abs_Acceleration_32 OBJ_Abs_Lat_Acc_STD_V_32 OBJ_Abs_Lat_Acc_STD_32 OBJ_Abs_Lat_Acc_V_32 OBJ_Abs_Lat_Acc_32 OBJ_Abs_Long_Acc_STD_V_32 OBJ_Abs_Long_Acc_STD_32 OBJ_Abs_Long_Acc_V_32 OBJ_Abs_Long_Acc_32 OBJ_Abs_Lat_Vel_STD_V_32 OBJ_Abs_Lat_Velocity_STD_32 OBJ_Abs_Lat_Velocity_V_32 OBJ_Abs_Lat_Velocity_32 OBJ_Abs_Long_Vel_STD_V_32 OBJ_Abs_Long_Velocity_STD_32 OBJ_Abs_Long_Velocity_V_32 OBJ_Abs_Long_Velocity_32 OBJ_Height_STD_V_32 OBJ_Height_STD_32 OBJ_Height_V_32 OBJ_Height_32 OBJ_Length_STD_V_32 OBJ_Length_STD_32 OBJ_Length_V_32 OBJ_Length_32 OBJ_Width_STD_V_32 OBJ_Width_STD_32 OBJ_Width_V_32 OBJ_Width_32 OBJ_Age_Seconds_V_32 OBJ_Age_Seconds_32 OBJ_Lane_Assignment_V_32 OBJ_Lane_Assignment_32 OBJ_Bottom_Out_Of_Image_V_32 OBJ_Top_Out_Of_Image_V_32 OBJ_Bottom_Out_Of_Image_32 OBJ_Top_Out_Of_Image_32 OBJ_Left_Out_Of_Image_V_32 OBJ_Right_Out_Of_Image_V_32 OBJ_Left_Out_Of_Image_32 OBJ_Right_Out_Of_Image_32 OBJ_Light_Indicator_Validity_32 OBJ_Turn_Indicator_Left_32 OBJ_Turn_Indicator_Right_32 OBJ_Brake_Light_32 OBJ_Has_Cut_Path_32 OBJ_Has_Cut_Lane_32 OBJ_Motion_Orientation_32 OBJ_Motion_Status_32 OBJ_Camera_Source_32 OBJ_Bike_Probability_32 OBJ_Truck_Probability_32 OBJ_Car_Probability_32 OBJ_Class_Probability_32 OBJ_Object_Class_32 OBJ_Measuring_Status_32 OBJ_Object_Age_32 OBJ_Moving_IN_Probability_32 OBJ_Motion_Category_32 OBJ_Triggered_SDM_32 OBJ_Fusion_Source_32 OBJ_Existence_Probability_32 OBJ_ID_32 OBJ_CRC_32 ICM_Object_Prot32_A_Header;
SIG_GROUP_ 208 ICM_Object_Prot31_B 1 : OBJ_Buffer_31 OBJ_Is_VeryClose_V_31 OBJ_Is_VeryClose_31 OBJ_Is_In_Drivable_Area_V_31 OBJ_Is_In_Drivable_Area_31 OBJ_Visibility_Side_31 OBJ_Visibility_Side_V_31 OBJ_Angle_Bottom_STD_V_31 OBJ_Angle_Bottom_STD_31 OBJ_Angle_Bottom_31 OBJ_Angle_Bottom_V_31 OBJ_Angle_Mid_STD_V_31 OBJ_Angle_Mid_STD_31 OBJ_Angle_Mid_31 OBJ_Angle_Mid_V_31 OBJ_Angle_Side_STD_V_31 OBJ_Angle_Side_STD_31 OBJ_Angle_Side_V_31 OBJ_Angle_Side_31 OBJ_Angle_Left_STD_V_31 OBJ_Angle_Left_STD_31 OBJ_Angle_Left_V_31 OBJ_Angle_Left_31 OBJ_Angle_Right_STD_V_31 OBJ_Angle_Right_STD_31 OBJ_Angle_Right_V_31 OBJ_Angle_Right_31 OBJ_Angle_Rate_V_31 OBJ_Angle_Rate_31 OBJ_Angle_Rate_STD_V_31 OBJ_Angle_Rate_STD_31 OBJ_Heading_STD_V_31 OBJ_Heading_STD_31 OBJ_Heading_V_31 OBJ_Heading_31 OBJ_Absolute_Speed_STD_V_31 OBJ_Absolute_Speed_STD_31 OBJ_Absolute_Speed_V_31 OBJ_Absolute_Speed_31 OBJ_Lat_Distance_STD_V_31 OBJ_Lat_Distance_STD_31 OBJ_Lat_Distance_V_31 OBJ_Lat_Distance_31 OBJ_Long_Distance_STD_V_31 OBJ_Long_Distance_STD_31 OBJ_Long_Distance_V_31 OBJ_Long_Distance_31 OBJ_Rel_Lat_Vel_STD_V_31 OBJ_Relative_Lat_Velocity_STD_31 OBJ_Relative_Lat_Velocity_V_31 OBJ_Relative_Lat_Velocity_31 OBJ_Rel_Long_Vel_STD_V_31 OBJ_Relative_Long_Vel_STD_31 OBJ_Relative_Long_Velocity_V_31 OBJ_Relative_Long_Velocity_31 ICM_Object_Prot31_B_Header;
SIG_GROUP_ 207 ICM_Object_Prot31_A 1 : OBJ_Rel_Long_Acc_STD_V_31 OBJ_Relative_Long_Acc_STD_31 OBJ_Relative_Long_Acc_V_31 OBJ_Relative_Long_Acc_31 OBJ_Inv_TTC_STD_V_31 OBJ_Inv_TTC_STD_31 OBJ_Inv_TTC_V_31 OBJ_Inv_TTC_31 OBJ_Abs_Acc_STD_V_31 OBJ_Abs_Acc_STD_31 OBJ_Abs_Acceleration_V_31 OBJ_Abs_Acceleration_31 OBJ_Abs_Lat_Acc_STD_V_31 OBJ_Abs_Lat_Acc_STD_31 OBJ_Abs_Lat_Acc_V_31 OBJ_Abs_Lat_Acc_31 OBJ_Abs_Long_Acc_STD_V_31 OBJ_Abs_Long_Acc_STD_31 OBJ_Abs_Long_Acc_V_31 OBJ_Abs_Long_Acc_31 OBJ_Abs_Lat_Vel_STD_V_31 OBJ_Abs_Lat_Velocity_STD_31 OBJ_Abs_Lat_Velocity_V_31 OBJ_Abs_Lat_Velocity_31 OBJ_Abs_Long_Vel_STD_V_31 OBJ_Abs_Long_Velocity_STD_31 OBJ_Abs_Long_Velocity_V_31 OBJ_Abs_Long_Velocity_31 OBJ_Height_STD_V_31 OBJ_Height_STD_31 OBJ_Height_V_31 OBJ_Height_31 OBJ_Length_STD_V_31 OBJ_Length_STD_31 OBJ_Length_V_31 OBJ_Length_31 OBJ_Width_STD_V_31 OBJ_Width_STD_31 OBJ_Width_V_31 OBJ_Width_31 OBJ_Age_Seconds_V_31 OBJ_Age_Seconds_31 OBJ_Lane_Assignment_V_31 OBJ_Lane_Assignment_31 OBJ_Bottom_Out_Of_Image_V_31 OBJ_Top_Out_Of_Image_V_31 OBJ_Bottom_Out_Of_Image_31 OBJ_Top_Out_Of_Image_31 OBJ_Left_Out_Of_Image_V_31 OBJ_Right_Out_Of_Image_V_31 OBJ_Left_Out_Of_Image_31 OBJ_Right_Out_Of_Image_31 OBJ_Light_Indicator_Validity_31 OBJ_Turn_Indicator_Left_31 OBJ_Turn_Indicator_Right_31 OBJ_Brake_Light_31 OBJ_Has_Cut_Path_31 OBJ_Has_Cut_Lane_31 OBJ_Motion_Orientation_31 OBJ_Motion_Status_31 OBJ_Camera_Source_31 OBJ_Bike_Probability_31 OBJ_Truck_Probability_31 OBJ_Car_Probability_31 OBJ_Class_Probability_31 OBJ_Object_Class_31 OBJ_Measuring_Status_31 OBJ_Object_Age_31 OBJ_Moving_IN_Probability_31 OBJ_Motion_Category_31 OBJ_Triggered_SDM_31 OBJ_Fusion_Source_31 OBJ_Existence_Probability_31 OBJ_ID_31 OBJ_CRC_31 ICM_Object_Prot31_A_Header;
SIG_GROUP_ 206 ICM_Object_Prot30_B 1 : OBJ_Buffer_30 OBJ_Is_VeryClose_V_30 OBJ_Is_VeryClose_30 OBJ_Is_In_Drivable_Area_V_30 OBJ_Is_In_Drivable_Area_30 OBJ_Visibility_Side_30 OBJ_Visibility_Side_V_30 OBJ_Angle_Bottom_STD_V_30 OBJ_Angle_Bottom_STD_30 OBJ_Angle_Bottom_30 OBJ_Angle_Bottom_V_30 OBJ_Angle_Mid_STD_V_30 OBJ_Angle_Mid_STD_30 OBJ_Angle_Mid_30 OBJ_Angle_Mid_V_30 OBJ_Angle_Side_STD_V_30 OBJ_Angle_Side_STD_30 OBJ_Angle_Side_V_30 OBJ_Angle_Side_30 OBJ_Angle_Left_STD_V_30 OBJ_Angle_Left_STD_30 OBJ_Angle_Left_V_30 OBJ_Angle_Left_30 OBJ_Angle_Right_STD_V_30 OBJ_Angle_Right_STD_30 OBJ_Angle_Right_V_30 OBJ_Angle_Right_30 OBJ_Angle_Rate_V_30 OBJ_Angle_Rate_30 OBJ_Angle_Rate_STD_V_30 OBJ_Angle_Rate_STD_30 OBJ_Heading_STD_V_30 OBJ_Heading_STD_30 OBJ_Heading_V_30 OBJ_Heading_30 OBJ_Absolute_Speed_STD_V_30 OBJ_Absolute_Speed_STD_30 OBJ_Absolute_Speed_V_30 OBJ_Absolute_Speed_30 OBJ_Lat_Distance_STD_V_30 OBJ_Lat_Distance_STD_30 OBJ_Lat_Distance_V_30 OBJ_Lat_Distance_30 OBJ_Long_Distance_STD_V_30 OBJ_Long_Distance_STD_30 OBJ_Long_Distance_V_30 OBJ_Long_Distance_30 OBJ_Rel_Lat_Vel_STD_V_30 OBJ_Relative_Lat_Velocity_STD_30 OBJ_Relative_Lat_Velocity_V_30 OBJ_Relative_Lat_Velocity_30 OBJ_Rel_Long_Vel_STD_V_30 OBJ_Relative_Long_Vel_STD_30 OBJ_Relative_Long_Velocity_V_30 OBJ_Relative_Long_Velocity_30 ICM_Object_Prot30_B_Header;
SIG_GROUP_ 205 ICM_Object_Prot30_A 1 : OBJ_Rel_Long_Acc_STD_V_30 OBJ_Relative_Long_Acc_STD_30 OBJ_Relative_Long_Acc_V_30 OBJ_Relative_Long_Acc_30 OBJ_Inv_TTC_STD_V_30 OBJ_Inv_TTC_STD_30 OBJ_Inv_TTC_V_30 OBJ_Inv_TTC_30 OBJ_Abs_Acc_STD_V_30 OBJ_Abs_Acc_STD_30 OBJ_Abs_Acceleration_V_30 OBJ_Abs_Acceleration_30 OBJ_Abs_Lat_Acc_STD_V_30 OBJ_Abs_Lat_Acc_STD_30 OBJ_Abs_Lat_Acc_V_30 OBJ_Abs_Lat_Acc_30 OBJ_Abs_Long_Acc_STD_V_30 OBJ_Abs_Long_Acc_STD_30 OBJ_Abs_Long_Acc_V_30 OBJ_Abs_Long_Acc_30 OBJ_Abs_Lat_Vel_STD_V_30 OBJ_Abs_Lat_Velocity_STD_30 OBJ_Abs_Lat_Velocity_V_30 OBJ_Abs_Lat_Velocity_30 OBJ_Abs_Long_Vel_STD_V_30 OBJ_Abs_Long_Velocity_STD_30 OBJ_Abs_Long_Velocity_V_30 OBJ_Abs_Long_Velocity_30 OBJ_Height_STD_V_30 OBJ_Height_STD_30 OBJ_Height_V_30 OBJ_Height_30 OBJ_Length_STD_V_30 OBJ_Length_STD_30 OBJ_Length_V_30 OBJ_Length_30 OBJ_Width_STD_V_30 OBJ_Width_STD_30 OBJ_Width_V_30 OBJ_Width_30 OBJ_Age_Seconds_V_30 OBJ_Age_Seconds_30 OBJ_Lane_Assignment_V_30 OBJ_Lane_Assignment_30 OBJ_Bottom_Out_Of_Image_V_30 OBJ_Top_Out_Of_Image_V_30 OBJ_Bottom_Out_Of_Image_30 OBJ_Top_Out_Of_Image_30 OBJ_Left_Out_Of_Image_V_30 OBJ_Right_Out_Of_Image_V_30 OBJ_Left_Out_Of_Image_30 OBJ_Right_Out_Of_Image_30 OBJ_Light_Indicator_Validity_30 OBJ_Turn_Indicator_Left_30 OBJ_Turn_Indicator_Right_30 OBJ_Brake_Light_30 OBJ_Has_Cut_Path_30 OBJ_Has_Cut_Lane_30 OBJ_Motion_Orientation_30 OBJ_Motion_Status_30 OBJ_Camera_Source_30 OBJ_Bike_Probability_30 OBJ_Truck_Probability_30 OBJ_Car_Probability_30 OBJ_Class_Probability_30 OBJ_Object_Class_30 OBJ_Measuring_Status_30 OBJ_Object_Age_30 OBJ_Moving_IN_Probability_30 OBJ_Motion_Category_30 OBJ_Triggered_SDM_30 OBJ_Fusion_Source_30 OBJ_Existence_Probability_30 OBJ_ID_30 OBJ_CRC_30 ICM_Object_Prot30_A_Header;
SIG_GROUP_ 204 ICM_Object_Prot29_B 1 : OBJ_Buffer_29 OBJ_Is_VeryClose_V_29 OBJ_Is_VeryClose_29 OBJ_Is_In_Drivable_Area_V_29 OBJ_Is_In_Drivable_Area_29 OBJ_Visibility_Side_29 OBJ_Visibility_Side_V_29 OBJ_Angle_Bottom_STD_V_29 OBJ_Angle_Bottom_STD_29 OBJ_Angle_Bottom_29 OBJ_Angle_Bottom_V_29 OBJ_Angle_Mid_STD_V_29 OBJ_Angle_Mid_STD_29 OBJ_Angle_Mid_29 OBJ_Angle_Mid_V_29 OBJ_Angle_Side_STD_V_29 OBJ_Angle_Side_STD_29 OBJ_Angle_Side_V_29 OBJ_Angle_Side_29 OBJ_Angle_Left_STD_V_29 OBJ_Angle_Left_STD_29 OBJ_Angle_Left_V_29 OBJ_Angle_Left_29 OBJ_Angle_Right_STD_V_29 OBJ_Angle_Right_STD_29 OBJ_Angle_Right_V_29 OBJ_Angle_Right_29 OBJ_Angle_Rate_V_29 OBJ_Angle_Rate_29 OBJ_Angle_Rate_STD_V_29 OBJ_Angle_Rate_STD_29 OBJ_Heading_STD_V_29 OBJ_Heading_STD_29 OBJ_Heading_V_29 OBJ_Heading_29 OBJ_Absolute_Speed_STD_V_29 OBJ_Absolute_Speed_STD_29 OBJ_Absolute_Speed_V_29 OBJ_Absolute_Speed_29 OBJ_Lat_Distance_STD_V_29 OBJ_Lat_Distance_STD_29 OBJ_Lat_Distance_V_29 OBJ_Lat_Distance_29 OBJ_Long_Distance_STD_V_29 OBJ_Long_Distance_STD_29 OBJ_Long_Distance_V_29 OBJ_Long_Distance_29 OBJ_Rel_Lat_Vel_STD_V_29 OBJ_Relative_Lat_Velocity_STD_29 OBJ_Relative_Lat_Velocity_V_29 OBJ_Relative_Lat_Velocity_29 OBJ_Rel_Long_Vel_STD_V_29 OBJ_Relative_Long_Vel_STD_29 OBJ_Relative_Long_Velocity_V_29 OBJ_Relative_Long_Velocity_29 ICM_Object_Prot29_B_Header;
SIG_GROUP_ 203 ICM_Object_Prot29_A 1 : OBJ_Rel_Long_Acc_STD_V_29 OBJ_Relative_Long_Acc_STD_29 OBJ_Relative_Long_Acc_V_29 OBJ_Relative_Long_Acc_29 OBJ_Inv_TTC_STD_V_29 OBJ_Inv_TTC_STD_29 OBJ_Inv_TTC_V_29 OBJ_Inv_TTC_29 OBJ_Abs_Acc_STD_V_29 OBJ_Abs_Acc_STD_29 OBJ_Abs_Acceleration_V_29 OBJ_Abs_Acceleration_29 OBJ_Abs_Lat_Acc_STD_V_29 OBJ_Abs_Lat_Acc_STD_29 OBJ_Abs_Lat_Acc_V_29 OBJ_Abs_Lat_Acc_29 OBJ_Abs_Long_Acc_STD_V_29 OBJ_Abs_Long_Acc_STD_29 OBJ_Abs_Long_Acc_V_29 OBJ_Abs_Long_Acc_29 OBJ_Abs_Lat_Vel_STD_V_29 OBJ_Abs_Lat_Velocity_STD_29 OBJ_Abs_Lat_Velocity_V_29 OBJ_Abs_Lat_Velocity_29 OBJ_Abs_Long_Vel_STD_V_29 OBJ_Abs_Long_Velocity_STD_29 OBJ_Abs_Long_Velocity_V_29 OBJ_Abs_Long_Velocity_29 OBJ_Height_STD_V_29 OBJ_Height_STD_29 OBJ_Height_V_29 OBJ_Height_29 OBJ_Length_STD_V_29 OBJ_Length_STD_29 OBJ_Length_V_29 OBJ_Length_29 OBJ_Width_STD_V_29 OBJ_Width_STD_29 OBJ_Width_V_29 OBJ_Width_29 OBJ_Age_Seconds_V_29 OBJ_Age_Seconds_29 OBJ_Lane_Assignment_V_29 OBJ_Lane_Assignment_29 OBJ_Bottom_Out_Of_Image_V_29 OBJ_Top_Out_Of_Image_V_29 OBJ_Bottom_Out_Of_Image_29 OBJ_Top_Out_Of_Image_29 OBJ_Left_Out_Of_Image_V_29 OBJ_Right_Out_Of_Image_V_29 OBJ_Left_Out_Of_Image_29 OBJ_Right_Out_Of_Image_29 OBJ_Light_Indicator_Validity_29 OBJ_Turn_Indicator_Left_29 OBJ_Turn_Indicator_Right_29 OBJ_Brake_Light_29 OBJ_Has_Cut_Path_29 OBJ_Has_Cut_Lane_29 OBJ_Motion_Orientation_29 OBJ_Motion_Status_29 OBJ_Camera_Source_29 OBJ_Bike_Probability_29 OBJ_Truck_Probability_29 OBJ_Car_Probability_29 OBJ_Class_Probability_29 OBJ_Object_Class_29 OBJ_Measuring_Status_29 OBJ_Object_Age_29 OBJ_Moving_IN_Probability_29 OBJ_Motion_Category_29 OBJ_Triggered_SDM_29 OBJ_Fusion_Source_29 OBJ_Existence_Probability_29 OBJ_ID_29 OBJ_CRC_29 ICM_Object_Prot29_A_Header;
SIG_GROUP_ 202 ICM_Object_Prot28_B 1 : OBJ_Buffer_28 OBJ_Is_VeryClose_V_28 OBJ_Is_VeryClose_28 OBJ_Is_In_Drivable_Area_V_28 OBJ_Is_In_Drivable_Area_28 OBJ_Visibility_Side_28 OBJ_Visibility_Side_V_28 OBJ_Angle_Bottom_STD_V_28 OBJ_Angle_Bottom_STD_28 OBJ_Angle_Bottom_28 OBJ_Angle_Bottom_V_28 OBJ_Angle_Mid_STD_V_28 OBJ_Angle_Mid_STD_28 OBJ_Angle_Mid_28 OBJ_Angle_Mid_V_28 OBJ_Angle_Side_STD_V_28 OBJ_Angle_Side_STD_28 OBJ_Angle_Side_V_28 OBJ_Angle_Side_28 OBJ_Angle_Left_STD_V_28 OBJ_Angle_Left_STD_28 OBJ_Angle_Left_V_28 OBJ_Angle_Left_28 OBJ_Angle_Right_STD_V_28 OBJ_Angle_Right_STD_28 OBJ_Angle_Right_V_28 OBJ_Angle_Right_28 OBJ_Angle_Rate_V_28 OBJ_Angle_Rate_28 OBJ_Angle_Rate_STD_V_28 OBJ_Angle_Rate_STD_28 OBJ_Heading_STD_V_28 OBJ_Heading_STD_28 OBJ_Heading_V_28 OBJ_Heading_28 OBJ_Absolute_Speed_STD_V_28 OBJ_Absolute_Speed_STD_28 OBJ_Absolute_Speed_V_28 OBJ_Absolute_Speed_28 OBJ_Lat_Distance_STD_V_28 OBJ_Lat_Distance_STD_28 OBJ_Lat_Distance_V_28 OBJ_Lat_Distance_28 OBJ_Long_Distance_STD_V_28 OBJ_Long_Distance_STD_28 OBJ_Long_Distance_V_28 OBJ_Long_Distance_28 OBJ_Rel_Lat_Vel_STD_V_28 OBJ_Relative_Lat_Velocity_STD_28 OBJ_Relative_Lat_Velocity_V_28 OBJ_Relative_Lat_Velocity_28 OBJ_Rel_Long_Vel_STD_V_28 OBJ_Relative_Long_Vel_STD_28 OBJ_Relative_Long_Velocity_V_28 OBJ_Relative_Long_Velocity_28 ICM_Object_Prot28_B_Header;
SIG_GROUP_ 201 ICM_Object_Prot28_A 1 : OBJ_Rel_Long_Acc_STD_V_28 OBJ_Relative_Long_Acc_STD_28 OBJ_Relative_Long_Acc_V_28 OBJ_Relative_Long_Acc_28 OBJ_Inv_TTC_STD_V_28 OBJ_Inv_TTC_STD_28 OBJ_Inv_TTC_V_28 OBJ_Inv_TTC_28 OBJ_Abs_Acc_STD_V_28 OBJ_Abs_Acc_STD_28 OBJ_Abs_Acceleration_V_28 OBJ_Abs_Acceleration_28 OBJ_Abs_Lat_Acc_STD_V_28 OBJ_Abs_Lat_Acc_STD_28 OBJ_Abs_Lat_Acc_V_28 OBJ_Abs_Lat_Acc_28 OBJ_Abs_Long_Acc_STD_V_28 OBJ_Abs_Long_Acc_STD_28 OBJ_Abs_Long_Acc_V_28 OBJ_Abs_Long_Acc_28 OBJ_Abs_Lat_Vel_STD_V_28 OBJ_Abs_Lat_Velocity_STD_28 OBJ_Abs_Lat_Velocity_V_28 OBJ_Abs_Lat_Velocity_28 OBJ_Abs_Long_Vel_STD_V_28 OBJ_Abs_Long_Velocity_STD_28 OBJ_Abs_Long_Velocity_V_28 OBJ_Abs_Long_Velocity_28 OBJ_Height_STD_V_28 OBJ_Height_STD_28 OBJ_Height_V_28 OBJ_Height_28 OBJ_Length_STD_V_28 OBJ_Length_STD_28 OBJ_Length_V_28 OBJ_Length_28 OBJ_Width_STD_V_28 OBJ_Width_STD_28 OBJ_Width_V_28 OBJ_Width_28 OBJ_Age_Seconds_V_28 OBJ_Age_Seconds_28 OBJ_Lane_Assignment_V_28 OBJ_Lane_Assignment_28 OBJ_Bottom_Out_Of_Image_V_28 OBJ_Top_Out_Of_Image_V_28 OBJ_Bottom_Out_Of_Image_28 OBJ_Top_Out_Of_Image_28 OBJ_Left_Out_Of_Image_V_28 OBJ_Right_Out_Of_Image_V_28 OBJ_Left_Out_Of_Image_28 OBJ_Right_Out_Of_Image_28 OBJ_Light_Indicator_Validity_28 OBJ_Turn_Indicator_Left_28 OBJ_Turn_Indicator_Right_28 OBJ_Brake_Light_28 OBJ_Has_Cut_Path_28 OBJ_Has_Cut_Lane_28 OBJ_Motion_Orientation_28 OBJ_Motion_Status_28 OBJ_Camera_Source_28 OBJ_Bike_Probability_28 OBJ_Truck_Probability_28 OBJ_Car_Probability_28 OBJ_Class_Probability_28 OBJ_Object_Class_28 OBJ_Measuring_Status_28 OBJ_Object_Age_28 OBJ_Moving_IN_Probability_28 OBJ_Motion_Category_28 OBJ_Triggered_SDM_28 OBJ_Fusion_Source_28 OBJ_Existence_Probability_28 OBJ_ID_28 OBJ_CRC_28 ICM_Object_Prot28_A_Header;
SIG_GROUP_ 200 ICM_Object_Prot27_B 1 : OBJ_Buffer_27 OBJ_Is_VeryClose_V_27 OBJ_Is_VeryClose_27 OBJ_Is_In_Drivable_Area_V_27 OBJ_Is_In_Drivable_Area_27 OBJ_Visibility_Side_27 OBJ_Visibility_Side_V_27 OBJ_Angle_Bottom_STD_V_27 OBJ_Angle_Bottom_STD_27 OBJ_Angle_Bottom_27 OBJ_Angle_Bottom_V_27 OBJ_Angle_Mid_STD_V_27 OBJ_Angle_Mid_STD_27 OBJ_Angle_Mid_27 OBJ_Angle_Mid_V_27 OBJ_Angle_Side_STD_V_27 OBJ_Angle_Side_STD_27 OBJ_Angle_Side_V_27 OBJ_Angle_Side_27 OBJ_Angle_Left_STD_V_27 OBJ_Angle_Left_STD_27 OBJ_Angle_Left_V_27 OBJ_Angle_Left_27 OBJ_Angle_Right_STD_V_27 OBJ_Angle_Right_STD_27 OBJ_Angle_Right_V_27 OBJ_Angle_Right_27 OBJ_Angle_Rate_V_27 OBJ_Angle_Rate_27 OBJ_Angle_Rate_STD_V_27 OBJ_Angle_Rate_STD_27 OBJ_Heading_STD_V_27 OBJ_Heading_STD_27 OBJ_Heading_V_27 OBJ_Heading_27 OBJ_Absolute_Speed_STD_V_27 OBJ_Absolute_Speed_STD_27 OBJ_Absolute_Speed_V_27 OBJ_Absolute_Speed_27 OBJ_Lat_Distance_STD_V_27 OBJ_Lat_Distance_STD_27 OBJ_Lat_Distance_V_27 OBJ_Lat_Distance_27 OBJ_Long_Distance_STD_V_27 OBJ_Long_Distance_STD_27 OBJ_Long_Distance_V_27 OBJ_Long_Distance_27 OBJ_Rel_Lat_Vel_STD_V_27 OBJ_Relative_Lat_Velocity_STD_27 OBJ_Relative_Lat_Velocity_V_27 OBJ_Relative_Lat_Velocity_27 OBJ_Rel_Long_Vel_STD_V_27 OBJ_Relative_Long_Vel_STD_27 OBJ_Relative_Long_Velocity_V_27 OBJ_Relative_Long_Velocity_27 ICM_Object_Prot27_B_Header;
SIG_GROUP_ 199 ICM_Object_Prot27_A 1 : OBJ_Rel_Long_Acc_STD_V_27 OBJ_Relative_Long_Acc_STD_27 OBJ_Relative_Long_Acc_V_27 OBJ_Relative_Long_Acc_27 OBJ_Inv_TTC_STD_V_27 OBJ_Inv_TTC_STD_27 OBJ_Inv_TTC_V_27 OBJ_Inv_TTC_27 OBJ_Abs_Acc_STD_V_27 OBJ_Abs_Acc_STD_27 OBJ_Abs_Acceleration_V_27 OBJ_Abs_Acceleration_27 OBJ_Abs_Lat_Acc_STD_V_27 OBJ_Abs_Lat_Acc_STD_27 OBJ_Abs_Lat_Acc_V_27 OBJ_Abs_Lat_Acc_27 OBJ_Abs_Long_Acc_STD_V_27 OBJ_Abs_Long_Acc_STD_27 OBJ_Abs_Long_Acc_V_27 OBJ_Abs_Long_Acc_27 OBJ_Abs_Lat_Vel_STD_V_27 OBJ_Abs_Lat_Velocity_STD_27 OBJ_Abs_Lat_Velocity_V_27 OBJ_Abs_Lat_Velocity_27 OBJ_Abs_Long_Vel_STD_V_27 OBJ_Abs_Long_Velocity_STD_27 OBJ_Abs_Long_Velocity_V_27 OBJ_Abs_Long_Velocity_27 OBJ_Height_STD_V_27 OBJ_Height_STD_27 OBJ_Height_V_27 OBJ_Height_27 OBJ_Length_STD_V_27 OBJ_Length_STD_27 OBJ_Length_V_27 OBJ_Length_27 OBJ_Width_STD_V_27 OBJ_Width_STD_27 OBJ_Width_V_27 OBJ_Width_27 OBJ_Age_Seconds_V_27 OBJ_Age_Seconds_27 OBJ_Lane_Assignment_V_27 OBJ_Lane_Assignment_27 OBJ_Bottom_Out_Of_Image_V_27 OBJ_Top_Out_Of_Image_V_27 OBJ_Bottom_Out_Of_Image_27 OBJ_Top_Out_Of_Image_27 OBJ_Left_Out_Of_Image_V_27 OBJ_Right_Out_Of_Image_V_27 OBJ_Left_Out_Of_Image_27 OBJ_Right_Out_Of_Image_27 OBJ_Light_Indicator_Validity_27 OBJ_Turn_Indicator_Left_27 OBJ_Turn_Indicator_Right_27 OBJ_Brake_Light_27 OBJ_Has_Cut_Path_27 OBJ_Has_Cut_Lane_27 OBJ_Motion_Orientation_27 OBJ_Motion_Status_27 OBJ_Camera_Source_27 OBJ_Bike_Probability_27 OBJ_Truck_Probability_27 OBJ_Car_Probability_27 OBJ_Class_Probability_27 OBJ_Object_Class_27 OBJ_Measuring_Status_27 OBJ_Object_Age_27 OBJ_Moving_IN_Probability_27 OBJ_Motion_Category_27 OBJ_Triggered_SDM_27 OBJ_Fusion_Source_27 OBJ_Existence_Probability_27 OBJ_ID_27 OBJ_CRC_27 ICM_Object_Prot27_A_Header;
SIG_GROUP_ 198 ICM_Object_Prot26_B 1 : OBJ_Buffer_26 OBJ_Is_VeryClose_V_26 OBJ_Is_VeryClose_26 OBJ_Is_In_Drivable_Area_V_26 OBJ_Is_In_Drivable_Area_26 OBJ_Visibility_Side_26 OBJ_Visibility_Side_V_26 OBJ_Angle_Bottom_STD_V_26 OBJ_Angle_Bottom_STD_26 OBJ_Angle_Bottom_26 OBJ_Angle_Bottom_V_26 OBJ_Angle_Mid_STD_V_26 OBJ_Angle_Mid_STD_26 OBJ_Angle_Mid_26 OBJ_Angle_Mid_V_26 OBJ_Angle_Side_STD_V_26 OBJ_Angle_Side_STD_26 OBJ_Angle_Side_V_26 OBJ_Angle_Side_26 OBJ_Angle_Left_STD_V_26 OBJ_Angle_Left_STD_26 OBJ_Angle_Left_V_26 OBJ_Angle_Left_26 OBJ_Angle_Right_STD_V_26 OBJ_Angle_Right_STD_26 OBJ_Angle_Right_V_26 OBJ_Angle_Right_26 OBJ_Angle_Rate_V_26 OBJ_Angle_Rate_26 OBJ_Angle_Rate_STD_V_26 OBJ_Angle_Rate_STD_26 OBJ_Heading_STD_V_26 OBJ_Heading_STD_26 OBJ_Heading_V_26 OBJ_Heading_26 OBJ_Absolute_Speed_STD_V_26 OBJ_Absolute_Speed_STD_26 OBJ_Absolute_Speed_V_26 OBJ_Absolute_Speed_26 OBJ_Lat_Distance_STD_V_26 OBJ_Lat_Distance_STD_26 OBJ_Lat_Distance_V_26 OBJ_Lat_Distance_26 OBJ_Long_Distance_STD_V_26 OBJ_Long_Distance_STD_26 OBJ_Long_Distance_V_26 OBJ_Long_Distance_26 OBJ_Rel_Lat_Vel_STD_V_26 OBJ_Relative_Lat_Velocity_STD_26 OBJ_Relative_Lat_Velocity_V_26 OBJ_Relative_Lat_Velocity_26 OBJ_Rel_Long_Vel_STD_V_26 OBJ_Relative_Long_Vel_STD_26 OBJ_Relative_Long_Velocity_V_26 OBJ_Relative_Long_Velocity_26 ICM_Object_Prot26_B_Header;
SIG_GROUP_ 197 ICM_Object_Prot26_A 1 : OBJ_Rel_Long_Acc_STD_V_26 OBJ_Relative_Long_Acc_STD_26 OBJ_Relative_Long_Acc_V_26 OBJ_Relative_Long_Acc_26 OBJ_Inv_TTC_STD_V_26 OBJ_Inv_TTC_STD_26 OBJ_Inv_TTC_V_26 OBJ_Inv_TTC_26 OBJ_Abs_Acc_STD_V_26 OBJ_Abs_Acc_STD_26 OBJ_Abs_Acceleration_V_26 OBJ_Abs_Acceleration_26 OBJ_Abs_Lat_Acc_STD_V_26 OBJ_Abs_Lat_Acc_STD_26 OBJ_Abs_Lat_Acc_V_26 OBJ_Abs_Lat_Acc_26 OBJ_Abs_Long_Acc_STD_V_26 OBJ_Abs_Long_Acc_STD_26 OBJ_Abs_Long_Acc_V_26 OBJ_Abs_Long_Acc_26 OBJ_Abs_Lat_Vel_STD_V_26 OBJ_Abs_Lat_Velocity_STD_26 OBJ_Abs_Lat_Velocity_V_26 OBJ_Abs_Lat_Velocity_26 OBJ_Abs_Long_Vel_STD_V_26 OBJ_Abs_Long_Velocity_STD_26 OBJ_Abs_Long_Velocity_V_26 OBJ_Abs_Long_Velocity_26 OBJ_Height_STD_V_26 OBJ_Height_STD_26 OBJ_Height_V_26 OBJ_Height_26 OBJ_Length_STD_V_26 OBJ_Length_STD_26 OBJ_Length_V_26 OBJ_Length_26 OBJ_Width_STD_V_26 OBJ_Width_STD_26 OBJ_Width_V_26 OBJ_Width_26 OBJ_Age_Seconds_V_26 OBJ_Age_Seconds_26 OBJ_Lane_Assignment_V_26 OBJ_Lane_Assignment_26 OBJ_Bottom_Out_Of_Image_V_26 OBJ_Top_Out_Of_Image_V_26 OBJ_Bottom_Out_Of_Image_26 OBJ_Top_Out_Of_Image_26 OBJ_Left_Out_Of_Image_V_26 OBJ_Right_Out_Of_Image_V_26 OBJ_Left_Out_Of_Image_26 OBJ_Right_Out_Of_Image_26 OBJ_Light_Indicator_Validity_26 OBJ_Turn_Indicator_Left_26 OBJ_Turn_Indicator_Right_26 OBJ_Brake_Light_26 OBJ_Has_Cut_Path_26 OBJ_Has_Cut_Lane_26 OBJ_Motion_Orientation_26 OBJ_Motion_Status_26 OBJ_Camera_Source_26 OBJ_Bike_Probability_26 OBJ_Truck_Probability_26 OBJ_Car_Probability_26 OBJ_Class_Probability_26 OBJ_Object_Class_26 OBJ_Measuring_Status_26 OBJ_Object_Age_26 OBJ_Moving_IN_Probability_26 OBJ_Motion_Category_26 OBJ_Triggered_SDM_26 OBJ_Fusion_Source_26 OBJ_Existence_Probability_26 OBJ_ID_26 OBJ_CRC_26 ICM_Object_Prot26_A_Header;
