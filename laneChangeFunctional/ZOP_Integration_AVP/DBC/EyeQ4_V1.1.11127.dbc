VERSION "3"

NS_ :

BS_:

BU_: MyECU ACM

BO_ 513 ACM_Immobilizer: 8 ACM
 SG_ Immobilizer2 : 0|64@1+ (1,0) [0|0] ""  MyECU

BO_ 512 ICM_Immobilizer: 8 MyECU
 SG_ Immobilizer1 : 0|64@1+ (1,0) [0|0] ""  ACM

BO_ 48 SystemSyncTimer: 8 MyECU
 SG_ SysSyncTmrCrc : 48|16@1+ (1,0) [0|65535] ""  ACM
 SG_ SysSyncTmr : 0|48@1+ (1,0) [0|281474976710600] ""  ACM

BO_ 82 ICM_Failsafe_Prot_C: 64 MyECU
 SG_ ICM_Failsafe_Prot_C_CRC : 400|16@1+ (1,0) [0|65535] ""  ACM
 SG_ ICM_Failsafe_Prot_C_Header : 0|16@1+ (1,0) [0|65535] ""  ACM
 SG_ FS_CRC_9 : 16|32@1+ (1,0) [0|4294967295] "NA"  ACM
 SG_ FS_Camera_ID_9 : 48|4@1+ (1,0) [0|11] "counter"  ACM
 SG_ FS_Free_Sight_9 : 52|1@1+ (1,0) [0|1] "bool"  ACM
 SG_ FS_Splashes_9 : 53|3@1+ (1,0) [0|5] "ENUM"  ACM
 SG_ FS_Sun_Ray_9 : 56|3@1+ (1,0) [0|5] "ENUM"  ACM
 SG_ FS_Low_Sun_9 : 59|3@1+ (1,0) [0|5] "ENUM"  ACM
 SG_ FS_Blur_Image_9 : 62|3@1+ (1,0) [0|5] "ENUM"  ACM
 SG_ FS_Partial_Blockage_9 : 65|3@1+ (1,0) [0|5] "ENUM"  ACM
 SG_ FS_Full_Blockage_9 : 68|3@1+ (1,0) [0|5] "ENUM"  ACM
 SG_ FS_Frozen_Windshield_9 : 71|3@1+ (1,0) [0|5] "ENUM"  ACM
 SG_ FS_Out_Of_Focus_9 : 74|3@1+ (1,0) [0|5] "ENUM"  ACM
 SG_ FS_C2C_Out_Of_Calib_9 : 77|3@1+ (1,0) [0|5] "ENUM"  ACM
 SG_ FS_CRC_10 : 80|32@1+ (1,0) [0|4294967295] "NA"  ACM
 SG_ FS_Camera_ID_10 : 112|4@1+ (1,0) [0|11] "counter"  ACM
 SG_ FS_Free_Sight_10 : 116|1@1+ (1,0) [0|1] "bool"  ACM
 SG_ FS_Splashes_10 : 117|3@1+ (1,0) [0|5] "ENUM"  ACM
 SG_ FS_Sun_Ray_10 : 120|3@1+ (1,0) [0|5] "ENUM"  ACM
 SG_ FS_Low_Sun_10 : 123|3@1+ (1,0) [0|5] "ENUM"  ACM
 SG_ FS_Blur_Image_10 : 126|3@1+ (1,0) [0|5] "ENUM"  ACM
 SG_ FS_Partial_Blockage_10 : 129|3@1+ (1,0) [0|5] "ENUM"  ACM
 SG_ FS_Full_Blockage_10 : 132|3@1+ (1,0) [0|5] "ENUM"  ACM
 SG_ FS_Frozen_Windshield_10 : 135|3@1+ (1,0) [0|5] "ENUM"  ACM
 SG_ FS_Out_Of_Focus_10 : 138|3@1+ (1,0) [0|5] "ENUM"  ACM
 SG_ FS_C2C_Out_Of_Calib_10 : 141|3@1+ (1,0) [0|5] "ENUM"  ACM
 SG_ FS_CRC_11 : 144|32@1+ (1,0) [0|4294967295] "NA"  ACM
 SG_ FS_Camera_ID_11 : 176|4@1+ (1,0) [0|11] "counter"  ACM
 SG_ FS_Free_Sight_11 : 180|1@1+ (1,0) [0|1] "bool"  ACM
 SG_ FS_Splashes_11 : 181|3@1+ (1,0) [0|5] "ENUM"  ACM
 SG_ FS_Sun_Ray_11 : 184|3@1+ (1,0) [0|5] "ENUM"  ACM
 SG_ FS_Low_Sun_11 : 187|3@1+ (1,0) [0|5] "ENUM"  ACM
 SG_ FS_Blur_Image_11 : 190|3@1+ (1,0) [0|5] "ENUM"  ACM
 SG_ FS_Partial_Blockage_11 : 193|3@1+ (1,0) [0|5] "ENUM"  ACM
 SG_ FS_Full_Blockage_11 : 196|3@1+ (1,0) [0|5] "ENUM"  ACM
 SG_ FS_Frozen_Windshield_11 : 199|3@1+ (1,0) [0|5] "ENUM"  ACM
 SG_ FS_Out_Of_Focus_11 : 202|3@1+ (1,0) [0|5] "ENUM"  ACM
 SG_ FS_C2C_Out_Of_Calib_11 : 205|3@1+ (1,0) [0|5] "ENUM"  ACM
 SG_ FS_CRC_12 : 208|32@1+ (1,0) [0|4294967295] "NA"  ACM
 SG_ FS_Camera_ID_12 : 240|4@1+ (1,0) [0|11] "counter"  ACM
 SG_ FS_Free_Sight_12 : 244|1@1+ (1,0) [0|1] "bool"  ACM
 SG_ FS_Splashes_12 : 245|3@1+ (1,0) [0|5] "ENUM"  ACM
 SG_ FS_Sun_Ray_12 : 248|3@1+ (1,0) [0|5] "ENUM"  ACM
 SG_ FS_Low_Sun_12 : 251|3@1+ (1,0) [0|5] "ENUM"  ACM
 SG_ FS_Blur_Image_12 : 254|3@1+ (1,0) [0|5] "ENUM"  ACM
 SG_ FS_Partial_Blockage_12 : 257|3@1+ (1,0) [0|5] "ENUM"  ACM
 SG_ FS_Full_Blockage_12 : 260|3@1+ (1,0) [0|5] "ENUM"  ACM
 SG_ FS_Frozen_Windshield_12 : 263|3@1+ (1,0) [0|5] "ENUM"  ACM
 SG_ FS_Out_Of_Focus_12 : 266|3@1+ (1,0) [0|5] "ENUM"  ACM
 SG_ FS_C2C_Out_Of_Calib_12 : 269|3@1+ (1,0) [0|5] "ENUM"  ACM
 SG_ FS_CRC_13 : 272|32@1+ (1,0) [0|4294967295] "NA"  ACM
 SG_ FS_Camera_ID_13 : 304|4@1+ (1,0) [0|11] "counter"  ACM
 SG_ FS_Free_Sight_13 : 308|1@1+ (1,0) [0|1] "bool"  ACM
 SG_ FS_Splashes_13 : 309|3@1+ (1,0) [0|5] "ENUM"  ACM
 SG_ FS_Sun_Ray_13 : 312|3@1+ (1,0) [0|5] "ENUM"  ACM
 SG_ FS_Low_Sun_13 : 315|3@1+ (1,0) [0|5] "ENUM"  ACM
 SG_ FS_Blur_Image_13 : 318|3@1+ (1,0) [0|5] "ENUM"  ACM
 SG_ FS_Partial_Blockage_13 : 321|3@1+ (1,0) [0|5] "ENUM"  ACM
 SG_ FS_Full_Blockage_13 : 324|3@1+ (1,0) [0|5] "ENUM"  ACM
 SG_ FS_Frozen_Windshield_13 : 327|3@1+ (1,0) [0|5] "ENUM"  ACM
 SG_ FS_Out_Of_Focus_13 : 330|3@1+ (1,0) [0|5] "ENUM"  ACM
 SG_ FS_C2C_Out_Of_Calib_13 : 333|3@1+ (1,0) [0|5] "ENUM"  ACM
 SG_ FS_CRC_14 : 336|32@1+ (1,0) [0|4294967295] "NA"  ACM
 SG_ FS_Camera_ID_14 : 368|4@1+ (1,0) [0|11] "counter"  ACM
 SG_ FS_Free_Sight_14 : 372|1@1+ (1,0) [0|1] "bool"  ACM
 SG_ FS_Splashes_14 : 373|3@1+ (1,0) [0|5] "ENUM"  ACM
 SG_ FS_Sun_Ray_14 : 376|3@1+ (1,0) [0|5] "ENUM"  ACM
 SG_ FS_Low_Sun_14 : 379|3@1+ (1,0) [0|5] "ENUM"  ACM
 SG_ FS_Blur_Image_14 : 382|3@1+ (1,0) [0|5] "ENUM"  ACM
 SG_ FS_Partial_Blockage_14 : 385|3@1+ (1,0) [0|5] "ENUM"  ACM
 SG_ FS_Full_Blockage_14 : 388|3@1+ (1,0) [0|5] "ENUM"  ACM
 SG_ FS_Frozen_Windshield_14 : 391|3@1+ (1,0) [0|5] "ENUM"  ACM
 SG_ FS_Out_Of_Focus_14 : 394|3@1+ (1,0) [0|5] "ENUM"  ACM
 SG_ FS_C2C_Out_Of_Calib_14 : 397|3@1+ (1,0) [0|5] "ENUM"  ACM

BO_ 81 ICM_Failsafe_Prot_B: 64 MyECU
 SG_ ICM_Failsafe_Prot_B_Header : 0|16@1+ (1,0) [0|65535] ""  ACM
 SG_ FS_CRC_3 : 16|32@1+ (1,0) [0|4294967295] "NA"  ACM
 SG_ FS_Camera_ID_3 : 48|4@1+ (1,0) [0|11] "counter"  ACM
 SG_ FS_Free_Sight_3 : 52|1@1+ (1,0) [0|1] "bool"  ACM
 SG_ FS_Splashes_3 : 53|3@1+ (1,0) [0|5] "ENUM"  ACM
 SG_ FS_Sun_Ray_3 : 56|3@1+ (1,0) [0|5] "ENUM"  ACM
 SG_ FS_Low_Sun_3 : 59|3@1+ (1,0) [0|5] "ENUM"  ACM
 SG_ FS_Blur_Image_3 : 62|3@1+ (1,0) [0|5] "ENUM"  ACM
 SG_ FS_Partial_Blockage_3 : 65|3@1+ (1,0) [0|5] "ENUM"  ACM
 SG_ FS_Full_Blockage_3 : 68|3@1+ (1,0) [0|5] "ENUM"  ACM
 SG_ FS_Frozen_Windshield_3 : 71|3@1+ (1,0) [0|5] "ENUM"  ACM
 SG_ FS_Out_Of_Focus_3 : 74|3@1+ (1,0) [0|5] "ENUM"  ACM
 SG_ FS_C2C_Out_Of_Calib_3 : 77|3@1+ (1,0) [0|5] "ENUM"  ACM
 SG_ FS_CRC_4 : 80|32@1+ (1,0) [0|4294967295] "NA"  ACM
 SG_ FS_Camera_ID_4 : 112|4@1+ (1,0) [0|11] "counter"  ACM
 SG_ FS_Free_Sight_4 : 116|1@1+ (1,0) [0|1] "bool"  ACM
 SG_ FS_Splashes_4 : 117|3@1+ (1,0) [0|5] "ENUM"  ACM
 SG_ FS_Sun_Ray_4 : 120|3@1+ (1,0) [0|5] "ENUM"  ACM
 SG_ FS_Low_Sun_4 : 123|3@1+ (1,0) [0|5] "ENUM"  ACM
 SG_ FS_Blur_Image_4 : 126|3@1+ (1,0) [0|5] "ENUM"  ACM
 SG_ FS_Partial_Blockage_4 : 129|3@1+ (1,0) [0|5] "ENUM"  ACM
 SG_ FS_Full_Blockage_4 : 132|3@1+ (1,0) [0|5] "ENUM"  ACM
 SG_ FS_Frozen_Windshield_4 : 135|3@1+ (1,0) [0|5] "ENUM"  ACM
 SG_ FS_Out_Of_Focus_4 : 138|3@1+ (1,0) [0|5] "ENUM"  ACM
 SG_ FS_C2C_Out_Of_Calib_4 : 141|3@1+ (1,0) [0|5] "ENUM"  ACM
 SG_ FS_CRC_5 : 144|32@1+ (1,0) [0|4294967295] "NA"  ACM
 SG_ FS_Camera_ID_5 : 176|4@1+ (1,0) [0|11] "counter"  ACM
 SG_ FS_Free_Sight_5 : 180|1@1+ (1,0) [0|1] "bool"  ACM
 SG_ FS_Splashes_5 : 181|3@1+ (1,0) [0|5] "ENUM"  ACM
 SG_ FS_Sun_Ray_5 : 184|3@1+ (1,0) [0|5] "ENUM"  ACM
 SG_ FS_Low_Sun_5 : 187|3@1+ (1,0) [0|5] "ENUM"  ACM
 SG_ FS_Blur_Image_5 : 190|3@1+ (1,0) [0|5] "ENUM"  ACM
 SG_ FS_Partial_Blockage_5 : 193|3@1+ (1,0) [0|5] "ENUM"  ACM
 SG_ FS_Full_Blockage_5 : 196|3@1+ (1,0) [0|5] "ENUM"  ACM
 SG_ FS_Frozen_Windshield_5 : 199|3@1+ (1,0) [0|5] "ENUM"  ACM
 SG_ FS_Out_Of_Focus_5 : 202|3@1+ (1,0) [0|5] "ENUM"  ACM
 SG_ FS_C2C_Out_Of_Calib_5 : 205|3@1+ (1,0) [0|5] "ENUM"  ACM
 SG_ FS_CRC_6 : 208|32@1+ (1,0) [0|4294967295] "NA"  ACM
 SG_ FS_Camera_ID_6 : 240|4@1+ (1,0) [0|11] "counter"  ACM
 SG_ FS_Free_Sight_6 : 244|1@1+ (1,0) [0|1] "bool"  ACM
 SG_ FS_Splashes_6 : 245|3@1+ (1,0) [0|5] "ENUM"  ACM
 SG_ FS_Sun_Ray_6 : 248|3@1+ (1,0) [0|5] "ENUM"  ACM
 SG_ FS_Low_Sun_6 : 251|3@1+ (1,0) [0|5] "ENUM"  ACM
 SG_ FS_Blur_Image_6 : 254|3@1+ (1,0) [0|5] "ENUM"  ACM
 SG_ FS_Partial_Blockage_6 : 257|3@1+ (1,0) [0|5] "ENUM"  ACM
 SG_ FS_Full_Blockage_6 : 260|3@1+ (1,0) [0|5] "ENUM"  ACM
 SG_ FS_Frozen_Windshield_6 : 263|3@1+ (1,0) [0|5] "ENUM"  ACM
 SG_ FS_Out_Of_Focus_6 : 266|3@1+ (1,0) [0|5] "ENUM"  ACM
 SG_ FS_C2C_Out_Of_Calib_6 : 269|3@1+ (1,0) [0|5] "ENUM"  ACM
 SG_ FS_CRC_7 : 272|32@1+ (1,0) [0|4294967295] "NA"  ACM
 SG_ FS_Camera_ID_7 : 304|4@1+ (1,0) [0|11] "counter"  ACM
 SG_ FS_Free_Sight_7 : 308|1@1+ (1,0) [0|1] "bool"  ACM
 SG_ FS_Splashes_7 : 309|3@1+ (1,0) [0|5] "ENUM"  ACM
 SG_ FS_Sun_Ray_7 : 312|3@1+ (1,0) [0|5] "ENUM"  ACM
 SG_ FS_Low_Sun_7 : 315|3@1+ (1,0) [0|5] "ENUM"  ACM
 SG_ FS_Blur_Image_7 : 318|3@1+ (1,0) [0|5] "ENUM"  ACM
 SG_ FS_Partial_Blockage_7 : 321|3@1+ (1,0) [0|5] "ENUM"  ACM
 SG_ FS_Full_Blockage_7 : 324|3@1+ (1,0) [0|5] "ENUM"  ACM
 SG_ FS_Frozen_Windshield_7 : 327|3@1+ (1,0) [0|5] "ENUM"  ACM
 SG_ FS_Out_Of_Focus_7 : 330|3@1+ (1,0) [0|5] "ENUM"  ACM
 SG_ FS_C2C_Out_Of_Calib_7 : 333|3@1+ (1,0) [0|5] "ENUM"  ACM
 SG_ FS_CRC_8 : 336|32@1+ (1,0) [0|4294967295] "NA"  ACM
 SG_ FS_Camera_ID_8 : 368|4@1+ (1,0) [0|11] "counter"  ACM
 SG_ FS_Free_Sight_8 : 372|1@1+ (1,0) [0|1] "bool"  ACM
 SG_ FS_Splashes_8 : 373|3@1+ (1,0) [0|5] "ENUM"  ACM
 SG_ FS_Sun_Ray_8 : 376|3@1+ (1,0) [0|5] "ENUM"  ACM
 SG_ FS_Low_Sun_8 : 379|3@1+ (1,0) [0|5] "ENUM"  ACM
 SG_ FS_Blur_Image_8 : 382|3@1+ (1,0) [0|5] "ENUM"  ACM
 SG_ FS_Partial_Blockage_8 : 385|3@1+ (1,0) [0|5] "ENUM"  ACM
 SG_ FS_Full_Blockage_8 : 388|3@1+ (1,0) [0|5] "ENUM"  ACM
 SG_ FS_Frozen_Windshield_8 : 391|3@1+ (1,0) [0|5] "ENUM"  ACM
 SG_ FS_Out_Of_Focus_8 : 394|3@1+ (1,0) [0|5] "ENUM"  ACM
 SG_ FS_C2C_Out_Of_Calib_8 : 397|3@1+ (1,0) [0|5] "ENUM"  ACM

BO_ 80 ICM_Failsafe_Prot_A: 64 MyECU
 SG_ FS_Frozen_Windshield_2 : 327|3@1- (1,0) [0|5] ""  ACM
 SG_ FS_Frozen_Windshield_1 : 263|3@1- (1,0) [0|5] ""  ACM
 SG_ ICM_Failsafe_Prot_A_Header : 0|16@1+ (1,0) [0|65535] ""  ACM
 SG_ FS_TSR_Out_OF_Calib : 100|8@1- (1,0) [-128|127] ""  ACM
 SG_ FS_C2C_Out_Of_Calib_2 : 333|3@1+ (1,0) [0|5] "ENUM"  ACM
 SG_ FS_Out_Of_Focus_2 : 330|3@1+ (1,0) [0|5] "ENUM"  ACM
 SG_ FS_Full_Blockage_2 : 324|3@1+ (1,0) [0|5] "ENUM"  ACM
 SG_ FS_Partial_Blockage_2 : 321|3@1+ (1,0) [0|5] "ENUM"  ACM
 SG_ FS_Blur_Image_2 : 318|3@1+ (1,0) [0|5] "ENUM"  ACM
 SG_ FS_Low_Sun_2 : 315|3@1+ (1,0) [0|5] "ENUM"  ACM
 SG_ FS_Sun_Ray_2 : 312|3@1+ (1,0) [0|5] "ENUM"  ACM
 SG_ FS_Splashes_2 : 309|3@1+ (1,0) [0|5] "ENUM"  ACM
 SG_ FS_Free_Sight_2 : 308|1@1+ (1,0) [0|1] "bool"  ACM
 SG_ FS_Camera_ID_2 : 304|4@1+ (1,0) [0|15] "ENUM"  ACM
 SG_ FS_CRC_2 : 272|32@1+ (1,0) [0|4294967295] "NA"  ACM
 SG_ FS_C2C_Out_Of_Calib_1 : 269|3@1+ (1,0) [0|5] "ENUM"  ACM
 SG_ FS_Out_Of_Focus_1 : 266|3@1+ (1,0) [0|5] "ENUM"  ACM
 SG_ FS_Full_Blockage_1 : 260|3@1+ (1,0) [0|5] "ENUM"  ACM
 SG_ FS_Partial_Blockage_1 : 257|3@1+ (1,0) [0|5] "ENUM"  ACM
 SG_ FS_Blur_Image_1 : 254|3@1+ (1,0) [0|5] "ENUM"  ACM
 SG_ FS_Low_Sun_1 : 251|3@1+ (1,0) [0|5] "ENUM"  ACM
 SG_ FS_Sun_Ray_1 : 248|3@1+ (1,0) [0|5] "ENUM"  ACM
 SG_ FS_Splashes_1 : 245|3@1+ (1,0) [0|5] "ENUM"  ACM
 SG_ FS_Free_Sight_1 : 244|1@1+ (1,0) [0|1] "bool"  ACM
 SG_ FS_Camera_ID_1 : 240|4@1+ (1,0) [0|15] "ENUM"  ACM
 SG_ FS_CRC_1 : 208|32@1+ (1,0) [0|4294967295] "NA"  ACM
 SG_ FS_C2C_Out_Of_Calib_0 : 205|3@1+ (1,0) [0|5] "ENUM"  ACM
 SG_ FS_Out_Of_Focus_0 : 202|3@1+ (1,0) [0|5] "ENUM"  ACM
 SG_ FS_Full_Blockage_0 : 196|3@1+ (1,0) [0|5] "ENUM"  ACM
 SG_ FS_Partial_Blockage_0 : 193|3@1+ (1,0) [0|5] "ENUM"  ACM
 SG_ FS_Blur_Image_0 : 190|3@1+ (1,0) [0|5] "ENUM"  ACM
 SG_ FS_Low_Sun_0 : 187|3@1+ (1,0) [0|5] "ENUM"  ACM
 SG_ FS_Sun_Ray_0 : 184|3@1+ (1,0) [0|5] "ENUM"  ACM
 SG_ FS_Splashes_0 : 181|3@1+ (1,0) [0|5] "ENUM"  ACM
 SG_ FS_Free_Sight_0 : 180|1@1+ (1,0) [0|1] "bool"  ACM
 SG_ FS_Camera_ID_0 : 176|4@1+ (1,0) [0|15] "ENUM"  ACM
 SG_ FS_CRC_0 : 144|32@1+ (1,0) [0|4294967295] "NA"  ACM
 SG_ FS_Header_Buffer : 137|7@1+ (1,0) [0|127] "NA"  ACM
 SG_ FS_Out_Of_Calib : 108|3@1+ (1,0) [0|5] "ENUM"  ACM
 SG_ FS_Calibration_Misalignment : 134|3@1+ (1,0) [0|5] "ENUM"  ACM
 SG_ FS_Frozen_Windshield_0 : 199|3@1+ (1,0) [0|5] "ENUM"  ACM
 SG_ FS_Fog : 131|3@1+ (1,0) [0|5] "ENUM"  ACM
 SG_ FS_Rain : 128|3@1+ (1,0) [0|5] "ENUM"  ACM
 SG_ FS_Impacted_Technologies : 112|16@1+ (1,0) [0|65535] "BITWIZE"  ACM
 SG_ FS_Cameras_Number : 96|4@1+ (1,0) [0|15] "counter"  ACM
 SG_ FS_Sync_ID : 88|8@1+ (1,0) [0|255] "counter"  ACM
 SG_ FS_Protocol_Version : 80|8@1+ (1,0) [4|4] "NA"  ACM
 SG_ FS_Header_CRC : 48|32@1+ (1,0) [0|4294967295] "NA"  ACM
 SG_ FS_Zero_byte : 16|8@1+ (1,0) [0|255] "NA"  ACM

BO_ 79 ICM_Lanes_Host_Prot_B_2: 64 MyECU
 SG_ LH_Buffer_1 : 174|2@1- (1,0) [0|0] ""  ACM
 SG_ ICM_La_Host_Prot_B_2_CRC : 176|16@1+ (1,0) [0|65535] ""  ACM
 SG_ ICM_La_Host_Prot_B_2_Header : 0|16@1+ (1,0) [0|65535] ""  ACM
 SG_ LH_Line_Second_C0_1 : 16|32@1- (0.0001,0) [-30|30] "m"  ACM
 SG_ LH_Line_Second_C1_1 : 48|32@1- (1E-006,0) [-2|2] "rad"  ACM
 SG_ LH_Line_Second_C2_1 : 80|32@1- (1E-006,0) [-0.125|0.125] "INV(m)"  ACM
 SG_ LH_Line_Second_C3_1 : 112|32@1- (1E-009,0) [-0.004|0.004] "INV(m2)"  ACM
 SG_ LH_Second_VR_Start_1 : 144|15@1+ (0.01,0) [0|200] "m"  ACM
 SG_ LH_Second_VR_End_1 : 159|15@1+ (0.01,0) [0|200] "m"  ACM

BO_ 78 ICM_Lanes_Host_Prot_B_1: 64 MyECU
 SG_ LH_Is_Triggered_SDM_Model_1 : 50|2@1- (1,0) [0|0] ""  ACM
 SG_ LH_Is_Triggered_SDM_Type_1 : 48|2@1- (1,0) [0|0] ""  ACM
 SG_ ICM_La_Host_Prot_B_1_Header : 0|16@1+ (1,0) [0|65535] ""  ACM
 SG_ LH_CRC_1 : 16|32@1+ (1,0) [0|4294967295] "NA"  ACM
 SG_ LH_Track_ID_1 : 52|8@1+ (1,0) [0|255] "counter"  ACM
 SG_ LH_Age_1 : 60|8@1+ (1,0) [0|255] "frames"  ACM
 SG_ LH_Existence_Probability_1 : 68|7@1+ (0.01,0) [0|1] "NA"  ACM
 SG_ LH_Prediction_Source_1 : 80|6@1+ (1,0) [0|63] "BITWIZE"  ACM
 SG_ LH_Prediction_Type_1 : 86|2@1+ (1,0) [0|3] "BITWIZE"  ACM
 SG_ LH_Color_1 : 88|2@1+ (1,0) [0|3] "ENUM"  ACM
 SG_ LH_Color_Confidence_1 : 90|7@1+ (0.01,0) [0|1] "NA"  ACM
 SG_ LH_Lanemark_Type_1 : 97|4@1+ (1,0) [0|6] "ENUM"  ACM
 SG_ LH_DLM_Type_1 : 101|3@1+ (1,0) [0|5] "ENUM"  ACM
 SG_ LH_DECEL_Type_1 : 104|3@1+ (1,0) [0|5] "ENUM"  ACM
 SG_ LH_Lanemark_Type_Conf_1 : 112|7@1+ (0.01,0) [0|1] "NA"  ACM
 SG_ LH_Side_1 : 119|2@1+ (1,0) [0|2] "ENUM"  ACM
 SG_ LH_Crossing_1 : 121|1@1+ (1,0) [0|1] "bool"  ACM
 SG_ LH_Marker_Width_1 : 122|8@1+ (0.01,0) [0|0.7] "m"  ACM
 SG_ LH_Marker_Width_STD_1 : 130|7@1+ (0.005,0) [0|0.5] "m"  ACM
 SG_ LH_Dash_Average_Length_1 : 144|8@1+ (0.01,0) [0|2] "m"  ACM
 SG_ LH_Dash_Average_Gap_1 : 152|8@1+ (0.01,0) [0|2] "m"  ACM
 SG_ LH_Is_Multi_Clothoid_1 : 160|1@1+ (1,0) [0|1] "bool"  ACM
 SG_ LH_Line_First_C0_1 : 176|32@1- (0.0001,0) [-30|30] "m"  ACM
 SG_ LH_Line_First_C1_1 : 208|32@1- (1E-006,0) [-2|2] "rad"  ACM
 SG_ LH_Line_First_C2_1 : 240|32@1- (1E-006,0) [-0.125|0.125] "INV(m)"  ACM
 SG_ LH_Line_First_C3_1 : 272|32@1- (1E-009,0) [-0.004|0.004] "INV(m2)"  ACM
 SG_ LH_First_VR_Start_1 : 304|15@1+ (0.01,0) [0|200] "m"  ACM
 SG_ LH_First_VR_End_1 : 319|15@1+ (0.01,0) [0|200] "m"  ACM
 SG_ LH_First_Measured_VR_End_1 : 336|15@1+ (0.01,0) [0|200] "m"  ACM
 SG_ LH_Second_Measured_VR_End_1 : 351|15@1+ (0.01,0) [0|200] "m"  ACM

BO_ 77 ICM_Lanes_Host_Prot_A_2: 64 MyECU
 SG_ LH_Buffer_0 : 174|2@1- (1,0) [0|0] ""  ACM
 SG_ ICM_La_Host_Prot_A_2_Header : 0|16@1+ (1,0) [0|65535] ""  ACM
 SG_ LH_Line_Second_C0_0 : 16|32@1- (0.0001,0) [-30|30] "m"  ACM
 SG_ LH_Line_Second_C1_0 : 48|32@1- (1E-006,0) [-2|2] "rad"  ACM
 SG_ LH_Line_Second_C2_0 : 80|32@1- (1E-006,0) [-0.125|0.125] "INV(m)"  ACM
 SG_ LH_Line_Second_C3_0 : 112|32@1- (1E-009,0) [-0.004|0.004] "INV(m2)"  ACM
 SG_ LH_Second_VR_Start_0 : 144|15@1+ (0.01,0) [0|200] "m"  ACM
 SG_ LH_Second_VR_End_0 : 159|15@1+ (0.01,0) [0|200] "m"  ACM

BO_ 76 ICM_Lanes_Host_Prot_A_1: 64 MyECU
 SG_ LH_Is_Triggered_SDM_Model_0 : 50|2@1- (1,0) [0|0] ""  ACM
 SG_ LH_Is_Triggered_SDM_Type_0 : 48|2@1- (1,0) [0|0] ""  ACM
 SG_ ICM_La_Host_Prot_A_1_Header : 0|16@1+ (1,0) [0|65535] ""  ACM
 SG_ LH_CRC_0 : 16|32@1+ (1,0) [0|4294967295] "NA"  ACM
 SG_ LH_Track_ID_0 : 52|8@1+ (1,0) [0|255] "counter"  ACM
 SG_ LH_Age_0 : 60|8@1+ (1,0) [0|255] "frames"  ACM
 SG_ LH_Existence_Probability_0 : 68|7@1+ (0.01,0) [0|1] "NA"  ACM
 SG_ LH_Prediction_Source_0 : 80|6@1+ (1,0) [0|63] "BITWIZE"  ACM
 SG_ LH_Prediction_Type_0 : 86|2@1+ (1,0) [0|3] "BITWIZE"  ACM
 SG_ LH_Color_0 : 88|2@1+ (1,0) [0|3] "ENUM"  ACM
 SG_ LH_Color_Confidence_0 : 90|7@1+ (0.01,0) [0|1] "NA"  ACM
 SG_ LH_Lanemark_Type_0 : 97|4@1+ (1,0) [0|6] "ENUM"  ACM
 SG_ LH_DLM_Type_0 : 101|3@1+ (1,0) [0|5] "ENUM"  ACM
 SG_ LH_DECEL_Type_0 : 104|3@1+ (1,0) [0|5] "ENUM"  ACM
 SG_ LH_Lanemark_Type_Conf_0 : 112|7@1+ (0.01,0) [0|1] "NA"  ACM
 SG_ LH_Side_0 : 119|2@1+ (1,0) [0|2] "ENUM"  ACM
 SG_ LH_Crossing_0 : 121|1@1+ (1,0) [0|1] "bool"  ACM
 SG_ LH_Marker_Width_0 : 122|8@1+ (0.01,0) [0|0.7] "m"  ACM
 SG_ LH_Marker_Width_STD_0 : 130|7@1+ (0.005,0) [0|0.5] "m"  ACM
 SG_ LH_Dash_Average_Length_0 : 144|8@1+ (0.01,0) [0|2] "m"  ACM
 SG_ LH_Dash_Average_Gap_0 : 152|8@1+ (0.01,0) [0|2] "m"  ACM
 SG_ LH_Is_Multi_Clothoid_0 : 160|1@1+ (1,0) [0|1] "bool"  ACM
 SG_ LH_Line_First_C0_0 : 176|32@1- (0.0001,0) [-30|30] "m"  ACM
 SG_ LH_Line_First_C1_0 : 208|32@1- (1E-006,0) [-2|2] "rad"  ACM
 SG_ LH_Line_First_C2_0 : 240|32@1- (1E-006,0) [-0.125|0.125] "INV(m)"  ACM
 SG_ LH_Line_First_C3_0 : 272|32@1- (1E-009,0) [-0.004|0.004] "INV(m2)"  ACM
 SG_ LH_First_VR_Start_0 : 304|15@1+ (0.01,0) [0|200] "m"  ACM
 SG_ LH_First_VR_End_0 : 319|15@1+ (0.01,0) [0|200] "m"  ACM
 SG_ LH_First_Measured_VR_End_0 : 336|15@1+ (0.01,0) [0|200] "m"  ACM
 SG_ LH_Second_Measured_VR_End_0 : 351|15@1+ (0.01,0) [0|200] "m"  ACM

BO_ 131 ICM_Traffic_Signs19: 64 MyECU
 SG_ ICM_Traffic_Signs19_CRC : 272|16@1+ (1,0) [0|65535] ""  ACM
 SG_ ICM_Traffic_Signs19_Header : 0|16@1+ (1,0) [0|65535] ""  ACM
 SG_ TSR_ID_19 : 16|8@1+ (1,0) [0|255] "counter"  ACM
 SG_ TSR_Camera_Source_19 : 24|8@1+ (1,0) [0|255] "ENUM"  ACM
 SG_ TSR_Sign_Name_19 : 32|10@1+ (1,0) [0|1023] "NA"  ACM
 SG_ TSR_Relevancy_19 : 42|5@1+ (1,0) [0|13] "ENUM"  ACM
 SG_ TSR_Filter_Type_19 : 48|4@1+ (1,0) [0|7] "ENUM"  ACM
 SG_ TSR_Sup1_SignName_19 : 52|8@1+ (1,0) [0|255] "NA"  ACM
 SG_ TSR_Sup1_Confidence_19 : 60|7@1+ (0.01,0) [0|1] "NA"  ACM
 SG_ TSR_Sup2_SignName_19 : 67|8@1+ (1,0) [0|255] "NA"  ACM
 SG_ TSR_Sup2_Confidence_19 : 80|7@1+ (0.01,0) [0|1] "NA"  ACM
 SG_ TSR_Confidence_19 : 87|7@1+ (0.01,0) [0|1] "NA"  ACM
 SG_ TSR_Sign_Shape_19 : 94|4@1+ (1,0) [0|8] "ENUM"  ACM
 SG_ TSR_Sign_Structure_19 : 98|3@1+ (1,0) [0|3] "ENUM"  ACM
 SG_ TSR_Tracking_Age_19 : 101|10@1+ (1,0) [0|1000] "counter"  ACM
 SG_ TSR_Sign_Long_Distance_19 : 112|15@1+ (0.01,0) [0|200] "m"  ACM
 SG_ TSR_Sign_Long_Distance_STD_19 : 127|15@1+ (0.01,0) [0|200] "m"  ACM
 SG_ TSR_Sign_Lateral_Distance_19 : 144|13@1+ (0.01,-32) [-32|31] "m"  ACM
 SG_ TSR_Sign_Lat_Distance_STD_19 : 157|13@1+ (0.01,-32) [-32|31] "m"  ACM
 SG_ TSR_Sign_Height_19 : 176|15@1+ (0.01,-15) [-15|15] "m"  ACM
 SG_ TSR_Sign_Panel_Height_STD_19 : 191|10@1+ (0.01,0) [0|8] "m"  ACM
 SG_ TSR_Sign_Height_STD_19 : 208|15@1+ (0.01,-15) [-15|15] "m"  ACM
 SG_ TSR_Sign_Panel_Width_19 : 223|10@1+ (0.01,0) [0|8] "m"  ACM
 SG_ TSR_Sign_Panel_Height_19 : 240|10@1+ (0.01,0) [0|8] "m"  ACM
 SG_ TSR_Sign_Panel_Width_STD_19 : 250|10@1+ (0.01,0) [0|8] "m"  ACM
 SG_ TSR_Buffer_19 : 260|12@1+ (1,0) [0|4095] "NA"  ACM

BO_ 130 ICM_Traffic_Signs18: 64 MyECU
 SG_ ICM_Traffic_Signs18_Header : 0|16@1+ (1,0) [0|65535] ""  ACM
 SG_ TSR_ID_18 : 16|8@1+ (1,0) [0|255] "counter"  ACM
 SG_ TSR_Camera_Source_18 : 24|8@1+ (1,0) [0|255] "ENUM"  ACM
 SG_ TSR_Sign_Name_18 : 32|10@1+ (1,0) [0|1023] "NA"  ACM
 SG_ TSR_Relevancy_18 : 42|5@1+ (1,0) [0|13] "ENUM"  ACM
 SG_ TSR_Filter_Type_18 : 48|4@1+ (1,0) [0|7] "ENUM"  ACM
 SG_ TSR_Sup1_SignName_18 : 52|8@1+ (1,0) [0|255] "NA"  ACM
 SG_ TSR_Sup1_Confidence_18 : 60|7@1+ (0.01,0) [0|1] "NA"  ACM
 SG_ TSR_Sup2_SignName_18 : 67|8@1+ (1,0) [0|255] "NA"  ACM
 SG_ TSR_Sup2_Confidence_18 : 80|7@1+ (0.01,0) [0|1] "NA"  ACM
 SG_ TSR_Confidence_18 : 87|7@1+ (0.01,0) [0|1] "NA"  ACM
 SG_ TSR_Sign_Shape_18 : 94|4@1+ (1,0) [0|8] "ENUM"  ACM
 SG_ TSR_Sign_Structure_18 : 98|3@1+ (1,0) [0|3] "ENUM"  ACM
 SG_ TSR_Tracking_Age_18 : 101|10@1+ (1,0) [0|1000] "counter"  ACM
 SG_ TSR_Sign_Long_Distance_18 : 112|15@1+ (0.01,0) [0|200] "m"  ACM
 SG_ TSR_Sign_Long_Distance_STD_18 : 127|15@1+ (0.01,0) [0|200] "m"  ACM
 SG_ TSR_Sign_Lateral_Distance_18 : 144|13@1+ (0.01,-32) [-32|31] "m"  ACM
 SG_ TSR_Sign_Lat_Distance_STD_18 : 157|13@1+ (0.01,-32) [-32|31] "m"  ACM
 SG_ TSR_Sign_Height_18 : 176|15@1+ (0.01,-15) [-15|15] "m"  ACM
 SG_ TSR_Sign_Panel_Height_STD_18 : 191|10@1+ (0.01,0) [0|8] "m"  ACM
 SG_ TSR_Sign_Height_STD_18 : 208|15@1+ (0.01,-15) [-15|15] "m"  ACM
 SG_ TSR_Sign_Panel_Width_18 : 223|10@1+ (0.01,0) [0|8] "m"  ACM
 SG_ TSR_Sign_Panel_Height_18 : 240|10@1+ (0.01,0) [0|8] "m"  ACM
 SG_ TSR_Sign_Panel_Width_STD_18 : 250|10@1+ (0.01,0) [0|8] "m"  ACM
 SG_ TSR_Buffer_18 : 262|12@1+ (1,0) [0|4095] "NA"  ACM

BO_ 129 ICM_Traffic_Signs17: 64 MyECU
 SG_ ICM_Traffic_Signs17_Header : 0|16@1+ (1,0) [0|65535] ""  ACM
 SG_ TSR_ID_17 : 16|8@1+ (1,0) [0|255] "counter"  ACM
 SG_ TSR_Camera_Source_17 : 24|8@1+ (1,0) [0|255] "ENUM"  ACM
 SG_ TSR_Sign_Name_17 : 32|10@1+ (1,0) [0|1023] "NA"  ACM
 SG_ TSR_Relevancy_17 : 42|5@1+ (1,0) [0|13] "ENUM"  ACM
 SG_ TSR_Filter_Type_17 : 48|4@1+ (1,0) [0|7] "ENUM"  ACM
 SG_ TSR_Sup1_SignName_17 : 52|8@1+ (1,0) [0|255] "NA"  ACM
 SG_ TSR_Sup1_Confidence_17 : 60|7@1+ (0.01,0) [0|1] "NA"  ACM
 SG_ TSR_Sup2_SignName_17 : 67|8@1+ (1,0) [0|255] "NA"  ACM
 SG_ TSR_Sup2_Confidence_17 : 80|7@1+ (0.01,0) [0|1] "NA"  ACM
 SG_ TSR_Confidence_17 : 87|7@1+ (0.01,0) [0|1] "NA"  ACM
 SG_ TSR_Sign_Shape_17 : 94|4@1+ (1,0) [0|8] "ENUM"  ACM
 SG_ TSR_Sign_Structure_17 : 98|3@1+ (1,0) [0|3] "ENUM"  ACM
 SG_ TSR_Tracking_Age_17 : 101|10@1+ (1,0) [0|1000] "counter"  ACM
 SG_ TSR_Sign_Long_Distance_17 : 112|15@1+ (0.01,0) [0|200] "m"  ACM
 SG_ TSR_Sign_Long_Distance_STD_17 : 127|15@1+ (0.01,0) [0|200] "m"  ACM
 SG_ TSR_Sign_Lateral_Distance_17 : 144|13@1+ (0.01,-32) [-32|31] "m"  ACM
 SG_ TSR_Sign_Lat_Distance_STD_17 : 157|13@1+ (0.01,-32) [-32|31] "m"  ACM
 SG_ TSR_Sign_Height_17 : 176|15@1+ (0.01,-15) [-15|15] "m"  ACM
 SG_ TSR_Sign_Panel_Height_STD_17 : 191|10@1+ (0.01,0) [0|8] "m"  ACM
 SG_ TSR_Sign_Height_STD_17 : 208|15@1+ (0.01,-15) [-15|15] "m"  ACM
 SG_ TSR_Sign_Panel_Width_17 : 223|10@1+ (0.01,0) [0|8] "m"  ACM
 SG_ TSR_Sign_Panel_Height_17 : 240|10@1+ (0.01,0) [0|8] "m"  ACM
 SG_ TSR_Sign_Panel_Width_STD_17 : 250|10@1+ (0.01,0) [0|8] "m"  ACM
 SG_ TSR_Buffer_17 : 260|12@1+ (1,0) [0|4095] "NA"  ACM

BO_ 128 ICM_Traffic_Signs16: 64 MyECU
 SG_ ICM_Traffic_Signs16_Header : 0|16@1+ (1,0) [0|65535] ""  ACM
 SG_ TSR_ID_16 : 16|8@1+ (1,0) [0|255] "counter"  ACM
 SG_ TSR_Camera_Source_16 : 24|8@1+ (1,0) [0|255] "ENUM"  ACM
 SG_ TSR_Sign_Name_16 : 32|10@1+ (1,0) [0|1023] "NA"  ACM
 SG_ TSR_Relevancy_16 : 42|5@1+ (1,0) [0|13] "ENUM"  ACM
 SG_ TSR_Filter_Type_16 : 48|4@1+ (1,0) [0|7] "ENUM"  ACM
 SG_ TSR_Sup1_SignName_16 : 52|8@1+ (1,0) [0|255] "NA"  ACM
 SG_ TSR_Sup1_Confidence_16 : 60|7@1+ (0.01,0) [0|1] "NA"  ACM
 SG_ TSR_Sup2_SignName_16 : 67|8@1+ (1,0) [0|255] "NA"  ACM
 SG_ TSR_Sup2_Confidence_16 : 80|7@1+ (0.01,0) [0|1] "NA"  ACM
 SG_ TSR_Confidence_16 : 87|7@1+ (0.01,0) [0|1] "NA"  ACM
 SG_ TSR_Sign_Shape_16 : 94|4@1+ (1,0) [0|8] "ENUM"  ACM
 SG_ TSR_Sign_Structure_16 : 98|3@1+ (1,0) [0|3] "ENUM"  ACM
 SG_ TSR_Tracking_Age_16 : 101|10@1+ (1,0) [0|1000] "counter"  ACM
 SG_ TSR_Sign_Long_Distance_16 : 112|15@1+ (0.01,0) [0|200] "m"  ACM
 SG_ TSR_Sign_Long_Distance_STD_16 : 127|15@1+ (0.01,0) [0|200] "m"  ACM
 SG_ TSR_Sign_Lateral_Distance_16 : 144|13@1+ (0.01,-32) [-32|31] "m"  ACM
 SG_ TSR_Sign_Lat_Distance_STD_16 : 157|13@1+ (0.01,-32) [-32|31] "m"  ACM
 SG_ TSR_Sign_Height_16 : 176|15@1+ (0.01,-15) [-15|15] "m"  ACM
 SG_ TSR_Sign_Panel_Height_STD_16 : 191|10@1+ (0.01,0) [0|8] "m"  ACM
 SG_ TSR_Sign_Height_STD_16 : 208|15@1+ (0.01,-15) [-15|15] "m"  ACM
 SG_ TSR_Sign_Panel_Width_16 : 223|10@1+ (0.01,0) [0|8] "m"  ACM
 SG_ TSR_Sign_Panel_Height_16 : 240|10@1+ (0.01,0) [0|8] "m"  ACM
 SG_ TSR_Sign_Panel_Width_STD_16 : 250|10@1+ (0.01,0) [0|8] "m"  ACM
 SG_ TSR_Buffer_16 : 260|12@1+ (1,0) [0|4095] "NA"  ACM

BO_ 127 ICM_Traffic_Signs15: 64 MyECU
 SG_ ICM_Traffic_Signs15_Header : 0|16@1+ (1,0) [0|65535] ""  ACM
 SG_ TSR_ID_15 : 16|8@1+ (1,0) [0|255] "counter"  ACM
 SG_ TSR_Camera_Source_15 : 24|8@1+ (1,0) [0|255] "ENUM"  ACM
 SG_ TSR_Sign_Name_15 : 32|10@1+ (1,0) [0|1023] "NA"  ACM
 SG_ TSR_Relevancy_15 : 42|5@1+ (1,0) [0|13] "ENUM"  ACM
 SG_ TSR_Filter_Type_15 : 48|4@1+ (1,0) [0|7] "ENUM"  ACM
 SG_ TSR_Sup1_SignName_15 : 52|8@1+ (1,0) [0|255] "NA"  ACM
 SG_ TSR_Sup1_Confidence_15 : 60|7@1+ (0.01,0) [0|1] "NA"  ACM
 SG_ TSR_Sup2_SignName_15 : 67|8@1+ (1,0) [0|255] "NA"  ACM
 SG_ TSR_Sup2_Confidence_15 : 80|7@1+ (0.01,0) [0|1] "NA"  ACM
 SG_ TSR_Confidence_15 : 87|7@1+ (0.01,0) [0|1] "NA"  ACM
 SG_ TSR_Sign_Shape_15 : 94|4@1+ (1,0) [0|8] "ENUM"  ACM
 SG_ TSR_Sign_Structure_15 : 98|3@1+ (1,0) [0|3] "ENUM"  ACM
 SG_ TSR_Tracking_Age_15 : 101|10@1+ (1,0) [0|1000] "counter"  ACM
 SG_ TSR_Sign_Long_Distance_15 : 112|15@1+ (0.01,0) [0|200] "m"  ACM
 SG_ TSR_Sign_Long_Distance_STD_15 : 127|15@1+ (0.01,0) [0|200] "m"  ACM
 SG_ TSR_Sign_Lateral_Distance_15 : 144|13@1+ (0.01,-32) [-32|31] "m"  ACM
 SG_ TSR_Sign_Lat_Distance_STD_15 : 157|13@1+ (0.01,-32) [-32|31] "m"  ACM
 SG_ TSR_Sign_Height_15 : 176|15@1+ (0.01,-15) [-15|15] "m"  ACM
 SG_ TSR_Sign_Panel_Height_STD_15 : 191|10@1+ (0.01,0) [0|8] "m"  ACM
 SG_ TSR_Sign_Height_STD_15 : 208|15@1+ (0.01,-15) [-15|15] "m"  ACM
 SG_ TSR_Sign_Panel_Width_15 : 223|10@1+ (0.01,0) [0|8] "m"  ACM
 SG_ TSR_Sign_Panel_Height_15 : 240|10@1+ (0.01,0) [0|8] "m"  ACM
 SG_ TSR_Sign_Panel_Width_STD_15 : 250|10@1+ (0.01,0) [0|8] "m"  ACM
 SG_ TSR_Buffer_15 : 262|12@1+ (1,0) [0|4095] "NA"  ACM

BO_ 126 ICM_Traffic_Signs14: 64 MyECU
 SG_ ICM_Traffic_Signs14_Header : 0|16@1+ (1,0) [0|65535] ""  ACM
 SG_ TSR_ID_14 : 16|8@1+ (1,0) [0|255] "counter"  ACM
 SG_ TSR_Camera_Source_14 : 24|8@1+ (1,0) [0|255] "ENUM"  ACM
 SG_ TSR_Sign_Name_14 : 32|10@1+ (1,0) [0|1023] "NA"  ACM
 SG_ TSR_Relevancy_14 : 42|5@1+ (1,0) [0|13] "ENUM"  ACM
 SG_ TSR_Filter_Type_14 : 48|4@1+ (1,0) [0|7] "ENUM"  ACM
 SG_ TSR_Sup1_SignName_14 : 52|8@1+ (1,0) [0|255] "NA"  ACM
 SG_ TSR_Sup1_Confidence_14 : 60|7@1+ (0.01,0) [0|1] "NA"  ACM
 SG_ TSR_Sup2_SignName_14 : 67|8@1+ (1,0) [0|255] "NA"  ACM
 SG_ TSR_Sup2_Confidence_14 : 80|7@1+ (0.01,0) [0|1] "NA"  ACM
 SG_ TSR_Confidence_14 : 87|7@1+ (0.01,0) [0|1] "NA"  ACM
 SG_ TSR_Sign_Shape_14 : 94|4@1+ (1,0) [0|8] "ENUM"  ACM
 SG_ TSR_Sign_Structure_14 : 98|3@1+ (1,0) [0|3] "ENUM"  ACM
 SG_ TSR_Tracking_Age_14 : 101|10@1+ (1,0) [0|1000] "counter"  ACM
 SG_ TSR_Sign_Long_Distance_14 : 112|15@1+ (0.01,0) [0|200] "m"  ACM
 SG_ TSR_Sign_Long_Distance_STD_14 : 127|15@1+ (0.01,0) [0|200] "m"  ACM
 SG_ TSR_Sign_Lateral_Distance_14 : 144|13@1+ (0.01,-32) [-32|31] "m"  ACM
 SG_ TSR_Sign_Lat_Distance_STD_14 : 157|13@1+ (0.01,-32) [-32|31] "m"  ACM
 SG_ TSR_Sign_Height_14 : 176|15@1+ (0.01,-15) [-15|15] "m"  ACM
 SG_ TSR_Sign_Panel_Height_STD_14 : 191|10@1+ (0.01,0) [0|8] "m"  ACM
 SG_ TSR_Sign_Height_STD_14 : 208|15@1+ (0.01,-15) [-15|15] "m"  ACM
 SG_ TSR_Sign_Panel_Width_14 : 223|10@1+ (0.01,0) [0|8] "m"  ACM
 SG_ TSR_Sign_Panel_Height_14 : 240|10@1+ (0.01,0) [0|8] "m"  ACM
 SG_ TSR_Sign_Panel_Width_STD_14 : 250|10@1+ (0.01,0) [0|8] "m"  ACM
 SG_ TSR_Buffer_14 : 262|12@1+ (1,0) [0|4095] "NA"  ACM

BO_ 125 ICM_Traffic_Signs13: 64 MyECU
 SG_ ICM_Traffic_Signs13_Header : 0|16@1+ (1,0) [0|65535] ""  ACM
 SG_ TSR_ID_13 : 16|8@1+ (1,0) [0|255] "counter"  ACM
 SG_ TSR_Camera_Source_13 : 24|8@1+ (1,0) [0|255] "ENUM"  ACM
 SG_ TSR_Sign_Name_13 : 32|10@1+ (1,0) [0|1023] "NA"  ACM
 SG_ TSR_Relevancy_13 : 42|5@1+ (1,0) [0|13] "ENUM"  ACM
 SG_ TSR_Filter_Type_13 : 48|4@1+ (1,0) [0|7] "ENUM"  ACM
 SG_ TSR_Sup1_SignName_13 : 52|8@1+ (1,0) [0|255] "NA"  ACM
 SG_ TSR_Sup1_Confidence_13 : 60|7@1+ (0.01,0) [0|1] "NA"  ACM
 SG_ TSR_Sup2_SignName_13 : 67|8@1+ (1,0) [0|255] "NA"  ACM
 SG_ TSR_Sup2_Confidence_13 : 80|7@1+ (0.01,0) [0|1] "NA"  ACM
 SG_ TSR_Confidence_13 : 87|7@1+ (0.01,0) [0|1] "NA"  ACM
 SG_ TSR_Sign_Shape_13 : 94|4@1+ (1,0) [0|8] "ENUM"  ACM
 SG_ TSR_Sign_Structure_13 : 98|3@1+ (1,0) [0|3] "ENUM"  ACM
 SG_ TSR_Tracking_Age_13 : 101|10@1+ (1,0) [0|1000] "counter"  ACM
 SG_ TSR_Sign_Long_Distance_13 : 112|15@1+ (0.01,0) [0|200] "m"  ACM
 SG_ TSR_Sign_Long_Distance_STD_13 : 127|15@1+ (0.01,0) [0|200] "m"  ACM
 SG_ TSR_Sign_Lateral_Distance_13 : 144|13@1+ (0.01,-32) [-32|31] "m"  ACM
 SG_ TSR_Sign_Lat_Distance_STD_13 : 157|13@1+ (0.01,-32) [-32|31] "m"  ACM
 SG_ TSR_Sign_Height_13 : 176|15@1+ (0.01,-15) [-15|15] "m"  ACM
 SG_ TSR_Sign_Panel_Height_STD_13 : 191|10@1+ (0.01,0) [0|8] "m"  ACM
 SG_ TSR_Sign_Height_STD_13 : 208|15@1+ (0.01,-15) [-15|15] "m"  ACM
 SG_ TSR_Sign_Panel_Width_13 : 223|10@1+ (0.01,0) [0|8] "m"  ACM
 SG_ TSR_Sign_Panel_Height_13 : 240|10@1+ (0.01,0) [0|8] "m"  ACM
 SG_ TSR_Sign_Panel_Width_STD_13 : 250|10@1+ (0.01,0) [0|8] "m"  ACM
 SG_ TSR_Buffer_13 : 262|12@1+ (1,0) [0|4095] "NA"  ACM

BO_ 124 ICM_Traffic_Signs12: 64 MyECU
 SG_ ICM_Traffic_Signs12_Header : 0|16@1+ (1,0) [0|65535] ""  ACM
 SG_ TSR_ID_12 : 16|8@1+ (1,0) [0|255] "counter"  ACM
 SG_ TSR_Camera_Source_12 : 24|8@1+ (1,0) [0|255] "ENUM"  ACM
 SG_ TSR_Sign_Name_12 : 32|10@1+ (1,0) [0|1023] "NA"  ACM
 SG_ TSR_Relevancy_12 : 42|5@1+ (1,0) [0|13] "ENUM"  ACM
 SG_ TSR_Filter_Type_12 : 48|4@1+ (1,0) [0|7] "ENUM"  ACM
 SG_ TSR_Sup1_SignName_12 : 52|8@1+ (1,0) [0|255] "NA"  ACM
 SG_ TSR_Sup1_Confidence_12 : 60|7@1+ (0.01,0) [0|1] "NA"  ACM
 SG_ TSR_Sup2_SignName_12 : 67|8@1+ (1,0) [0|255] "NA"  ACM
 SG_ TSR_Sup2_Confidence_12 : 80|7@1+ (0.01,0) [0|1] "NA"  ACM
 SG_ TSR_Confidence_12 : 87|7@1+ (0.01,0) [0|1] "NA"  ACM
 SG_ TSR_Sign_Shape_12 : 94|4@1+ (1,0) [0|8] "ENUM"  ACM
 SG_ TSR_Sign_Structure_12 : 98|3@1+ (1,0) [0|3] "ENUM"  ACM
 SG_ TSR_Tracking_Age_12 : 101|10@1+ (1,0) [0|1000] "counter"  ACM
 SG_ TSR_Sign_Long_Distance_12 : 112|15@1+ (0.01,0) [0|200] "m"  ACM
 SG_ TSR_Sign_Long_Distance_STD_12 : 127|15@1+ (0.01,0) [0|200] "m"  ACM
 SG_ TSR_Sign_Lateral_Distance_12 : 144|13@1+ (0.01,-32) [-32|31] "m"  ACM
 SG_ TSR_Sign_Lat_Distance_STD_12 : 157|13@1+ (0.01,-32) [-32|31] "m"  ACM
 SG_ TSR_Sign_Height_12 : 176|15@1+ (0.01,-15) [-15|15] "m"  ACM
 SG_ TSR_Sign_Panel_Height_STD_12 : 191|10@1+ (0.01,0) [0|8] "m"  ACM
 SG_ TSR_Sign_Height_STD_12 : 208|15@1+ (0.01,-15) [-15|15] "m"  ACM
 SG_ TSR_Sign_Panel_Width_12 : 223|10@1+ (0.01,0) [0|8] "m"  ACM
 SG_ TSR_Sign_Panel_Height_12 : 240|10@1+ (0.01,0) [0|8] "m"  ACM
 SG_ TSR_Sign_Panel_Width_STD_12 : 250|10@1+ (0.01,0) [0|8] "m"  ACM
 SG_ TSR_Buffer_12 : 260|12@1+ (1,0) [0|4095] "NA"  ACM

BO_ 123 ICM_Traffic_Signs11: 64 MyECU
 SG_ ICM_Traffic_Signs11_Header : 0|16@1+ (1,0) [0|65535] ""  ACM
 SG_ TSR_ID_11 : 16|8@1+ (1,0) [0|255] "counter"  ACM
 SG_ TSR_Camera_Source_11 : 24|8@1+ (1,0) [0|255] "ENUM"  ACM
 SG_ TSR_Sign_Name_11 : 32|10@1+ (1,0) [0|1023] "NA"  ACM
 SG_ TSR_Relevancy_11 : 42|5@1+ (1,0) [0|13] "ENUM"  ACM
 SG_ TSR_Filter_Type_11 : 48|4@1+ (1,0) [0|7] "ENUM"  ACM
 SG_ TSR_Sup1_SignName_11 : 52|8@1+ (1,0) [0|255] "NA"  ACM
 SG_ TSR_Sup1_Confidence_11 : 60|7@1+ (0.01,0) [0|1] "NA"  ACM
 SG_ TSR_Sup2_SignName_11 : 67|8@1+ (1,0) [0|255] "NA"  ACM
 SG_ TSR_Sup2_Confidence_11 : 80|7@1+ (0.01,0) [0|1] "NA"  ACM
 SG_ TSR_Confidence_11 : 87|7@1+ (0.01,0) [0|1] "NA"  ACM
 SG_ TSR_Sign_Shape_11 : 94|4@1+ (1,0) [0|8] "ENUM"  ACM
 SG_ TSR_Sign_Structure_11 : 98|3@1+ (1,0) [0|3] "ENUM"  ACM
 SG_ TSR_Tracking_Age_11 : 101|10@1+ (1,0) [0|1000] "counter"  ACM
 SG_ TSR_Sign_Long_Distance_11 : 112|15@1+ (0.01,0) [0|200] "m"  ACM
 SG_ TSR_Sign_Long_Distance_STD_11 : 127|15@1+ (0.01,0) [0|200] "m"  ACM
 SG_ TSR_Sign_Lateral_Distance_11 : 144|13@1+ (0.01,-32) [-32|31] "m"  ACM
 SG_ TSR_Sign_Lat_Distance_STD_11 : 157|13@1+ (0.01,-32) [-32|31] "m"  ACM
 SG_ TSR_Sign_Height_11 : 176|15@1+ (0.01,-15) [-15|15] "m"  ACM
 SG_ TSR_Sign_Panel_Height_STD_11 : 191|10@1+ (0.01,0) [0|8] "m"  ACM
 SG_ TSR_Sign_Height_STD_11 : 208|15@1+ (0.01,-15) [-15|15] "m"  ACM
 SG_ TSR_Sign_Panel_Width_11 : 223|10@1+ (0.01,0) [0|8] "m"  ACM
 SG_ TSR_Sign_Panel_Height_11 : 240|10@1+ (0.01,0) [0|8] "m"  ACM
 SG_ TSR_Sign_Panel_Width_STD_11 : 250|10@1+ (0.01,0) [0|8] "m"  ACM
 SG_ TSR_Buffer_11 : 260|12@1+ (1,0) [0|4095] "NA"  ACM

BO_ 122 ICM_Traffic_Signs10: 64 MyECU
 SG_ ICM_Traffic_Signs10_Header : 0|16@1+ (1,0) [0|65535] ""  ACM
 SG_ TSR_ID_10 : 16|8@1+ (1,0) [0|255] "counter"  ACM
 SG_ TSR_Camera_Source_10 : 24|8@1+ (1,0) [0|255] "ENUM"  ACM
 SG_ TSR_Sign_Name_10 : 32|10@1+ (1,0) [0|1023] "NA"  ACM
 SG_ TSR_Relevancy_10 : 42|5@1+ (1,0) [0|13] "ENUM"  ACM
 SG_ TSR_Filter_Type_10 : 48|4@1+ (1,0) [0|7] "ENUM"  ACM
 SG_ TSR_Sup1_SignName_10 : 52|8@1+ (1,0) [0|255] "NA"  ACM
 SG_ TSR_Sup1_Confidence_10 : 60|7@1+ (0.01,0) [0|1] "NA"  ACM
 SG_ TSR_Sup2_SignName_10 : 67|8@1+ (1,0) [0|255] "NA"  ACM
 SG_ TSR_Sup2_Confidence_10 : 80|7@1+ (0.01,0) [0|1] "NA"  ACM
 SG_ TSR_Confidence_10 : 87|7@1+ (0.01,0) [0|1] "NA"  ACM
 SG_ TSR_Sign_Shape_10 : 94|4@1+ (1,0) [0|8] "ENUM"  ACM
 SG_ TSR_Sign_Structure_10 : 98|3@1+ (1,0) [0|3] "ENUM"  ACM
 SG_ TSR_Tracking_Age_10 : 101|10@1+ (1,0) [0|1000] "counter"  ACM
 SG_ TSR_Sign_Long_Distance_10 : 112|15@1+ (0.01,0) [0|200] "m"  ACM
 SG_ TSR_Sign_Long_Distance_STD_10 : 127|15@1+ (0.01,0) [0|200] "m"  ACM
 SG_ TSR_Sign_Lateral_Distance_10 : 144|13@1+ (0.01,-32) [-32|31] "m"  ACM
 SG_ TSR_Sign_Lat_Distance_STD_10 : 157|13@1+ (0.01,-32) [-32|31] "m"  ACM
 SG_ TSR_Sign_Height_10 : 176|15@1+ (0.01,-15) [-15|15] "m"  ACM
 SG_ TSR_Sign_Panel_Height_STD_10 : 191|10@1+ (0.01,0) [0|8] "m"  ACM
 SG_ TSR_Sign_Height_STD_10 : 208|15@1+ (0.01,-15) [-15|15] "m"  ACM
 SG_ TSR_Sign_Panel_Width_10 : 223|10@1+ (0.01,0) [0|8] "m"  ACM
 SG_ TSR_Sign_Panel_Height_10 : 240|10@1+ (0.01,0) [0|8] "m"  ACM
 SG_ TSR_Sign_Panel_Width_STD_10 : 250|10@1+ (0.01,0) [0|8] "m"  ACM
 SG_ TSR_Buffer_10 : 260|12@1+ (1,0) [0|4095] "NA"  ACM

BO_ 121 ICM_Traffic_Signs9: 64 MyECU
 SG_ ICM_Traffic_Signs9_Header : 0|16@1+ (1,0) [0|65535] ""  ACM
 SG_ TSR_ID_9 : 16|8@1+ (1,0) [0|255] "counter"  ACM
 SG_ TSR_Camera_Source_9 : 24|8@1+ (1,0) [0|255] "ENUM"  ACM
 SG_ TSR_Sign_Name_9 : 32|10@1+ (1,0) [0|1023] "NA"  ACM
 SG_ TSR_Relevancy_9 : 42|5@1+ (1,0) [0|13] "ENUM"  ACM
 SG_ TSR_Filter_Type_9 : 48|4@1+ (1,0) [0|7] "ENUM"  ACM
 SG_ TSR_Sup1_SignName_9 : 52|8@1+ (1,0) [0|255] "NA"  ACM
 SG_ TSR_Sup1_Confidence_9 : 60|7@1+ (0.01,0) [0|1] "NA"  ACM
 SG_ TSR_Sup2_SignName_9 : 67|8@1+ (1,0) [0|255] "NA"  ACM
 SG_ TSR_Sup2_Confidence_9 : 80|7@1+ (0.01,0) [0|1] "NA"  ACM
 SG_ TSR_Confidence_9 : 87|7@1+ (0.01,0) [0|1] "NA"  ACM
 SG_ TSR_Sign_Shape_9 : 94|4@1+ (1,0) [0|8] "ENUM"  ACM
 SG_ TSR_Sign_Structure_9 : 98|3@1+ (1,0) [0|3] "ENUM"  ACM
 SG_ TSR_Tracking_Age_9 : 101|10@1+ (1,0) [0|1000] "counter"  ACM
 SG_ TSR_Sign_Long_Distance_9 : 112|15@1+ (0.01,0) [0|200] "m"  ACM
 SG_ TSR_Sign_Long_Distance_STD_9 : 127|15@1+ (0.01,0) [0|200] "m"  ACM
 SG_ TSR_Sign_Lateral_Distance_9 : 144|13@1+ (0.01,-32) [-32|31] "m"  ACM
 SG_ TSR_Sign_Lat_Distance_STD_9 : 157|13@1+ (0.01,-32) [-32|31] "m"  ACM
 SG_ TSR_Sign_Height_9 : 176|15@1+ (0.01,-15) [-15|15] "m"  ACM
 SG_ TSR_Sign_Panel_Height_STD_9 : 191|10@1+ (0.01,0) [0|8] "m"  ACM
 SG_ TSR_Sign_Height_STD_9 : 208|15@1+ (0.01,-15) [-15|15] "m"  ACM
 SG_ TSR_Sign_Panel_Width_9 : 223|10@1+ (0.01,0) [0|8] "m"  ACM
 SG_ TSR_Sign_Panel_Height_9 : 240|10@1+ (0.01,0) [0|8] "m"  ACM
 SG_ TSR_Sign_Panel_Width_STD_9 : 250|10@1+ (0.01,0) [0|8] "m"  ACM
 SG_ TSR_Buffer_9 : 260|12@1+ (1,0) [0|4095] "NA"  ACM

BO_ 120 ICM_Traffic_Signs8: 64 MyECU
 SG_ ICM_Traffic_Signs8_Header : 0|16@1+ (1,0) [0|65535] ""  ACM
 SG_ TSR_ID_8 : 16|8@1+ (1,0) [0|255] "counter"  ACM
 SG_ TSR_Camera_Source_8 : 24|8@1+ (1,0) [0|255] "ENUM"  ACM
 SG_ TSR_Sign_Name_8 : 32|10@1+ (1,0) [0|1023] "NA"  ACM
 SG_ TSR_Relevancy_8 : 42|5@1+ (1,0) [0|13] "ENUM"  ACM
 SG_ TSR_Filter_Type_8 : 48|4@1+ (1,0) [0|7] "ENUM"  ACM
 SG_ TSR_Sup1_SignName_8 : 52|8@1+ (1,0) [0|255] "NA"  ACM
 SG_ TSR_Sup1_Confidence_8 : 60|7@1+ (0.01,0) [0|1] "NA"  ACM
 SG_ TSR_Sup2_SignName_8 : 67|8@1+ (1,0) [0|255] "NA"  ACM
 SG_ TSR_Sup2_Confidence_8 : 80|7@1+ (0.01,0) [0|1] "NA"  ACM
 SG_ TSR_Confidence_8 : 87|7@1+ (0.01,0) [0|1] "NA"  ACM
 SG_ TSR_Sign_Shape_8 : 94|4@1+ (1,0) [0|8] "ENUM"  ACM
 SG_ TSR_Sign_Structure_8 : 98|3@1+ (1,0) [0|3] "ENUM"  ACM
 SG_ TSR_Tracking_Age_8 : 101|10@1+ (1,0) [0|1000] "counter"  ACM
 SG_ TSR_Sign_Long_Distance_8 : 112|15@1+ (0.01,0) [0|200] "m"  ACM
 SG_ TSR_Sign_Long_Distance_STD_8 : 127|15@1+ (0.01,0) [0|200] "m"  ACM
 SG_ TSR_Sign_Lateral_Distance_8 : 144|13@1+ (0.01,-32) [-32|31] "m"  ACM
 SG_ TSR_Sign_Lat_Distance_STD_8 : 157|13@1+ (0.01,-32) [-32|31] "m"  ACM
 SG_ TSR_Sign_Height_8 : 176|15@1+ (0.01,-15) [-15|15] "m"  ACM
 SG_ TSR_Sign_Panel_Height_STD_8 : 191|10@1+ (0.01,0) [0|8] "m"  ACM
 SG_ TSR_Sign_Height_STD_8 : 208|15@1+ (0.01,-15) [-15|15] "m"  ACM
 SG_ TSR_Sign_Panel_Width_8 : 223|10@1+ (0.01,0) [0|8] "m"  ACM
 SG_ TSR_Sign_Panel_Height_8 : 240|10@1+ (0.01,0) [0|8] "m"  ACM
 SG_ TSR_Sign_Panel_Width_STD_8 : 250|10@1+ (0.01,0) [0|8] "m"  ACM
 SG_ TSR_Buffer_8 : 260|12@1+ (1,0) [0|4095] "NA"  ACM

BO_ 119 ICM_Traffic_Signs7: 64 MyECU
 SG_ ICM_Traffic_Signs7_Header : 0|16@1+ (1,0) [0|65535] ""  ACM
 SG_ TSR_ID_7 : 16|8@1+ (1,0) [0|255] "counter"  ACM
 SG_ TSR_Camera_Source_7 : 24|8@1+ (1,0) [0|255] "ENUM"  ACM
 SG_ TSR_Sign_Name_7 : 32|10@1+ (1,0) [0|1023] "NA"  ACM
 SG_ TSR_Relevancy_7 : 42|5@1+ (1,0) [0|13] "ENUM"  ACM
 SG_ TSR_Filter_Type_7 : 48|4@1+ (1,0) [0|7] "ENUM"  ACM
 SG_ TSR_Sup1_SignName_7 : 52|8@1+ (1,0) [0|255] "NA"  ACM
 SG_ TSR_Sup1_Confidence_7 : 60|7@1+ (0.01,0) [0|1] "NA"  ACM
 SG_ TSR_Sup2_SignName_7 : 67|8@1+ (1,0) [0|255] "NA"  ACM
 SG_ TSR_Sup2_Confidence_7 : 80|7@1+ (0.01,0) [0|1] "NA"  ACM
 SG_ TSR_Confidence_7 : 87|7@1+ (0.01,0) [0|1] "NA"  ACM
 SG_ TSR_Sign_Shape_7 : 94|4@1+ (1,0) [0|8] "ENUM"  ACM
 SG_ TSR_Sign_Structure_7 : 98|3@1+ (1,0) [0|3] "ENUM"  ACM
 SG_ TSR_Tracking_Age_7 : 101|10@1+ (1,0) [0|1000] "counter"  ACM
 SG_ TSR_Sign_Long_Distance_7 : 112|15@1+ (0.01,0) [0|200] "m"  ACM
 SG_ TSR_Sign_Long_Distance_STD_7 : 127|15@1+ (0.01,0) [0|200] "m"  ACM
 SG_ TSR_Sign_Lateral_Distance_7 : 144|13@1+ (0.01,-32) [-32|31] "m"  ACM
 SG_ TSR_Sign_Lat_Distance_STD_7 : 157|13@1+ (0.01,-32) [-32|31] "m"  ACM
 SG_ TSR_Sign_Height_7 : 176|15@1+ (0.01,-15) [-15|15] "m"  ACM
 SG_ TSR_Sign_Panel_Height_STD_7 : 191|10@1+ (0.01,0) [0|8] "m"  ACM
 SG_ TSR_Sign_Height_STD_7 : 208|15@1+ (0.01,-15) [-15|15] "m"  ACM
 SG_ TSR_Sign_Panel_Width_7 : 223|10@1+ (0.01,0) [0|8] "m"  ACM
 SG_ TSR_Sign_Panel_Height_7 : 240|10@1+ (0.01,0) [0|8] "m"  ACM
 SG_ TSR_Sign_Panel_Width_STD_7 : 250|10@1+ (0.01,0) [0|8] "m"  ACM
 SG_ TSR_Buffer_7 : 260|12@1+ (1,0) [0|4095] "NA"  ACM

BO_ 118 ICM_Traffic_Signs6: 64 MyECU
 SG_ ICM_Traffic_Signs6_Header : 0|16@1+ (1,0) [0|65535] ""  ACM
 SG_ TSR_ID_6 : 16|8@1+ (1,0) [0|255] "counter"  ACM
 SG_ TSR_Camera_Source_6 : 24|8@1+ (1,0) [0|255] "ENUM"  ACM
 SG_ TSR_Sign_Name_6 : 32|10@1+ (1,0) [0|1023] "NA"  ACM
 SG_ TSR_Relevancy_6 : 42|5@1+ (1,0) [0|13] "ENUM"  ACM
 SG_ TSR_Filter_Type_6 : 48|4@1+ (1,0) [0|7] "ENUM"  ACM
 SG_ TSR_Sup1_SignName_6 : 52|8@1+ (1,0) [0|255] "NA"  ACM
 SG_ TSR_Sup1_Confidence_6 : 60|7@1+ (0.01,0) [0|1] "NA"  ACM
 SG_ TSR_Sup2_SignName_6 : 67|8@1+ (1,0) [0|255] "NA"  ACM
 SG_ TSR_Sup2_Confidence_6 : 80|7@1+ (0.01,0) [0|1] "NA"  ACM
 SG_ TSR_Confidence_6 : 87|7@1+ (0.01,0) [0|1] "NA"  ACM
 SG_ TSR_Sign_Shape_6 : 94|4@1+ (1,0) [0|8] "ENUM"  ACM
 SG_ TSR_Sign_Structure_6 : 98|3@1+ (1,0) [0|3] "ENUM"  ACM
 SG_ TSR_Tracking_Age_6 : 101|10@1+ (1,0) [0|1000] "counter"  ACM
 SG_ TSR_Sign_Long_Distance_6 : 112|15@1+ (0.01,0) [0|200] "m"  ACM
 SG_ TSR_Sign_Long_Distance_STD_6 : 127|15@1+ (0.01,0) [0|200] "m"  ACM
 SG_ TSR_Sign_Lateral_Distance_6 : 144|13@1+ (0.01,-32) [-32|31] "m"  ACM
 SG_ TSR_Sign_Lat_Distance_STD_6 : 157|13@1+ (0.01,-32) [-32|31] "m"  ACM
 SG_ TSR_Sign_Height_6 : 176|15@1+ (0.01,-15) [-15|15] "m"  ACM
 SG_ TSR_Sign_Panel_Height_STD_6 : 191|10@1+ (0.01,0) [0|8] "m"  ACM
 SG_ TSR_Sign_Height_STD_6 : 208|15@1+ (0.01,-15) [-15|15] "m"  ACM
 SG_ TSR_Sign_Panel_Width_6 : 223|10@1+ (0.01,0) [0|8] "m"  ACM
 SG_ TSR_Sign_Panel_Height_6 : 240|10@1+ (0.01,0) [0|8] "m"  ACM
 SG_ TSR_Sign_Panel_Width_STD_6 : 250|10@1+ (0.01,0) [0|8] "m"  ACM
 SG_ TSR_Buffer_6 : 260|12@1+ (1,0) [0|4095] "NA"  ACM

BO_ 117 ICM_Traffic_Signs5: 64 MyECU
 SG_ ICM_Traffic_Signs5_Header : 0|16@1+ (1,0) [0|65535] ""  ACM
 SG_ TSR_ID_5 : 16|8@1+ (1,0) [0|255] "counter"  ACM
 SG_ TSR_Camera_Source_5 : 24|8@1+ (1,0) [0|255] "ENUM"  ACM
 SG_ TSR_Sign_Name_5 : 32|10@1+ (1,0) [0|1023] "NA"  ACM
 SG_ TSR_Relevancy_5 : 42|5@1+ (1,0) [0|13] "ENUM"  ACM
 SG_ TSR_Filter_Type_5 : 48|4@1+ (1,0) [0|7] "ENUM"  ACM
 SG_ TSR_Sup1_SignName_5 : 52|8@1+ (1,0) [0|255] "NA"  ACM
 SG_ TSR_Sup1_Confidence_5 : 60|7@1+ (0.01,0) [0|1] "NA"  ACM
 SG_ TSR_Sup2_SignName_5 : 67|8@1+ (1,0) [0|255] "NA"  ACM
 SG_ TSR_Sup2_Confidence_5 : 80|7@1+ (0.01,0) [0|1] "NA"  ACM
 SG_ TSR_Confidence_5 : 87|7@1+ (0.01,0) [0|1] "NA"  ACM
 SG_ TSR_Sign_Shape_5 : 94|4@1+ (1,0) [0|8] "ENUM"  ACM
 SG_ TSR_Sign_Structure_5 : 98|3@1+ (1,0) [0|3] "ENUM"  ACM
 SG_ TSR_Tracking_Age_5 : 101|10@1+ (1,0) [0|1000] "counter"  ACM
 SG_ TSR_Sign_Long_Distance_5 : 112|15@1+ (0.01,0) [0|200] "m"  ACM
 SG_ TSR_Sign_Long_Distance_STD_5 : 127|15@1+ (0.01,0) [0|200] "m"  ACM
 SG_ TSR_Sign_Lateral_Distance_5 : 144|13@1+ (0.01,-32) [-32|31] "m"  ACM
 SG_ TSR_Sign_Lat_Distance_STD_5 : 157|13@1+ (0.01,-32) [-32|31] "m"  ACM
 SG_ TSR_Sign_Height_5 : 176|15@1+ (0.01,-15) [-15|15] "m"  ACM
 SG_ TSR_Sign_Panel_Height_STD_5 : 191|10@1+ (0.01,0) [0|8] "m"  ACM
 SG_ TSR_Sign_Height_STD_5 : 208|15@1+ (0.01,-15) [-15|15] "m"  ACM
 SG_ TSR_Sign_Panel_Width_5 : 223|10@1+ (0.01,0) [0|8] "m"  ACM
 SG_ TSR_Sign_Panel_Height_5 : 240|10@1+ (0.01,0) [0|8] "m"  ACM
 SG_ TSR_Sign_Panel_Width_STD_5 : 250|10@1+ (0.01,0) [0|8] "m"  ACM
 SG_ TSR_Buffer_5 : 260|12@1+ (1,0) [0|4095] "NA"  ACM

BO_ 116 ICM_Traffic_Signs4: 64 MyECU
 SG_ ICM_Traffic_Signs4_Header : 0|16@1+ (1,0) [0|65535] ""  ACM
 SG_ TSR_ID_4 : 16|8@1+ (1,0) [0|255] "counter"  ACM
 SG_ TSR_Camera_Source_4 : 24|8@1+ (1,0) [0|255] "ENUM"  ACM
 SG_ TSR_Sign_Name_4 : 32|10@1+ (1,0) [0|1023] "NA"  ACM
 SG_ TSR_Relevancy_4 : 42|5@1+ (1,0) [0|13] "ENUM"  ACM
 SG_ TSR_Filter_Type_4 : 48|4@1+ (1,0) [0|7] "ENUM"  ACM
 SG_ TSR_Sup1_SignName_4 : 52|8@1+ (1,0) [0|255] "NA"  ACM
 SG_ TSR_Sup1_Confidence_4 : 60|7@1+ (0.01,0) [0|1] "NA"  ACM
 SG_ TSR_Sup2_SignName_4 : 67|8@1+ (1,0) [0|255] "NA"  ACM
 SG_ TSR_Sup2_Confidence_4 : 80|7@1+ (0.01,0) [0|1] "NA"  ACM
 SG_ TSR_Confidence_4 : 87|7@1+ (0.01,0) [0|1] "NA"  ACM
 SG_ TSR_Sign_Shape_4 : 94|4@1+ (1,0) [0|8] "ENUM"  ACM
 SG_ TSR_Sign_Structure_4 : 98|3@1+ (1,0) [0|3] "ENUM"  ACM
 SG_ TSR_Tracking_Age_4 : 101|10@1+ (1,0) [0|1000] "counter"  ACM
 SG_ TSR_Sign_Long_Distance_4 : 112|15@1+ (0.01,0) [0|200] "m"  ACM
 SG_ TSR_Sign_Long_Distance_STD_4 : 127|15@1+ (0.01,0) [0|200] "m"  ACM
 SG_ TSR_Sign_Lateral_Distance_4 : 144|13@1+ (0.01,-32) [-32|31] "m"  ACM
 SG_ TSR_Sign_Lat_Distance_STD_4 : 157|13@1+ (0.01,-32) [-32|31] "m"  ACM
 SG_ TSR_Sign_Height_4 : 176|15@1+ (0.01,-15) [-15|15] "m"  ACM
 SG_ TSR_Sign_Panel_Height_STD_4 : 191|10@1+ (0.01,0) [0|8] "m"  ACM
 SG_ TSR_Sign_Height_STD_4 : 208|15@1+ (0.01,-15) [-15|15] "m"  ACM
 SG_ TSR_Sign_Panel_Width_4 : 223|10@1+ (0.01,0) [0|8] "m"  ACM
 SG_ TSR_Sign_Panel_Height_4 : 240|10@1+ (0.01,0) [0|8] "m"  ACM
 SG_ TSR_Sign_Panel_Width_STD_4 : 250|10@1+ (0.01,0) [0|8] "m"  ACM
 SG_ TSR_Buffer_4 : 260|12@1+ (1,0) [0|4095] "NA"  ACM

BO_ 115 ICM_Traffic_Signs3: 64 MyECU
 SG_ ICM_Traffic_Signs3_Header : 0|16@1+ (1,0) [0|65535] ""  ACM
 SG_ TSR_ID_3 : 16|8@1+ (1,0) [0|255] "counter"  ACM
 SG_ TSR_Camera_Source_3 : 24|8@1+ (1,0) [0|255] "ENUM"  ACM
 SG_ TSR_Sign_Name_3 : 32|10@1+ (1,0) [0|1023] "NA"  ACM
 SG_ TSR_Relevancy_3 : 42|5@1+ (1,0) [0|13] "ENUM"  ACM
 SG_ TSR_Filter_Type_3 : 48|4@1+ (1,0) [0|7] "ENUM"  ACM
 SG_ TSR_Sup1_SignName_3 : 52|8@1+ (1,0) [0|255] "NA"  ACM
 SG_ TSR_Sup1_Confidence_3 : 60|7@1+ (0.01,0) [0|1] "NA"  ACM
 SG_ TSR_Sup2_SignName_3 : 67|8@1+ (1,0) [0|255] "NA"  ACM
 SG_ TSR_Sup2_Confidence_3 : 80|7@1+ (0.01,0) [0|1] "NA"  ACM
 SG_ TSR_Confidence_3 : 87|7@1+ (0.01,0) [0|1] "NA"  ACM
 SG_ TSR_Sign_Shape_3 : 94|4@1+ (1,0) [0|8] "ENUM"  ACM
 SG_ TSR_Sign_Structure_3 : 98|3@1+ (1,0) [0|3] "ENUM"  ACM
 SG_ TSR_Tracking_Age_3 : 101|10@1+ (1,0) [0|1000] "counter"  ACM
 SG_ TSR_Sign_Long_Distance_3 : 112|15@1+ (0.01,0) [0|200] "m"  ACM
 SG_ TSR_Sign_Long_Distance_STD_3 : 127|15@1+ (0.01,0) [0|200] "m"  ACM
 SG_ TSR_Sign_Lateral_Distance_3 : 144|13@1+ (0.01,-32) [-32|31] "m"  ACM
 SG_ TSR_Sign_Lat_Distance_STD_3 : 157|13@1+ (0.01,-32) [-32|31] "m"  ACM
 SG_ TSR_Sign_Height_3 : 176|15@1+ (0.01,-15) [-15|15] "m"  ACM
 SG_ TSR_Sign_Panel_Height_STD_3 : 191|10@1+ (0.01,0) [0|8] "m"  ACM
 SG_ TSR_Sign_Height_STD_3 : 208|15@1+ (0.01,-15) [-15|15] "m"  ACM
 SG_ TSR_Sign_Panel_Width_3 : 223|10@1+ (0.01,0) [0|8] "m"  ACM
 SG_ TSR_Sign_Panel_Height_3 : 240|10@1+ (0.01,0) [0|8] "m"  ACM
 SG_ TSR_Sign_Panel_Width_STD_3 : 250|10@1+ (0.01,0) [0|8] "m"  ACM
 SG_ TSR_Buffer_3 : 260|12@1+ (1,0) [0|4095] "NA"  ACM

BO_ 114 ICM_Traffic_Signs2: 64 MyECU
 SG_ ICM_Traffic_Signs2_Header : 0|16@1+ (1,0) [0|65535] ""  ACM
 SG_ TSR_ID_2 : 16|8@1+ (1,0) [0|255] "counter"  ACM
 SG_ TSR_Camera_Source_2 : 24|8@1+ (1,0) [0|255] "ENUM"  ACM
 SG_ TSR_Sign_Name_2 : 32|10@1+ (1,0) [0|1023] "NA"  ACM
 SG_ TSR_Relevancy_2 : 42|5@1+ (1,0) [0|13] "ENUM"  ACM
 SG_ TSR_Filter_Type_2 : 48|4@1+ (1,0) [0|7] "ENUM"  ACM
 SG_ TSR_Sup1_SignName_2 : 52|8@1+ (1,0) [0|255] "NA"  ACM
 SG_ TSR_Sup1_Confidence_2 : 60|7@1+ (0.01,0) [0|1] "NA"  ACM
 SG_ TSR_Sup2_SignName_2 : 67|8@1+ (1,0) [0|255] "NA"  ACM
 SG_ TSR_Sup2_Confidence_2 : 80|7@1+ (0.01,0) [0|1] "NA"  ACM
 SG_ TSR_Confidence_2 : 87|7@1+ (0.01,0) [0|1] "NA"  ACM
 SG_ TSR_Sign_Shape_2 : 94|4@1+ (1,0) [0|8] "ENUM"  ACM
 SG_ TSR_Sign_Structure_2 : 98|3@1+ (1,0) [0|3] "ENUM"  ACM
 SG_ TSR_Tracking_Age_2 : 101|10@1+ (1,0) [0|1000] "counter"  ACM
 SG_ TSR_Sign_Long_Distance_2 : 112|15@1+ (0.01,0) [0|200] "m"  ACM
 SG_ TSR_Sign_Long_Distance_STD_2 : 127|15@1+ (0.01,0) [0|200] "m"  ACM
 SG_ TSR_Sign_Lateral_Distance_2 : 144|13@1+ (0.01,-32) [-32|31] "m"  ACM
 SG_ TSR_Sign_Lat_Distance_STD_2 : 157|13@1+ (0.01,-32) [-32|31] "m"  ACM
 SG_ TSR_Sign_Height_2 : 176|15@1+ (0.01,-15) [-15|15] "m"  ACM
 SG_ TSR_Sign_Panel_Height_STD_2 : 191|10@1+ (0.01,0) [0|8] "m"  ACM
 SG_ TSR_Sign_Height_STD_2 : 208|15@1+ (0.01,-15) [-15|15] "m"  ACM
 SG_ TSR_Sign_Panel_Width_2 : 223|10@1+ (0.01,0) [0|8] "m"  ACM
 SG_ TSR_Sign_Panel_Height_2 : 240|10@1+ (0.01,0) [0|8] "m"  ACM
 SG_ TSR_Sign_Panel_Width_STD_2 : 250|10@1+ (0.01,0) [0|8] "m"  ACM
 SG_ TSR_Buffer_2 : 260|12@1+ (1,0) [0|4095] "NA"  ACM

BO_ 113 ICM_Traffic_Signs1: 64 MyECU
 SG_ ICM_Traffic_Signs1_Header : 0|16@1+ (1,0) [0|65535] ""  ACM
 SG_ TSR_ID_1 : 16|8@1+ (1,0) [0|255] "counter"  ACM
 SG_ TSR_Camera_Source_1 : 24|8@1+ (1,0) [0|255] "ENUM"  ACM
 SG_ TSR_Sign_Name_1 : 32|10@1+ (1,0) [0|1023] "NA"  ACM
 SG_ TSR_Relevancy_1 : 42|5@1+ (1,0) [0|13] "ENUM"  ACM
 SG_ TSR_Filter_Type_1 : 48|4@1+ (1,0) [0|7] "ENUM"  ACM
 SG_ TSR_Sup1_SignName_1 : 52|8@1+ (1,0) [0|255] "NA"  ACM
 SG_ TSR_Sup1_Confidence_1 : 60|7@1+ (0.01,0) [0|1] "NA"  ACM
 SG_ TSR_Sup2_SignName_1 : 67|8@1+ (1,0) [0|255] "NA"  ACM
 SG_ TSR_Sup2_Confidence_1 : 80|7@1+ (0.01,0) [0|1] "NA"  ACM
 SG_ TSR_Confidence_1 : 87|7@1+ (0.01,0) [0|1] "NA"  ACM
 SG_ TSR_Sign_Shape_1 : 94|4@1+ (1,0) [0|8] "ENUM"  ACM
 SG_ TSR_Sign_Structure_1 : 98|3@1+ (1,0) [0|3] "ENUM"  ACM
 SG_ TSR_Tracking_Age_1 : 101|10@1+ (1,0) [0|1000] "counter"  ACM
 SG_ TSR_Sign_Long_Distance_1 : 112|15@1+ (0.01,0) [0|200] "m"  ACM
 SG_ TSR_Sign_Long_Distance_STD_1 : 127|15@1+ (0.01,0) [0|200] "m"  ACM
 SG_ TSR_Sign_Lateral_Distance_1 : 144|13@1+ (0.01,-32) [-32|31] "m"  ACM
 SG_ TSR_Sign_Lat_Distance_STD_1 : 157|13@1+ (0.01,-32) [-32|31] "m"  ACM
 SG_ TSR_Sign_Height_1 : 176|15@1+ (0.01,-15) [-15|15] "m"  ACM
 SG_ TSR_Sign_Panel_Height_STD_1 : 191|10@1+ (0.01,0) [0|8] "m"  ACM
 SG_ TSR_Sign_Height_STD_1 : 208|15@1+ (0.01,-15) [-15|15] "m"  ACM
 SG_ TSR_Sign_Panel_Width_1 : 223|10@1+ (0.01,0) [0|8] "m"  ACM
 SG_ TSR_Sign_Panel_Height_1 : 240|10@1+ (0.01,0) [0|8] "m"  ACM
 SG_ TSR_Sign_Panel_Width_STD_1 : 250|10@1+ (0.01,0) [0|8] "m"  ACM
 SG_ TSR_Buffer_1 : 260|12@1+ (1,0) [0|4095] "NA"  ACM

BO_ 112 ICM_Traffic_Signs_Head_Header: 64 MyECU
 SG_ ICM_Traffic_Signs_Header_Header : 0|16@1+ (1,0) [0|65535] ""  ACM
 SG_ TSR_Zero_byte : 16|8@1+ (1,0) [0|255] "NA"  ACM
 SG_ TSR_Protocol_Version : 24|8@1+ (1,0) [4|4] "counter"  ACM
 SG_ TSR_Sync_ID : 32|8@1+ (1,0) [0|255] "counter"  ACM
 SG_ TSR_Approved_Sign_Count : 40|5@1+ (1,0) [0|20] "counter"  ACM
 SG_ TSR_Filtered_Sign_Count : 45|3@1+ (1,0) [0|5] "counter"  ACM
 SG_ TSR_UnderTracking_Sign_Count : 48|5@1+ (1,0) [0|20] "counter"  ACM
 SG_ TSR_Header_Buffer : 53|27@1+ (1,0) [0|134217727] "NA"  ACM
 SG_ TSR_ID_0 : 80|8@1+ (1,0) [0|255] "counter"  ACM
 SG_ TSR_Camera_Source_0 : 88|8@1+ (1,0) [0|255] "ENUM"  ACM
 SG_ TSR_Sign_Name_0 : 96|10@1+ (1,0) [0|1023] "NA"  ACM
 SG_ TSR_Relevancy_0 : 106|5@1+ (1,0) [0|13] "ENUM"  ACM
 SG_ TSR_Filter_Type_0 : 112|4@1+ (1,0) [0|7] "ENUM"  ACM
 SG_ TSR_Sup1_SignName_0 : 116|8@1+ (1,0) [0|255] "NA"  ACM
 SG_ TSR_Sup1_Confidence_0 : 124|7@1+ (0.01,0) [0|1] "NA"  ACM
 SG_ TSR_Sup2_SignName_0 : 131|8@1+ (1,0) [0|255] "NA"  ACM
 SG_ TSR_Sup2_Confidence_0 : 144|7@1+ (0.01,0) [0|1] "NA"  ACM
 SG_ TSR_Confidence_0 : 151|7@1+ (0.01,0) [0|1] "NA"  ACM
 SG_ TSR_Sign_Shape_0 : 158|4@1+ (1,0) [0|8] "ENUM"  ACM
 SG_ TSR_Sign_Structure_0 : 162|3@1+ (1,0) [0|3] "ENUM"  ACM
 SG_ TSR_Tracking_Age_0 : 165|10@1+ (1,0) [0|1000] "counter"  ACM
 SG_ TSR_Sign_Long_Distance_0 : 176|15@1+ (0.01,0) [0|200] "m"  ACM
 SG_ TSR_Sign_Long_Distance_STD_0 : 191|15@1+ (0.01,0) [0|200] "m"  ACM
 SG_ TSR_Sign_Lateral_Distance_0 : 208|13@1+ (0.01,-32) [-32|31] "m"  ACM
 SG_ TSR_Sign_Lat_Distance_STD_0 : 221|13@1+ (0.01,-32) [-32|31] "m"  ACM
 SG_ TSR_Sign_Height_0 : 240|15@1+ (0.01,-15) [-15|15] "m"  ACM
 SG_ TSR_Sign_Panel_Height_STD_0 : 255|10@1+ (0.01,0) [0|8] "m"  ACM
 SG_ TSR_Sign_Height_STD_0 : 272|15@1+ (0.01,-15) [-15|15] "m"  ACM
 SG_ TSR_Sign_Panel_Width_0 : 287|10@1+ (0.01,0) [0|8] "m"  ACM
 SG_ TSR_Sign_Panel_Height_0 : 304|10@1+ (0.01,0) [0|8] "m"  ACM
 SG_ TSR_Sign_Panel_Width_STD_0 : 314|10@1+ (0.01,0) [0|8] "m"  ACM
 SG_ TSR_Buffer_0 : 324|12@1+ (1,0) [0|4095] "NA"  ACM

BO_ 224 ICM_Object_Prot39_B: 64 MyECU
 SG_ ICM_Object_Prot39_B_CRC : 400|16@1+ (1,0) [0|65535] ""  ACM
 SG_ ICM_Object_Prot39_B_Header : 0|16@1+ (1,0) [0|65535] ""  ACM
 SG_ OBJ_Relative_Long_Velocity_39 : 16|13@1+ (0.05,-120) [-120|130] "MPS"  ACM
 SG_ OBJ_Relative_Long_Velocity_V_39 : 29|1@1+ (1,0) [0|1] "bool"  ACM
 SG_ OBJ_Relative_Long_Vel_STD_39 : 30|12@1+ (0.05,0) [0|130] "MPS"  ACM
 SG_ OBJ_Rel_Long_Vel_STD_V_39 : 42|1@1+ (1,0) [0|1] "bool"  ACM
 SG_ OBJ_Relative_Lat_Velocity_39 : 48|11@1+ (0.05,-50) [-50|50] "MPS"  ACM
 SG_ OBJ_Relative_Lat_Velocity_V_39 : 59|1@1+ (1,0) [0|1] "bool"  ACM
 SG_ OBJ_Relative_Lat_Velocity_STD_39 : 60|10@1+ (0.05,0) [0|50] "MPS"  ACM
 SG_ OBJ_Rel_Lat_Vel_STD_V_39 : 70|1@1+ (1,0) [0|1] "bool"  ACM
 SG_ OBJ_Long_Distance_39 : 80|14@1+ (0.05,-200) [-200|250] "m"  ACM
 SG_ OBJ_Long_Distance_V_39 : 94|1@1+ (1,0) [0|1] "bool"  ACM
 SG_ OBJ_Long_Distance_STD_39 : 95|13@1+ (0.05,0) [0|250] "m"  ACM
 SG_ OBJ_Long_Distance_STD_V_39 : 108|1@1+ (1,0) [0|1] "bool"  ACM
 SG_ OBJ_Lat_Distance_39 : 112|12@1+ (0.05,-100) [-100|100] "m"  ACM
 SG_ OBJ_Lat_Distance_V_39 : 124|1@1+ (1,0) [0|1] "bool"  ACM
 SG_ OBJ_Lat_Distance_STD_39 : 125|11@1+ (0.05,0) [0|100] "m"  ACM
 SG_ OBJ_Lat_Distance_STD_V_39 : 136|1@1+ (1,0) [0|1] "bool"  ACM
 SG_ OBJ_Absolute_Speed_39 : 144|12@1+ (0.05,-65) [-65|65] "MPS"  ACM
 SG_ OBJ_Absolute_Speed_V_39 : 156|1@1+ (1,0) [0|1] "bool"  ACM
 SG_ OBJ_Absolute_Speed_STD_39 : 157|11@1+ (0.05,-65) [0|65] "MPS"  ACM
 SG_ OBJ_Absolute_Speed_STD_V_39 : 168|1@1+ (1,0) [0|1] "bool"  ACM
 SG_ OBJ_Heading_39 : 176|10@1+ (0.01,-3.14) [-3.14|3.14] "rad"  ACM
 SG_ OBJ_Heading_V_39 : 186|1@1+ (1,0) [0|1] "bool"  ACM
 SG_ OBJ_Heading_STD_39 : 187|9@1+ (0.01,0) [0|3.14] "rad"  ACM
 SG_ OBJ_Heading_STD_V_39 : 196|1@1+ (1,0) [0|1] "bool"  ACM
 SG_ OBJ_Angle_Rate_STD_39 : 197|11@1+ (0.002,0) [0|2.2318] "RPS"  ACM
 SG_ OBJ_Angle_Rate_STD_V_39 : 208|1@1+ (1,0) [0|1] "bool"  ACM
 SG_ OBJ_Angle_Rate_39 : 209|12@1+ (0.002,-2.234) [-2.234|2.2318] "RPS"  ACM
 SG_ OBJ_Angle_Rate_V_39 : 221|1@1+ (1,0) [0|1] "bool"  ACM
 SG_ OBJ_Angle_Right_39 : 222|14@1+ (0.0002,-1.571) [-1.571|1.571] "rad "  ACM
 SG_ OBJ_Angle_Right_V_39 : 236|1@1+ (1,0) [0|1] "bool"  ACM
 SG_ OBJ_Angle_Right_STD_39 : 240|13@1+ (0.0002,0) [0|1.571] "rad "  ACM
 SG_ OBJ_Angle_Right_STD_V_39 : 253|1@1+ (1,0) [0|1] "bool"  ACM
 SG_ OBJ_Angle_Left_39 : 254|14@1+ (0.0002,-1.571) [-1.571|1.571] "rad "  ACM
 SG_ OBJ_Angle_Left_V_39 : 268|1@1+ (1,0) [0|1] "bool"  ACM
 SG_ OBJ_Angle_Left_STD_39 : 272|13@1+ (0.0002,0) [0|1.571] "rad"  ACM
 SG_ OBJ_Angle_Left_STD_V_39 : 285|1@1+ (1,0) [0|1] "bool"  ACM
 SG_ OBJ_Angle_Side_39 : 286|14@1+ (0.0002,-1.571) [-1.571|1.571] "rad"  ACM
 SG_ OBJ_Angle_Side_V_39 : 300|1@1+ (1,0) [0|1] "bool"  ACM
 SG_ OBJ_Angle_Side_STD_39 : 304|13@1+ (0.0002,0) [0|1.571] "rad"  ACM
 SG_ OBJ_Angle_Side_STD_V_39 : 317|1@1+ (1,0) [0|1] "bool"  ACM
 SG_ OBJ_Angle_Mid_V_39 : 318|1@1+ (1,0) [0|1] "bool"  ACM
 SG_ OBJ_Angle_Mid_39 : 319|14@1+ (0.0002,-1.571) [-1.571|1.571] "rad"  ACM
 SG_ OBJ_Angle_Mid_STD_39 : 336|13@1+ (0.0002,0) [0|1.571] "rad"  ACM
 SG_ OBJ_Angle_Mid_STD_V_39 : 349|1@1+ (1,0) [0|1] "bool"  ACM
 SG_ OBJ_Angle_Bottom_V_39 : 350|1@1+ (1,0) [0|1] "bool"  ACM
 SG_ OBJ_Angle_Bottom_39 : 351|14@1+ (0.0002,-1.571) [-1.571|1.571] "rad"  ACM
 SG_ OBJ_Angle_Bottom_STD_39 : 368|13@1+ (0.0002,0) [0|1.571] "rad"  ACM
 SG_ OBJ_Angle_Bottom_STD_V_39 : 381|1@1+ (1,0) [0|1] "bool"  ACM
 SG_ OBJ_Visibility_Side_V_39 : 382|1@1+ (1,0) [0|1] "bool"  ACM
 SG_ OBJ_Visibility_Side_39 : 383|2@1+ (1,0) [0|2] "ENUM"  ACM
 SG_ OBJ_Is_In_Drivable_Area_39 : 385|1@1+ (1,0) [0|1] "bool"  ACM
 SG_ OBJ_Is_In_Drivable_Area_V_39 : 386|1@1+ (1,0) [0|1] "bool"  ACM
 SG_ OBJ_Is_VeryClose_39 : 387|1@1+ (1,0) [0|1] "bool"  ACM
 SG_ OBJ_Is_VeryClose_V_39 : 388|1@1+ (1,0) [0|1] "bool"  ACM
 SG_ OBJ_Buffer_39 : 389|11@1+ (1,0) [0|0] "NA"  ACM

BO_ 223 ICM_Object_Prot39_A: 64 MyECU
 SG_ ICM_Object_Prot39_A_Header : 0|16@1+ (1,0) [0|65535] ""  ACM
 SG_ OBJ_CRC_39 : 16|32@1+ (1,0) [0|4294967295] "NA"  ACM
 SG_ OBJ_ID_39 : 48|8@1+ (1,0) [0|255] "NA"  ACM
 SG_ OBJ_Existence_Probability_39 : 56|8@1+ (0.01,0) [0|1] "NA"  ACM
 SG_ OBJ_Fusion_Source_39 : 64|16@1+ (1,0) [0|65535] "BITWIZE"  ACM
 SG_ OBJ_Triggered_SDM_39 : 80|2@1+ (1,0) [0|2] "ENUM"  ACM
 SG_ OBJ_Motion_Category_39 : 82|4@1+ (1,0) [0|13] "ENUM "  ACM
 SG_ OBJ_Moving_IN_Probability_39 : 86|7@1+ (0.01,0) [0|0] "NA"  ACM
 SG_ OBJ_Object_Age_39 : 93|11@1+ (1,0) [0|2047] "Frame"  ACM
 SG_ OBJ_Measuring_Status_39 : 104|3@1+ (1,0) [0|7] "BITWIZE"  ACM
 SG_ OBJ_Object_Class_39 : 107|4@1+ (1,0) [0|8] "ENUM"  ACM
 SG_ OBJ_Class_Probability_39 : 112|7@1+ (0.01,0) [0|1] "NA"  ACM
 SG_ OBJ_Car_Probability_39 : 119|7@1+ (0.01,0) [0|0] "NA"  ACM
 SG_ OBJ_Truck_Probability_39 : 126|7@1+ (0.01,0) [0|0] "NA"  ACM
 SG_ OBJ_Bike_Probability_39 : 133|7@1+ (0.01,0) [0|0] "NA"  ACM
 SG_ OBJ_Camera_Source_39 : 140|4@1+ (1,0) [0|15] "ENUM"  ACM
 SG_ OBJ_Motion_Status_39 : 144|3@1+ (1,0) [0|5] "ENUM "  ACM
 SG_ OBJ_Motion_Orientation_39 : 147|4@1+ (1,0) [0|13] "ENUM "  ACM
 SG_ OBJ_Has_Cut_Lane_39 : 151|1@1+ (1,0) [0|1] "bool"  ACM
 SG_ OBJ_Has_Cut_Path_39 : 152|1@1+ (1,0) [0|1] "bool"  ACM
 SG_ OBJ_Brake_Light_39 : 153|1@1+ (1,0) [0|1] "bool"  ACM
 SG_ OBJ_Turn_Indicator_Right_39 : 154|1@1+ (1,0) [0|1] "bool"  ACM
 SG_ OBJ_Turn_Indicator_Left_39 : 155|1@1+ (1,0) [0|1] "bool"  ACM
 SG_ OBJ_Light_Indicator_Validity_39 : 156|1@1+ (1,0) [0|1] "bool"  ACM
 SG_ OBJ_Right_Out_Of_Image_39 : 157|1@1+ (1,0) [0|1] "bool"  ACM
 SG_ OBJ_Left_Out_Of_Image_39 : 158|1@1+ (1,0) [0|1] "bool"  ACM
 SG_ OBJ_Right_Out_Of_Image_V_39 : 159|1@1+ (1,0) [0|1] "bool"  ACM
 SG_ OBJ_Left_Out_Of_Image_V_39 : 160|1@1+ (1,0) [0|1] "bool"  ACM
 SG_ OBJ_Top_Out_Of_Image_39 : 161|1@1+ (1,0) [0|1] "bool"  ACM
 SG_ OBJ_Bottom_Out_Of_Image_39 : 162|1@1+ (1,0) [0|1] "bool"  ACM
 SG_ OBJ_Top_Out_Of_Image_V_39 : 163|1@1+ (1,0) [0|1] "bool"  ACM
 SG_ OBJ_Bottom_Out_Of_Image_V_39 : 164|1@1+ (1,0) [0|1] "bool"  ACM
 SG_ OBJ_Lane_Assignment_39 : 165|3@1+ (1,0) [0|5] "ENUM"  ACM
 SG_ OBJ_Lane_Assignment_V_39 : 168|1@1+ (1,0) [0|1] "bool"  ACM
 SG_ OBJ_Age_Seconds_39 : 169|7@1+ (1,0) [0|100] "s"  ACM
 SG_ OBJ_Age_Seconds_V_39 : 176|1@1+ (1,0) [0|1] "bool"  ACM
 SG_ OBJ_Width_39 : 177|9@1+ (0.01,0) [0.4|2.95] "m"  ACM
 SG_ OBJ_Width_V_39 : 186|1@1+ (1,0) [0|1] "bool"  ACM
 SG_ OBJ_Width_STD_39 : 187|8@1+ (0.01,0) [0|2] "m"  ACM
 SG_ OBJ_Width_STD_V_39 : 195|1@1+ (1,0) [0|1] "bool"  ACM
 SG_ OBJ_Length_39 : 196|9@1+ (0.05,0) [1.2|21] "m"  ACM
 SG_ OBJ_Length_V_39 : 205|1@1+ (1,0) [0|1] "bool"  ACM
 SG_ OBJ_Length_STD_39 : 208|8@1+ (0.05,0) [0|10] "m"  ACM
 SG_ OBJ_Length_STD_V_39 : 216|1@1+ (1,0) [0|1] "bool"  ACM
 SG_ OBJ_Height_39 : 217|9@1+ (0.01,0) [0|2.95] "m"  ACM
 SG_ OBJ_Height_V_39 : 226|1@1+ (1,0) [0|1] "bool"  ACM
 SG_ OBJ_Height_STD_39 : 227|8@1+ (0.01,0) [0|2] "m"  ACM
 SG_ OBJ_Height_STD_V_39 : 235|1@1+ (1,0) [0|1] "bool"  ACM
 SG_ OBJ_Abs_Long_Velocity_39 : 240|12@1+ (0.05,-30) [-30|100] "MPS"  ACM
 SG_ OBJ_Abs_Long_Velocity_V_39 : 252|1@1+ (1,0) [0|1] "bool"  ACM
 SG_ OBJ_Abs_Long_Velocity_STD_39 : 253|11@1+ (0.05,0) [0|65] "MPS"  ACM
 SG_ OBJ_Abs_Long_Vel_STD_V_39 : 264|1@1+ (1,0) [0|1] "bool"  ACM
 SG_ OBJ_Abs_Lat_Velocity_39 : 272|11@1+ (0.05,-50) [-50|50] "MPS"  ACM
 SG_ OBJ_Abs_Lat_Velocity_V_39 : 283|1@1+ (1,0) [0|1] "bool"  ACM
 SG_ OBJ_Abs_Lat_Velocity_STD_39 : 284|10@1+ (0.05,0) [0|50] "MPS"  ACM
 SG_ OBJ_Abs_Lat_Vel_STD_V_39 : 294|1@1+ (1,0) [0|1] "bool"  ACM
 SG_ OBJ_Abs_Long_Acc_39 : 295|9@1+ (0.05,-10.3) [-10.3|7.3] "MPS2"  ACM
 SG_ OBJ_Abs_Long_Acc_V_39 : 304|1@1+ (1,0) [0|1] "bool"  ACM
 SG_ OBJ_Abs_Long_Acc_STD_39 : 305|8@1+ (0.05,0) [0|7.3] "MPS2"  ACM
 SG_ OBJ_Abs_Long_Acc_STD_V_39 : 313|1@1+ (1,0) [0|1] "bool"  ACM
 SG_ OBJ_Abs_Lat_Acc_39 : 314|9@1+ (0.05,-10.3) [-10.3|7.3] "MPS2"  ACM
 SG_ OBJ_Abs_Lat_Acc_V_39 : 323|1@1+ (1,0) [0|1] "bool"  ACM
 SG_ OBJ_Abs_Lat_Acc_STD_39 : 324|8@1+ (0.05,0) [0|7.3] "MPS2"  ACM
 SG_ OBJ_Abs_Lat_Acc_STD_V_39 : 332|1@1+ (1,0) [0|1] "bool"  ACM
 SG_ OBJ_Abs_Acceleration_39 : 336|9@1+ (0.05,-10.3) [-10.3|7.3] "MPS2"  ACM
 SG_ OBJ_Abs_Acceleration_V_39 : 345|1@1+ (1,0) [0|1] "bool"  ACM
 SG_ OBJ_Abs_Acc_STD_39 : 346|8@1+ (0.05,0) [0|7.3] "MPS2"  ACM
 SG_ OBJ_Abs_Acc_STD_V_39 : 354|1@1+ (1,0) [0|1] "bool"  ACM
 SG_ OBJ_Inv_TTC_39 : 355|11@1+ (0.01,-8) [-8|8] "INV(s)"  ACM
 SG_ OBJ_Inv_TTC_V_39 : 366|1@1+ (1,0) [0|1] "bool"  ACM
 SG_ OBJ_Inv_TTC_STD_39 : 368|11@1+ (0.01,0) [0|4] "INV(s)"  ACM
 SG_ OBJ_Inv_TTC_STD_V_39 : 379|1@1+ (1,0) [0|1] "bool"  ACM
 SG_ OBJ_Relative_Long_Acc_39 : 380|9@1+ (0.05,-10.3) [-10.3|7.3] "MPS2"  ACM
 SG_ OBJ_Relative_Long_Acc_V_39 : 389|1@1+ (1,0) [0|1] "bool"  ACM
 SG_ OBJ_Relative_Long_Acc_STD_39 : 390|8@1+ (0.05,0) [0|7.3] "MPS2"  ACM
 SG_ OBJ_Rel_Long_Acc_STD_V_39 : 398|1@1+ (1,0) [0|1] "bool"  ACM

BO_ 222 ICM_Object_Prot38_B: 64 MyECU
 SG_ ICM_Object_Prot38_B_Header : 0|16@1+ (1,0) [0|65535] ""  ACM
 SG_ OBJ_Relative_Long_Velocity_38 : 16|13@1+ (0.05,-120) [-120|130] "MPS"  ACM
 SG_ OBJ_Relative_Long_Velocity_V_38 : 29|1@1+ (1,0) [0|1] "bool"  ACM
 SG_ OBJ_Relative_Long_Vel_STD_38 : 30|12@1+ (0.05,0) [0|130] "MPS"  ACM
 SG_ OBJ_Rel_Long_Vel_STD_V_38 : 42|1@1+ (1,0) [0|1] "bool"  ACM
 SG_ OBJ_Relative_Lat_Velocity_38 : 48|11@1+ (0.05,-50) [-50|50] "MPS"  ACM
 SG_ OBJ_Relative_Lat_Velocity_V_38 : 59|1@1+ (1,0) [0|1] "bool"  ACM
 SG_ OBJ_Relative_Lat_Velocity_STD_38 : 60|10@1+ (0.05,0) [0|50] "MPS"  ACM
 SG_ OBJ_Rel_Lat_Vel_STD_V_38 : 70|1@1+ (1,0) [0|1] "bool"  ACM
 SG_ OBJ_Long_Distance_38 : 80|14@1+ (0.05,-200) [-200|250] "m"  ACM
 SG_ OBJ_Long_Distance_V_38 : 94|1@1+ (1,0) [0|1] "bool"  ACM
 SG_ OBJ_Long_Distance_STD_38 : 95|13@1+ (0.05,0) [0|250] "m"  ACM
 SG_ OBJ_Long_Distance_STD_V_38 : 108|1@1+ (1,0) [0|1] "bool"  ACM
 SG_ OBJ_Lat_Distance_38 : 112|12@1+ (0.05,-100) [-100|100] "m"  ACM
 SG_ OBJ_Lat_Distance_V_38 : 124|1@1+ (1,0) [0|1] "bool"  ACM
 SG_ OBJ_Lat_Distance_STD_38 : 125|11@1+ (0.05,0) [0|100] "m"  ACM
 SG_ OBJ_Lat_Distance_STD_V_38 : 136|1@1+ (1,0) [0|1] "bool"  ACM
 SG_ OBJ_Absolute_Speed_38 : 144|12@1+ (0.05,-65) [-65|65] "MPS"  ACM
 SG_ OBJ_Absolute_Speed_V_38 : 156|1@1+ (1,0) [0|1] "bool"  ACM
 SG_ OBJ_Absolute_Speed_STD_38 : 157|11@1+ (0.05,-65) [0|65] "MPS"  ACM
 SG_ OBJ_Absolute_Speed_STD_V_38 : 168|1@1+ (1,0) [0|1] "bool"  ACM
 SG_ OBJ_Heading_38 : 176|10@1+ (0.01,-3.14) [-3.14|3.14] "rad"  ACM
 SG_ OBJ_Heading_V_38 : 186|1@1+ (1,0) [0|1] "bool"  ACM
 SG_ OBJ_Heading_STD_38 : 187|9@1+ (0.01,0) [0|3.14] "rad"  ACM
 SG_ OBJ_Heading_STD_V_38 : 196|1@1+ (1,0) [0|1] "bool"  ACM
 SG_ OBJ_Angle_Rate_STD_38 : 197|11@1+ (0.002,0) [0|2.2318] "RPS"  ACM
 SG_ OBJ_Angle_Rate_STD_V_38 : 208|1@1+ (1,0) [0|1] "bool"  ACM
 SG_ OBJ_Angle_Rate_38 : 209|12@1+ (0.002,-2.234) [-2.234|2.2318] "RPS"  ACM
 SG_ OBJ_Angle_Rate_V_38 : 221|1@1+ (1,0) [0|1] "bool"  ACM
 SG_ OBJ_Angle_Right_38 : 222|14@1+ (0.0002,-1.571) [-1.571|1.571] "rad "  ACM
 SG_ OBJ_Angle_Right_V_38 : 236|1@1+ (1,0) [0|1] "bool"  ACM
 SG_ OBJ_Angle_Right_STD_38 : 240|13@1+ (0.0002,0) [0|1.571] "rad "  ACM
 SG_ OBJ_Angle_Right_STD_V_38 : 253|1@1+ (1,0) [0|1] "bool"  ACM
 SG_ OBJ_Angle_Left_38 : 254|14@1+ (0.0002,-1.571) [-1.571|1.571] "rad "  ACM
 SG_ OBJ_Angle_Left_V_38 : 268|1@1+ (1,0) [0|1] "bool"  ACM
 SG_ OBJ_Angle_Left_STD_38 : 272|13@1+ (0.0002,0) [0|1.571] "rad"  ACM
 SG_ OBJ_Angle_Left_STD_V_38 : 285|1@1+ (1,0) [0|1] "bool"  ACM
 SG_ OBJ_Angle_Side_38 : 286|14@1+ (0.0002,-1.571) [-1.571|1.571] "rad"  ACM
 SG_ OBJ_Angle_Side_V_38 : 300|1@1+ (1,0) [0|1] "bool"  ACM
 SG_ OBJ_Angle_Side_STD_38 : 304|13@1+ (0.0002,0) [0|1.571] "rad"  ACM
 SG_ OBJ_Angle_Side_STD_V_38 : 317|1@1+ (1,0) [0|1] "bool"  ACM
 SG_ OBJ_Angle_Mid_V_38 : 318|1@1+ (1,0) [0|1] "bool"  ACM
 SG_ OBJ_Angle_Mid_38 : 319|14@1+ (0.0002,-1.571) [-1.571|1.571] "rad"  ACM
 SG_ OBJ_Angle_Mid_STD_38 : 336|13@1+ (0.0002,0) [0|1.571] "rad"  ACM
 SG_ OBJ_Angle_Mid_STD_V_38 : 349|1@1+ (1,0) [0|1] "bool"  ACM
 SG_ OBJ_Angle_Bottom_V_38 : 350|1@1+ (1,0) [0|1] "bool"  ACM
 SG_ OBJ_Angle_Bottom_38 : 351|14@1+ (0.0002,-1.571) [-1.571|1.571] "rad"  ACM
 SG_ OBJ_Angle_Bottom_STD_38 : 368|13@1+ (0.0002,0) [0|1.571] "rad"  ACM
 SG_ OBJ_Angle_Bottom_STD_V_38 : 381|1@1+ (1,0) [0|1] "bool"  ACM
 SG_ OBJ_Visibility_Side_V_38 : 382|1@1+ (1,0) [0|1] "bool"  ACM
 SG_ OBJ_Visibility_Side_38 : 383|2@1+ (1,0) [0|2] "ENUM"  ACM
 SG_ OBJ_Is_In_Drivable_Area_38 : 385|1@1+ (1,0) [0|1] "bool"  ACM
 SG_ OBJ_Is_In_Drivable_Area_V_38 : 386|1@1+ (1,0) [0|1] "bool"  ACM
 SG_ OBJ_Is_VeryClose_38 : 387|1@1+ (1,0) [0|1] "bool"  ACM
 SG_ OBJ_Is_VeryClose_V_38 : 388|1@1+ (1,0) [0|1] "bool"  ACM
 SG_ OBJ_Buffer_38 : 389|11@1+ (1,0) [0|0] "NA"  ACM

BO_ 221 ICM_Object_Prot38_A: 64 MyECU
 SG_ ICM_Object_Prot38_A_Header : 0|16@1+ (1,0) [0|65535] ""  ACM
 SG_ OBJ_CRC_38 : 16|32@1+ (1,0) [0|4294967295] "NA"  ACM
 SG_ OBJ_ID_38 : 48|8@1+ (1,0) [0|255] "NA"  ACM
 SG_ OBJ_Existence_Probability_38 : 56|8@1+ (0.01,0) [0|1] "NA"  ACM
 SG_ OBJ_Fusion_Source_38 : 64|16@1+ (1,0) [0|65535] "BITWIZE"  ACM
 SG_ OBJ_Triggered_SDM_38 : 80|2@1+ (1,0) [0|2] "ENUM"  ACM
 SG_ OBJ_Motion_Category_38 : 82|4@1+ (1,0) [0|13] "ENUM "  ACM
 SG_ OBJ_Moving_IN_Probability_38 : 86|7@1+ (0.01,0) [0|0] "NA"  ACM
 SG_ OBJ_Object_Age_38 : 93|11@1+ (1,0) [0|2047] "Frame"  ACM
 SG_ OBJ_Measuring_Status_38 : 104|3@1+ (1,0) [0|7] "BITWIZE"  ACM
 SG_ OBJ_Object_Class_38 : 107|4@1+ (1,0) [0|8] "ENUM"  ACM
 SG_ OBJ_Class_Probability_38 : 112|7@1+ (0.01,0) [0|1] "NA"  ACM
 SG_ OBJ_Car_Probability_38 : 119|7@1+ (0.01,0) [0|0] "NA"  ACM
 SG_ OBJ_Truck_Probability_38 : 126|7@1+ (0.01,0) [0|0] "NA"  ACM
 SG_ OBJ_Bike_Probability_38 : 133|7@1+ (0.01,0) [0|0] "NA"  ACM
 SG_ OBJ_Camera_Source_38 : 140|4@1+ (1,0) [0|15] "ENUM"  ACM
 SG_ OBJ_Motion_Status_38 : 144|3@1+ (1,0) [0|5] "ENUM "  ACM
 SG_ OBJ_Motion_Orientation_38 : 147|4@1+ (1,0) [0|13] "ENUM "  ACM
 SG_ OBJ_Has_Cut_Lane_38 : 151|1@1+ (1,0) [0|1] "bool"  ACM
 SG_ OBJ_Has_Cut_Path_38 : 152|1@1+ (1,0) [0|1] "bool"  ACM
 SG_ OBJ_Brake_Light_38 : 153|1@1+ (1,0) [0|1] "bool"  ACM
 SG_ OBJ_Turn_Indicator_Right_38 : 154|1@1+ (1,0) [0|1] "bool"  ACM
 SG_ OBJ_Turn_Indicator_Left_38 : 155|1@1+ (1,0) [0|1] "bool"  ACM
 SG_ OBJ_Light_Indicator_Validity_38 : 156|1@1+ (1,0) [0|1] "bool"  ACM
 SG_ OBJ_Right_Out_Of_Image_38 : 157|1@1+ (1,0) [0|1] "bool"  ACM
 SG_ OBJ_Left_Out_Of_Image_38 : 158|1@1+ (1,0) [0|1] "bool"  ACM
 SG_ OBJ_Right_Out_Of_Image_V_38 : 159|1@1+ (1,0) [0|1] "bool"  ACM
 SG_ OBJ_Left_Out_Of_Image_V_38 : 160|1@1+ (1,0) [0|1] "bool"  ACM
 SG_ OBJ_Top_Out_Of_Image_38 : 161|1@1+ (1,0) [0|1] "bool"  ACM
 SG_ OBJ_Bottom_Out_Of_Image_38 : 162|1@1+ (1,0) [0|1] "bool"  ACM
 SG_ OBJ_Top_Out_Of_Image_V_38 : 163|1@1+ (1,0) [0|1] "bool"  ACM
 SG_ OBJ_Bottom_Out_Of_Image_V_38 : 164|1@1+ (1,0) [0|1] "bool"  ACM
 SG_ OBJ_Lane_Assignment_38 : 165|3@1+ (1,0) [0|5] "ENUM"  ACM
 SG_ OBJ_Lane_Assignment_V_38 : 168|1@1+ (1,0) [0|1] "bool"  ACM
 SG_ OBJ_Age_Seconds_38 : 169|7@1+ (1,0) [0|100] "s"  ACM
 SG_ OBJ_Age_Seconds_V_38 : 176|1@1+ (1,0) [0|1] "bool"  ACM
 SG_ OBJ_Width_38 : 177|9@1+ (0.01,0) [0.4|2.95] "m"  ACM
 SG_ OBJ_Width_V_38 : 186|1@1+ (1,0) [0|1] "bool"  ACM
 SG_ OBJ_Width_STD_38 : 187|8@1+ (0.01,0) [0|2] "m"  ACM
 SG_ OBJ_Width_STD_V_38 : 195|1@1+ (1,0) [0|1] "bool"  ACM
 SG_ OBJ_Length_38 : 196|9@1+ (0.05,0) [1.2|21] "m"  ACM
 SG_ OBJ_Length_V_38 : 205|1@1+ (1,0) [0|1] "bool"  ACM
 SG_ OBJ_Length_STD_38 : 208|8@1+ (0.05,0) [0|10] "m"  ACM
 SG_ OBJ_Length_STD_V_38 : 216|1@1+ (1,0) [0|1] "bool"  ACM
 SG_ OBJ_Height_38 : 217|9@1+ (0.01,0) [0|2.95] "m"  ACM
 SG_ OBJ_Height_V_38 : 226|1@1+ (1,0) [0|1] "bool"  ACM
 SG_ OBJ_Height_STD_38 : 227|8@1+ (0.01,0) [0|2] "m"  ACM
 SG_ OBJ_Height_STD_V_38 : 235|1@1+ (1,0) [0|1] "bool"  ACM
 SG_ OBJ_Abs_Long_Velocity_38 : 240|12@1+ (0.05,-30) [-30|100] "MPS"  ACM
 SG_ OBJ_Abs_Long_Velocity_V_38 : 252|1@1+ (1,0) [0|1] "bool"  ACM
 SG_ OBJ_Abs_Long_Velocity_STD_38 : 253|11@1+ (0.05,0) [0|65] "MPS"  ACM
 SG_ OBJ_Abs_Long_Vel_STD_V_38 : 264|1@1+ (1,0) [0|1] "bool"  ACM
 SG_ OBJ_Abs_Lat_Velocity_38 : 272|11@1+ (0.05,-50) [-50|50] "MPS"  ACM
 SG_ OBJ_Abs_Lat_Velocity_V_38 : 283|1@1+ (1,0) [0|1] "bool"  ACM
 SG_ OBJ_Abs_Lat_Velocity_STD_38 : 284|10@1+ (0.05,0) [0|50] "MPS"  ACM
 SG_ OBJ_Abs_Lat_Vel_STD_V_38 : 294|1@1+ (1,0) [0|1] "bool"  ACM
 SG_ OBJ_Abs_Long_Acc_38 : 295|9@1+ (0.05,-10.3) [-10.3|7.3] "MPS2"  ACM
 SG_ OBJ_Abs_Long_Acc_V_38 : 304|1@1+ (1,0) [0|1] "bool"  ACM
 SG_ OBJ_Abs_Long_Acc_STD_38 : 305|8@1+ (0.05,0) [0|7.3] "MPS2"  ACM
 SG_ OBJ_Abs_Long_Acc_STD_V_38 : 313|1@1+ (1,0) [0|1] "bool"  ACM
 SG_ OBJ_Abs_Lat_Acc_38 : 314|9@1+ (0.05,-10.3) [-10.3|7.3] "MPS2"  ACM
 SG_ OBJ_Abs_Lat_Acc_V_38 : 323|1@1+ (1,0) [0|1] "bool"  ACM
 SG_ OBJ_Abs_Lat_Acc_STD_38 : 324|8@1+ (0.05,0) [0|7.3] "MPS2"  ACM
 SG_ OBJ_Abs_Lat_Acc_STD_V_38 : 332|1@1+ (1,0) [0|1] "bool"  ACM
 SG_ OBJ_Abs_Acceleration_38 : 336|9@1+ (0.05,-10.3) [-10.3|7.3] "MPS2"  ACM
 SG_ OBJ_Abs_Acceleration_V_38 : 345|1@1+ (1,0) [0|1] "bool"  ACM
 SG_ OBJ_Abs_Acc_STD_38 : 346|8@1+ (0.05,0) [0|7.3] "MPS2"  ACM
 SG_ OBJ_Abs_Acc_STD_V_38 : 354|1@1+ (1,0) [0|1] "bool"  ACM
 SG_ OBJ_Inv_TTC_38 : 355|11@1+ (0.01,-8) [-8|8] "INV(s)"  ACM
 SG_ OBJ_Inv_TTC_V_38 : 366|1@1+ (1,0) [0|1] "bool"  ACM
 SG_ OBJ_Inv_TTC_STD_38 : 368|11@1+ (0.01,0) [0|4] "INV(s)"  ACM
 SG_ OBJ_Inv_TTC_STD_V_38 : 379|1@1+ (1,0) [0|1] "bool"  ACM
 SG_ OBJ_Relative_Long_Acc_38 : 380|9@1+ (0.05,-10.3) [-10.3|7.3] "MPS2"  ACM
 SG_ OBJ_Relative_Long_Acc_V_38 : 389|1@1+ (1,0) [0|1] "bool"  ACM
 SG_ OBJ_Relative_Long_Acc_STD_38 : 390|8@1+ (0.05,0) [0|7.3] "MPS2"  ACM
 SG_ OBJ_Rel_Long_Acc_STD_V_38 : 398|1@1+ (1,0) [0|1] "bool"  ACM

BO_ 220 ICM_Object_Prot37_B: 64 MyECU
 SG_ ICM_Object_Prot37_B_Header : 0|16@1+ (1,0) [0|65535] ""  ACM
 SG_ OBJ_Relative_Long_Velocity_37 : 16|13@1+ (0.05,-120) [-120|130] "MPS"  ACM
 SG_ OBJ_Relative_Long_Velocity_V_37 : 29|1@1+ (1,0) [0|1] "bool"  ACM
 SG_ OBJ_Relative_Long_Vel_STD_37 : 30|12@1+ (0.05,0) [0|130] "MPS"  ACM
 SG_ OBJ_Rel_Long_Vel_STD_V_37 : 42|1@1+ (1,0) [0|1] "bool"  ACM
 SG_ OBJ_Relative_Lat_Velocity_37 : 48|11@1+ (0.05,-50) [-50|50] "MPS"  ACM
 SG_ OBJ_Relative_Lat_Velocity_V_37 : 59|1@1+ (1,0) [0|1] "bool"  ACM
 SG_ OBJ_Relative_Lat_Velocity_STD_37 : 60|10@1+ (0.05,0) [0|50] "MPS"  ACM
 SG_ OBJ_Rel_Lat_Vel_STD_V_37 : 70|1@1+ (1,0) [0|1] "bool"  ACM
 SG_ OBJ_Long_Distance_37 : 80|14@1+ (0.05,-200) [-200|250] "m"  ACM
 SG_ OBJ_Long_Distance_V_37 : 94|1@1+ (1,0) [0|1] "bool"  ACM
 SG_ OBJ_Long_Distance_STD_37 : 95|13@1+ (0.05,0) [0|250] "m"  ACM
 SG_ OBJ_Long_Distance_STD_V_37 : 108|1@1+ (1,0) [0|1] "bool"  ACM
 SG_ OBJ_Lat_Distance_37 : 112|12@1+ (0.05,-100) [-100|100] "m"  ACM
 SG_ OBJ_Lat_Distance_V_37 : 124|1@1+ (1,0) [0|1] "bool"  ACM
 SG_ OBJ_Lat_Distance_STD_37 : 125|11@1+ (0.05,0) [0|100] "m"  ACM
 SG_ OBJ_Lat_Distance_STD_V_37 : 136|1@1+ (1,0) [0|1] "bool"  ACM
 SG_ OBJ_Absolute_Speed_37 : 144|12@1+ (0.05,-65) [-65|65] "MPS"  ACM
 SG_ OBJ_Absolute_Speed_V_37 : 156|1@1+ (1,0) [0|1] "bool"  ACM
 SG_ OBJ_Absolute_Speed_STD_37 : 157|11@1+ (0.05,-65) [0|65] "MPS"  ACM
 SG_ OBJ_Absolute_Speed_STD_V_37 : 168|1@1+ (1,0) [0|1] "bool"  ACM
 SG_ OBJ_Heading_37 : 176|10@1+ (0.01,-3.14) [-3.14|3.14] "rad"  ACM
 SG_ OBJ_Heading_V_37 : 186|1@1+ (1,0) [0|1] "bool"  ACM
 SG_ OBJ_Heading_STD_37 : 187|9@1+ (0.01,0) [0|3.14] "rad"  ACM
 SG_ OBJ_Heading_STD_V_37 : 196|1@1+ (1,0) [0|1] "bool"  ACM
 SG_ OBJ_Angle_Rate_STD_37 : 197|11@1+ (0.002,0) [0|2.2318] "RPS"  ACM
 SG_ OBJ_Angle_Rate_STD_V_37 : 208|1@1+ (1,0) [0|1] "bool"  ACM
 SG_ OBJ_Angle_Rate_37 : 209|12@1+ (0.002,-2.234) [-2.234|2.2318] "RPS"  ACM
 SG_ OBJ_Angle_Rate_V_37 : 221|1@1+ (1,0) [0|1] "bool"  ACM
 SG_ OBJ_Angle_Right_37 : 222|14@1+ (0.0002,-1.571) [-1.571|1.571] "rad "  ACM
 SG_ OBJ_Angle_Right_V_37 : 236|1@1+ (1,0) [0|1] "bool"  ACM
 SG_ OBJ_Angle_Right_STD_37 : 240|13@1+ (0.0002,0) [0|1.571] "rad "  ACM
 SG_ OBJ_Angle_Right_STD_V_37 : 253|1@1+ (1,0) [0|1] "bool"  ACM
 SG_ OBJ_Angle_Left_37 : 254|14@1+ (0.0002,-1.571) [-1.571|1.571] "rad "  ACM
 SG_ OBJ_Angle_Left_V_37 : 268|1@1+ (1,0) [0|1] "bool"  ACM
 SG_ OBJ_Angle_Left_STD_37 : 272|13@1+ (0.0002,0) [0|1.571] "rad"  ACM
 SG_ OBJ_Angle_Left_STD_V_37 : 285|1@1+ (1,0) [0|1] "bool"  ACM
 SG_ OBJ_Angle_Side_37 : 286|14@1+ (0.0002,-1.571) [-1.571|1.571] "rad"  ACM
 SG_ OBJ_Angle_Side_V_37 : 300|1@1+ (1,0) [0|1] "bool"  ACM
 SG_ OBJ_Angle_Side_STD_37 : 304|13@1+ (0.0002,0) [0|1.571] "rad"  ACM
 SG_ OBJ_Angle_Side_STD_V_37 : 317|1@1+ (1,0) [0|1] "bool"  ACM
 SG_ OBJ_Angle_Mid_V_37 : 318|1@1+ (1,0) [0|1] "bool"  ACM
 SG_ OBJ_Angle_Mid_37 : 319|14@1+ (0.0002,-1.571) [-1.571|1.571] "rad"  ACM
 SG_ OBJ_Angle_Mid_STD_37 : 336|13@1+ (0.0002,0) [0|1.571] "rad"  ACM
 SG_ OBJ_Angle_Mid_STD_V_37 : 349|1@1+ (1,0) [0|1] "bool"  ACM
 SG_ OBJ_Angle_Bottom_V_37 : 350|1@1+ (1,0) [0|1] "bool"  ACM
 SG_ OBJ_Angle_Bottom_37 : 351|14@1+ (0.0002,-1.571) [-1.571|1.571] "rad"  ACM
 SG_ OBJ_Angle_Bottom_STD_37 : 368|13@1+ (0.0002,0) [0|1.571] "rad"  ACM
 SG_ OBJ_Angle_Bottom_STD_V_37 : 381|1@1+ (1,0) [0|1] "bool"  ACM
 SG_ OBJ_Visibility_Side_V_37 : 382|1@1+ (1,0) [0|1] "bool"  ACM
 SG_ OBJ_Visibility_Side_37 : 383|2@1+ (1,0) [0|2] "ENUM"  ACM
 SG_ OBJ_Is_In_Drivable_Area_37 : 385|1@1+ (1,0) [0|1] "bool"  ACM
 SG_ OBJ_Is_In_Drivable_Area_V_37 : 386|1@1+ (1,0) [0|1] "bool"  ACM
 SG_ OBJ_Is_VeryClose_37 : 387|1@1+ (1,0) [0|1] "bool"  ACM
 SG_ OBJ_Is_VeryClose_V_37 : 388|1@1+ (1,0) [0|1] "bool"  ACM
 SG_ OBJ_Buffer_37 : 389|11@1+ (1,0) [0|0] "NA"  ACM

BO_ 219 ICM_Object_Prot37_A: 64 MyECU
 SG_ ICM_Object_Prot37_A_Header : 0|16@1+ (1,0) [0|65535] ""  ACM
 SG_ OBJ_CRC_37 : 16|32@1+ (1,0) [0|4294967295] "NA"  ACM
 SG_ OBJ_ID_37 : 48|8@1+ (1,0) [0|255] "NA"  ACM
 SG_ OBJ_Existence_Probability_37 : 56|8@1+ (0.01,0) [0|1] "NA"  ACM
 SG_ OBJ_Fusion_Source_37 : 64|16@1+ (1,0) [0|65535] "BITWIZE"  ACM
 SG_ OBJ_Triggered_SDM_37 : 80|2@1+ (1,0) [0|2] "ENUM"  ACM
 SG_ OBJ_Motion_Category_37 : 82|4@1+ (1,0) [0|13] "ENUM "  ACM
 SG_ OBJ_Moving_IN_Probability_37 : 86|7@1+ (0.01,0) [0|0] "NA"  ACM
 SG_ OBJ_Object_Age_37 : 93|11@1+ (1,0) [0|2047] "Frame"  ACM
 SG_ OBJ_Measuring_Status_37 : 104|3@1+ (1,0) [0|7] "BITWIZE"  ACM
 SG_ OBJ_Object_Class_37 : 107|4@1+ (1,0) [0|8] "ENUM"  ACM
 SG_ OBJ_Class_Probability_37 : 112|7@1+ (0.01,0) [0|1] "NA"  ACM
 SG_ OBJ_Car_Probability_37 : 119|7@1+ (0.01,0) [0|0] "NA"  ACM
 SG_ OBJ_Truck_Probability_37 : 126|7@1+ (0.01,0) [0|0] "NA"  ACM
 SG_ OBJ_Bike_Probability_37 : 133|7@1+ (0.01,0) [0|0] "NA"  ACM
 SG_ OBJ_Camera_Source_37 : 140|4@1+ (1,0) [0|15] "ENUM"  ACM
 SG_ OBJ_Motion_Status_37 : 144|3@1+ (1,0) [0|5] "ENUM "  ACM
 SG_ OBJ_Motion_Orientation_37 : 147|4@1+ (1,0) [0|13] "ENUM "  ACM
 SG_ OBJ_Has_Cut_Lane_37 : 151|1@1+ (1,0) [0|1] "bool"  ACM
 SG_ OBJ_Has_Cut_Path_37 : 152|1@1+ (1,0) [0|1] "bool"  ACM
 SG_ OBJ_Brake_Light_37 : 153|1@1+ (1,0) [0|1] "bool"  ACM
 SG_ OBJ_Turn_Indicator_Right_37 : 154|1@1+ (1,0) [0|1] "bool"  ACM
 SG_ OBJ_Turn_Indicator_Left_37 : 155|1@1+ (1,0) [0|1] "bool"  ACM
 SG_ OBJ_Light_Indicator_Validity_37 : 156|1@1+ (1,0) [0|1] "bool"  ACM
 SG_ OBJ_Right_Out_Of_Image_37 : 157|1@1+ (1,0) [0|1] "bool"  ACM
 SG_ OBJ_Left_Out_Of_Image_37 : 158|1@1+ (1,0) [0|1] "bool"  ACM
 SG_ OBJ_Right_Out_Of_Image_V_37 : 159|1@1+ (1,0) [0|1] "bool"  ACM
 SG_ OBJ_Left_Out_Of_Image_V_37 : 160|1@1+ (1,0) [0|1] "bool"  ACM
 SG_ OBJ_Top_Out_Of_Image_37 : 161|1@1+ (1,0) [0|1] "bool"  ACM
 SG_ OBJ_Bottom_Out_Of_Image_37 : 162|1@1+ (1,0) [0|1] "bool"  ACM
 SG_ OBJ_Top_Out_Of_Image_V_37 : 163|1@1+ (1,0) [0|1] "bool"  ACM
 SG_ OBJ_Bottom_Out_Of_Image_V_37 : 164|1@1+ (1,0) [0|1] "bool"  ACM
 SG_ OBJ_Lane_Assignment_37 : 165|3@1+ (1,0) [0|5] "ENUM"  ACM
 SG_ OBJ_Lane_Assignment_V_37 : 168|1@1+ (1,0) [0|1] "bool"  ACM
 SG_ OBJ_Age_Seconds_37 : 169|7@1+ (1,0) [0|100] "s"  ACM
 SG_ OBJ_Age_Seconds_V_37 : 176|1@1+ (1,0) [0|1] "bool"  ACM
 SG_ OBJ_Width_37 : 177|9@1+ (0.01,0) [0.4|2.95] "m"  ACM
 SG_ OBJ_Width_V_37 : 186|1@1+ (1,0) [0|1] "bool"  ACM
 SG_ OBJ_Width_STD_37 : 187|8@1+ (0.01,0) [0|2] "m"  ACM
 SG_ OBJ_Width_STD_V_37 : 195|1@1+ (1,0) [0|1] "bool"  ACM
 SG_ OBJ_Length_37 : 196|9@1+ (0.05,0) [1.2|21] "m"  ACM
 SG_ OBJ_Length_V_37 : 205|1@1+ (1,0) [0|1] "bool"  ACM
 SG_ OBJ_Length_STD_37 : 208|8@1+ (0.05,0) [0|10] "m"  ACM
 SG_ OBJ_Length_STD_V_37 : 216|1@1+ (1,0) [0|1] "bool"  ACM
 SG_ OBJ_Height_37 : 217|9@1+ (0.01,0) [0|2.95] "m"  ACM
 SG_ OBJ_Height_V_37 : 226|1@1+ (1,0) [0|1] "bool"  ACM
 SG_ OBJ_Height_STD_37 : 227|8@1+ (0.01,0) [0|2] "m"  ACM
 SG_ OBJ_Height_STD_V_37 : 235|1@1+ (1,0) [0|1] "bool"  ACM
 SG_ OBJ_Abs_Long_Velocity_37 : 240|12@1+ (0.05,-30) [-30|100] "MPS"  ACM
 SG_ OBJ_Abs_Long_Velocity_V_37 : 252|1@1+ (1,0) [0|1] "bool"  ACM
 SG_ OBJ_Abs_Long_Velocity_STD_37 : 253|11@1+ (0.05,0) [0|65] "MPS"  ACM
 SG_ OBJ_Abs_Long_Vel_STD_V_37 : 264|1@1+ (1,0) [0|1] "bool"  ACM
 SG_ OBJ_Abs_Lat_Velocity_37 : 272|11@1+ (0.05,-50) [-50|50] "MPS"  ACM
 SG_ OBJ_Abs_Lat_Velocity_V_37 : 283|1@1+ (1,0) [0|1] "bool"  ACM
 SG_ OBJ_Abs_Lat_Velocity_STD_37 : 284|10@1+ (0.05,0) [0|50] "MPS"  ACM
 SG_ OBJ_Abs_Lat_Vel_STD_V_37 : 294|1@1+ (1,0) [0|1] "bool"  ACM
 SG_ OBJ_Abs_Long_Acc_37 : 295|9@1+ (0.05,-10.3) [-10.3|7.3] "MPS2"  ACM
 SG_ OBJ_Abs_Long_Acc_V_37 : 304|1@1+ (1,0) [0|1] "bool"  ACM
 SG_ OBJ_Abs_Long_Acc_STD_37 : 305|8@1+ (0.05,0) [0|7.3] "MPS2"  ACM
 SG_ OBJ_Abs_Long_Acc_STD_V_37 : 313|1@1+ (1,0) [0|1] "bool"  ACM
 SG_ OBJ_Abs_Lat_Acc_37 : 314|9@1+ (0.05,-10.3) [-10.3|7.3] "MPS2"  ACM
 SG_ OBJ_Abs_Lat_Acc_V_37 : 323|1@1+ (1,0) [0|1] "bool"  ACM
 SG_ OBJ_Abs_Lat_Acc_STD_37 : 324|8@1+ (0.05,0) [0|7.3] "MPS2"  ACM
 SG_ OBJ_Abs_Lat_Acc_STD_V_37 : 332|1@1+ (1,0) [0|1] "bool"  ACM
 SG_ OBJ_Abs_Acceleration_37 : 336|9@1+ (0.05,-10.3) [-10.3|7.3] "MPS2"  ACM
 SG_ OBJ_Abs_Acceleration_V_37 : 345|1@1+ (1,0) [0|1] "bool"  ACM
 SG_ OBJ_Abs_Acc_STD_37 : 346|8@1+ (0.05,0) [0|7.3] "MPS2"  ACM
 SG_ OBJ_Abs_Acc_STD_V_37 : 354|1@1+ (1,0) [0|1] "bool"  ACM
 SG_ OBJ_Inv_TTC_37 : 355|11@1+ (0.01,-8) [-8|8] "INV(s)"  ACM
 SG_ OBJ_Inv_TTC_V_37 : 366|1@1+ (1,0) [0|1] "bool"  ACM
 SG_ OBJ_Inv_TTC_STD_37 : 368|11@1+ (0.01,0) [0|4] "INV(s)"  ACM
 SG_ OBJ_Inv_TTC_STD_V_37 : 379|1@1+ (1,0) [0|1] "bool"  ACM
 SG_ OBJ_Relative_Long_Acc_37 : 380|9@1+ (0.05,-10.3) [-10.3|7.3] "MPS2"  ACM
 SG_ OBJ_Relative_Long_Acc_V_37 : 389|1@1+ (1,0) [0|1] "bool"  ACM
 SG_ OBJ_Relative_Long_Acc_STD_37 : 390|8@1+ (0.05,0) [0|7.3] "MPS2"  ACM
 SG_ OBJ_Rel_Long_Acc_STD_V_37 : 398|1@1+ (1,0) [0|1] "bool"  ACM

BO_ 218 ICM_Object_Prot36_B: 64 MyECU
 SG_ ICM_Object_Prot36_B_Header : 0|16@1+ (1,0) [0|65535] ""  ACM
 SG_ OBJ_Relative_Long_Velocity_36 : 16|13@1+ (0.05,-120) [-120|130] "MPS"  ACM
 SG_ OBJ_Relative_Long_Velocity_V_36 : 29|1@1+ (1,0) [0|1] "bool"  ACM
 SG_ OBJ_Relative_Long_Vel_STD_36 : 30|12@1+ (0.05,0) [0|130] "MPS"  ACM
 SG_ OBJ_Rel_Long_Vel_STD_V_36 : 42|1@1+ (1,0) [0|1] "bool"  ACM
 SG_ OBJ_Relative_Lat_Velocity_36 : 48|11@1+ (0.05,-50) [-50|50] "MPS"  ACM
 SG_ OBJ_Relative_Lat_Velocity_V_36 : 59|1@1+ (1,0) [0|1] "bool"  ACM
 SG_ OBJ_Relative_Lat_Velocity_STD_36 : 60|10@1+ (0.05,0) [0|50] "MPS"  ACM
 SG_ OBJ_Rel_Lat_Vel_STD_V_36 : 70|1@1+ (1,0) [0|1] "bool"  ACM
 SG_ OBJ_Long_Distance_36 : 80|14@1+ (0.05,-200) [-200|250] "m"  ACM
 SG_ OBJ_Long_Distance_V_36 : 94|1@1+ (1,0) [0|1] "bool"  ACM
 SG_ OBJ_Long_Distance_STD_36 : 95|13@1+ (0.05,0) [0|250] "m"  ACM
 SG_ OBJ_Long_Distance_STD_V_36 : 108|1@1+ (1,0) [0|1] "bool"  ACM
 SG_ OBJ_Lat_Distance_36 : 112|12@1+ (0.05,-100) [-100|100] "m"  ACM
 SG_ OBJ_Lat_Distance_V_36 : 124|1@1+ (1,0) [0|1] "bool"  ACM
 SG_ OBJ_Lat_Distance_STD_36 : 125|11@1+ (0.05,0) [0|100] "m"  ACM
 SG_ OBJ_Lat_Distance_STD_V_36 : 136|1@1+ (1,0) [0|1] "bool"  ACM
 SG_ OBJ_Absolute_Speed_36 : 144|12@1+ (0.05,-65) [-65|65] "MPS"  ACM
 SG_ OBJ_Absolute_Speed_V_36 : 156|1@1+ (1,0) [0|1] "bool"  ACM
 SG_ OBJ_Absolute_Speed_STD_36 : 157|11@1+ (0.05,-65) [0|65] "MPS"  ACM
 SG_ OBJ_Absolute_Speed_STD_V_36 : 168|1@1+ (1,0) [0|1] "bool"  ACM
 SG_ OBJ_Heading_36 : 176|10@1+ (0.01,-3.14) [-3.14|3.14] "rad"  ACM
 SG_ OBJ_Heading_V_36 : 186|1@1+ (1,0) [0|1] "bool"  ACM
 SG_ OBJ_Heading_STD_36 : 187|9@1+ (0.01,0) [0|3.14] "rad"  ACM
 SG_ OBJ_Heading_STD_V_36 : 196|1@1+ (1,0) [0|1] "bool"  ACM
 SG_ OBJ_Angle_Rate_STD_36 : 197|11@1+ (0.002,0) [0|2.2318] "RPS"  ACM
 SG_ OBJ_Angle_Rate_STD_V_36 : 208|1@1+ (1,0) [0|1] "bool"  ACM
 SG_ OBJ_Angle_Rate_36 : 209|12@1+ (0.002,-2.234) [-2.234|2.2318] "RPS"  ACM
 SG_ OBJ_Angle_Rate_V_36 : 221|1@1+ (1,0) [0|1] "bool"  ACM
 SG_ OBJ_Angle_Right_36 : 222|14@1+ (0.0002,-1.571) [-1.571|1.571] "rad "  ACM
 SG_ OBJ_Angle_Right_V_36 : 236|1@1+ (1,0) [0|1] "bool"  ACM
 SG_ OBJ_Angle_Right_STD_36 : 240|13@1+ (0.0002,0) [0|1.571] "rad "  ACM
 SG_ OBJ_Angle_Right_STD_V_36 : 253|1@1+ (1,0) [0|1] "bool"  ACM
 SG_ OBJ_Angle_Left_36 : 254|14@1+ (0.0002,-1.571) [-1.571|1.571] "rad "  ACM
 SG_ OBJ_Angle_Left_V_36 : 268|1@1+ (1,0) [0|1] "bool"  ACM
 SG_ OBJ_Angle_Left_STD_36 : 272|13@1+ (0.0002,0) [0|1.571] "rad"  ACM
 SG_ OBJ_Angle_Left_STD_V_36 : 285|1@1+ (1,0) [0|1] "bool"  ACM
 SG_ OBJ_Angle_Side_36 : 286|14@1+ (0.0002,-1.571) [-1.571|1.571] "rad"  ACM
 SG_ OBJ_Angle_Side_V_36 : 300|1@1+ (1,0) [0|1] "bool"  ACM
 SG_ OBJ_Angle_Side_STD_36 : 304|13@1+ (0.0002,0) [0|1.571] "rad"  ACM
 SG_ OBJ_Angle_Side_STD_V_36 : 317|1@1+ (1,0) [0|1] "bool"  ACM
 SG_ OBJ_Angle_Mid_V_36 : 318|1@1+ (1,0) [0|1] "bool"  ACM
 SG_ OBJ_Angle_Mid_36 : 319|14@1+ (0.0002,-1.571) [-1.571|1.571] "rad"  ACM
 SG_ OBJ_Angle_Mid_STD_36 : 336|13@1+ (0.0002,0) [0|1.571] "rad"  ACM
 SG_ OBJ_Angle_Mid_STD_V_36 : 349|1@1+ (1,0) [0|1] "bool"  ACM
 SG_ OBJ_Angle_Bottom_V_36 : 350|1@1+ (1,0) [0|1] "bool"  ACM
 SG_ OBJ_Angle_Bottom_36 : 351|14@1+ (0.0002,-1.571) [-1.571|1.571] "rad"  ACM
 SG_ OBJ_Angle_Bottom_STD_36 : 368|13@1+ (0.0002,0) [0|1.571] "rad"  ACM
 SG_ OBJ_Angle_Bottom_STD_V_36 : 381|1@1+ (1,0) [0|1] "bool"  ACM
 SG_ OBJ_Visibility_Side_V_36 : 382|1@1+ (1,0) [0|1] "bool"  ACM
 SG_ OBJ_Visibility_Side_36 : 383|2@1+ (1,0) [0|2] "ENUM"  ACM
 SG_ OBJ_Is_In_Drivable_Area_36 : 385|1@1+ (1,0) [0|1] "bool"  ACM
 SG_ OBJ_Is_In_Drivable_Area_V_36 : 386|1@1+ (1,0) [0|1] "bool"  ACM
 SG_ OBJ_Is_VeryClose_36 : 387|1@1+ (1,0) [0|1] "bool"  ACM
 SG_ OBJ_Is_VeryClose_V_36 : 388|1@1+ (1,0) [0|1] "bool"  ACM
 SG_ OBJ_Buffer_36 : 389|11@1+ (1,0) [0|0] "NA"  ACM

BO_ 217 ICM_Object_Prot36_A: 64 MyECU
 SG_ ICM_Object_Prot36_A_Header : 0|16@1+ (1,0) [0|65535] ""  ACM
 SG_ OBJ_CRC_36 : 16|32@1+ (1,0) [0|4294967295] "NA"  ACM
 SG_ OBJ_ID_36 : 48|8@1+ (1,0) [0|255] "NA"  ACM
 SG_ OBJ_Existence_Probability_36 : 56|8@1+ (0.01,0) [0|1] "NA"  ACM
 SG_ OBJ_Fusion_Source_36 : 64|16@1+ (1,0) [0|65535] "BITWIZE"  ACM
 SG_ OBJ_Triggered_SDM_36 : 80|2@1+ (1,0) [0|2] "ENUM"  ACM
 SG_ OBJ_Motion_Category_36 : 82|4@1+ (1,0) [0|13] "ENUM "  ACM
 SG_ OBJ_Moving_IN_Probability_36 : 86|7@1+ (0.01,0) [0|0] "NA"  ACM
 SG_ OBJ_Object_Age_36 : 93|11@1+ (1,0) [0|2047] "Frame"  ACM
 SG_ OBJ_Measuring_Status_36 : 104|3@1+ (1,0) [0|7] "BITWIZE"  ACM
 SG_ OBJ_Object_Class_36 : 107|4@1+ (1,0) [0|8] "ENUM"  ACM
 SG_ OBJ_Class_Probability_36 : 112|7@1+ (0.01,0) [0|1] "NA"  ACM
 SG_ OBJ_Car_Probability_36 : 119|7@1+ (0.01,0) [0|0] "NA"  ACM
 SG_ OBJ_Truck_Probability_36 : 126|7@1+ (0.01,0) [0|0] "NA"  ACM
 SG_ OBJ_Bike_Probability_36 : 133|7@1+ (0.01,0) [0|0] "NA"  ACM
 SG_ OBJ_Camera_Source_36 : 140|4@1+ (1,0) [0|15] "ENUM"  ACM
 SG_ OBJ_Motion_Status_36 : 144|3@1+ (1,0) [0|5] "ENUM "  ACM
 SG_ OBJ_Motion_Orientation_36 : 147|4@1+ (1,0) [0|13] "ENUM "  ACM
 SG_ OBJ_Has_Cut_Lane_36 : 151|1@1+ (1,0) [0|1] "bool"  ACM
 SG_ OBJ_Has_Cut_Path_36 : 152|1@1+ (1,0) [0|1] "bool"  ACM
 SG_ OBJ_Brake_Light_36 : 153|1@1+ (1,0) [0|1] "bool"  ACM
 SG_ OBJ_Turn_Indicator_Right_36 : 154|1@1+ (1,0) [0|1] "bool"  ACM
 SG_ OBJ_Turn_Indicator_Left_36 : 155|1@1+ (1,0) [0|1] "bool"  ACM
 SG_ OBJ_Light_Indicator_Validity_36 : 156|1@1+ (1,0) [0|1] "bool"  ACM
 SG_ OBJ_Right_Out_Of_Image_36 : 157|1@1+ (1,0) [0|1] "bool"  ACM
 SG_ OBJ_Left_Out_Of_Image_36 : 158|1@1+ (1,0) [0|1] "bool"  ACM
 SG_ OBJ_Right_Out_Of_Image_V_36 : 159|1@1+ (1,0) [0|1] "bool"  ACM
 SG_ OBJ_Left_Out_Of_Image_V_36 : 160|1@1+ (1,0) [0|1] "bool"  ACM
 SG_ OBJ_Top_Out_Of_Image_36 : 161|1@1+ (1,0) [0|1] "bool"  ACM
 SG_ OBJ_Bottom_Out_Of_Image_36 : 162|1@1+ (1,0) [0|1] "bool"  ACM
 SG_ OBJ_Top_Out_Of_Image_V_36 : 163|1@1+ (1,0) [0|1] "bool"  ACM
 SG_ OBJ_Bottom_Out_Of_Image_V_36 : 164|1@1+ (1,0) [0|1] "bool"  ACM
 SG_ OBJ_Lane_Assignment_36 : 165|3@1+ (1,0) [0|5] "ENUM"  ACM
 SG_ OBJ_Lane_Assignment_V_36 : 168|1@1+ (1,0) [0|1] "bool"  ACM
 SG_ OBJ_Age_Seconds_36 : 169|7@1+ (1,0) [0|100] "s"  ACM
 SG_ OBJ_Age_Seconds_V_36 : 176|1@1+ (1,0) [0|1] "bool"  ACM
 SG_ OBJ_Width_36 : 177|9@1+ (0.01,0) [0.4|2.95] "m"  ACM
 SG_ OBJ_Width_V_36 : 186|1@1+ (1,0) [0|1] "bool"  ACM
 SG_ OBJ_Width_STD_36 : 187|8@1+ (0.01,0) [0|2] "m"  ACM
 SG_ OBJ_Width_STD_V_36 : 195|1@1+ (1,0) [0|1] "bool"  ACM
 SG_ OBJ_Length_36 : 196|9@1+ (0.05,0) [1.2|21] "m"  ACM
 SG_ OBJ_Length_V_36 : 205|1@1+ (1,0) [0|1] "bool"  ACM
 SG_ OBJ_Length_STD_36 : 208|8@1+ (0.05,0) [0|10] "m"  ACM
 SG_ OBJ_Length_STD_V_36 : 216|1@1+ (1,0) [0|1] "bool"  ACM
 SG_ OBJ_Height_36 : 217|9@1+ (0.01,0) [0|2.95] "m"  ACM
 SG_ OBJ_Height_V_36 : 226|1@1+ (1,0) [0|1] "bool"  ACM
 SG_ OBJ_Height_STD_36 : 227|8@1+ (0.01,0) [0|2] "m"  ACM
 SG_ OBJ_Height_STD_V_36 : 235|1@1+ (1,0) [0|1] "bool"  ACM
 SG_ OBJ_Abs_Long_Velocity_36 : 240|12@1+ (0.05,-30) [-30|100] "MPS"  ACM
 SG_ OBJ_Abs_Long_Velocity_V_36 : 252|1@1+ (1,0) [0|1] "bool"  ACM
 SG_ OBJ_Abs_Long_Velocity_STD_36 : 253|11@1+ (0.05,0) [0|65] "MPS"  ACM
 SG_ OBJ_Abs_Long_Vel_STD_V_36 : 264|1@1+ (1,0) [0|1] "bool"  ACM
 SG_ OBJ_Abs_Lat_Velocity_36 : 272|11@1+ (0.05,-50) [-50|50] "MPS"  ACM
 SG_ OBJ_Abs_Lat_Velocity_V_36 : 283|1@1+ (1,0) [0|1] "bool"  ACM
 SG_ OBJ_Abs_Lat_Velocity_STD_36 : 284|10@1+ (0.05,0) [0|50] "MPS"  ACM
 SG_ OBJ_Abs_Lat_Vel_STD_V_36 : 294|1@1+ (1,0) [0|1] "bool"  ACM
 SG_ OBJ_Abs_Long_Acc_36 : 295|9@1+ (0.05,-10.3) [-10.3|7.3] "MPS2"  ACM
 SG_ OBJ_Abs_Long_Acc_V_36 : 304|1@1+ (1,0) [0|1] "bool"  ACM
 SG_ OBJ_Abs_Long_Acc_STD_36 : 305|8@1+ (0.05,0) [0|7.3] "MPS2"  ACM
 SG_ OBJ_Abs_Long_Acc_STD_V_36 : 313|1@1+ (1,0) [0|1] "bool"  ACM
 SG_ OBJ_Abs_Lat_Acc_36 : 314|9@1+ (0.05,-10.3) [-10.3|7.3] "MPS2"  ACM
 SG_ OBJ_Abs_Lat_Acc_V_36 : 323|1@1+ (1,0) [0|1] "bool"  ACM
 SG_ OBJ_Abs_Lat_Acc_STD_36 : 324|8@1+ (0.05,0) [0|7.3] "MPS2"  ACM
 SG_ OBJ_Abs_Lat_Acc_STD_V_36 : 332|1@1+ (1,0) [0|1] "bool"  ACM
 SG_ OBJ_Abs_Acceleration_36 : 336|9@1+ (0.05,-10.3) [-10.3|7.3] "MPS2"  ACM
 SG_ OBJ_Abs_Acceleration_V_36 : 345|1@1+ (1,0) [0|1] "bool"  ACM
 SG_ OBJ_Abs_Acc_STD_36 : 346|8@1+ (0.05,0) [0|7.3] "MPS2"  ACM
 SG_ OBJ_Abs_Acc_STD_V_36 : 354|1@1+ (1,0) [0|1] "bool"  ACM
 SG_ OBJ_Inv_TTC_36 : 355|11@1+ (0.01,-8) [-8|8] "INV(s)"  ACM
 SG_ OBJ_Inv_TTC_V_36 : 366|1@1+ (1,0) [0|1] "bool"  ACM
 SG_ OBJ_Inv_TTC_STD_36 : 368|11@1+ (0.01,0) [0|4] "INV(s)"  ACM
 SG_ OBJ_Inv_TTC_STD_V_36 : 379|1@1+ (1,0) [0|1] "bool"  ACM
 SG_ OBJ_Relative_Long_Acc_36 : 380|9@1+ (0.05,-10.3) [-10.3|7.3] "MPS2"  ACM
 SG_ OBJ_Relative_Long_Acc_V_36 : 389|1@1+ (1,0) [0|1] "bool"  ACM
 SG_ OBJ_Relative_Long_Acc_STD_36 : 390|8@1+ (0.05,0) [0|7.3] "MPS2"  ACM
 SG_ OBJ_Rel_Long_Acc_STD_V_36 : 398|1@1+ (1,0) [0|1] "bool"  ACM

BA_DEF_ BO_  "VFrameFormat" ENUM  "StandardCAN","ExtendedCAN","reserved","reserved","reserved","reserved","reserved","reserved","reserved","reserved","reserved","reserved","reserved","reserved","StandardCAN_FD","ExtendedCAN_FD";
BA_DEF_  "BusType" STRING ;
BA_DEF_ BO_  "GenMsgSendType" ENUM  "Cyclic","NotUsed","NotUsed","NotUsed","NotUsed","NotUsed","NotUsed","NotUsed","NoMsgSendType";
BA_DEF_ SG_  "GenSigSendType" ENUM  "NotUsed","OnWrite","OnWriteWithRepetition","OnChange","OnChangeWithRepetition","IfActive","IfActiveWithRepeition","NoSigSendType";
BA_DEF_ BO_  "GenMsgCycleTime" INT 0 0;
BA_DEF_ BO_  "GenMsgILSupport" ENUM  "no","yes";
BA_DEF_ SG_  "GenSigStartValue" INT 0 0;
BA_DEF_DEF_  "VFrameFormat" "ExtendedCAN_FD";
BA_DEF_DEF_  "BusType" "MOST";
BA_DEF_DEF_  "GenMsgSendType" "NoMsgSendType";
BA_DEF_DEF_  "GenSigSendType" "OnWrite";
BA_DEF_DEF_  "GenMsgCycleTime" 0;
BA_DEF_DEF_  "GenMsgILSupport" "yes";
BA_DEF_DEF_  "GenSigStartValue" 0;
BA_ "BusType" "CAN FD";
BA_ "GenMsgCycleTime" BO_ 513 1000;
BA_ "VFrameFormat" BO_ 513 14;
BA_ "GenMsgCycleTime" BO_ 512 1000;
BA_ "VFrameFormat" BO_ 512 14;
BA_ "GenMsgCycleTime" BO_ 48 500;
BA_ "VFrameFormat" BO_ 48 14;
BA_ "VFrameFormat" BO_ 82 14;
BA_ "VFrameFormat" BO_ 81 14;
BA_ "VFrameFormat" BO_ 80 14;
BA_ "VFrameFormat" BO_ 79 14;
BA_ "VFrameFormat" BO_ 78 14;
BA_ "VFrameFormat" BO_ 77 14;
BA_ "VFrameFormat" BO_ 76 14;
BA_ "VFrameFormat" BO_ 131 14;
BA_ "VFrameFormat" BO_ 130 14;
BA_ "VFrameFormat" BO_ 129 14;
BA_ "VFrameFormat" BO_ 128 14;
BA_ "VFrameFormat" BO_ 127 14;
BA_ "VFrameFormat" BO_ 126 14;
BA_ "VFrameFormat" BO_ 125 14;
BA_ "VFrameFormat" BO_ 124 14;
BA_ "VFrameFormat" BO_ 123 14;
BA_ "VFrameFormat" BO_ 122 14;
BA_ "VFrameFormat" BO_ 121 14;
BA_ "VFrameFormat" BO_ 120 14;
BA_ "VFrameFormat" BO_ 119 14;
BA_ "VFrameFormat" BO_ 118 14;
BA_ "VFrameFormat" BO_ 117 14;
BA_ "VFrameFormat" BO_ 116 14;
BA_ "VFrameFormat" BO_ 115 14;
BA_ "VFrameFormat" BO_ 114 14;
BA_ "VFrameFormat" BO_ 113 14;
BA_ "VFrameFormat" BO_ 112 14;
BA_ "VFrameFormat" BO_ 224 14;
BA_ "VFrameFormat" BO_ 223 14;
BA_ "VFrameFormat" BO_ 222 14;
BA_ "VFrameFormat" BO_ 221 14;
BA_ "VFrameFormat" BO_ 220 14;
BA_ "VFrameFormat" BO_ 219 14;
BA_ "VFrameFormat" BO_ 218 14;
BA_ "VFrameFormat" BO_ 217 14;
BA_ "GenSigStartValue" SG_ 80 FS_Protocol_Version 4;
BA_ "GenSigStartValue" SG_ 112 TSR_Protocol_Version 4;
BA_ "GenSigStartValue" SG_ 224 OBJ_Absolute_Speed_STD_39 1300;
BA_ "GenSigStartValue" SG_ 223 OBJ_Width_39 40;
BA_ "GenSigStartValue" SG_ 223 OBJ_Length_39 24;
BA_ "GenSigStartValue" SG_ 222 OBJ_Absolute_Speed_STD_38 1300;
BA_ "GenSigStartValue" SG_ 221 OBJ_Width_38 40;
BA_ "GenSigStartValue" SG_ 221 OBJ_Length_38 24;
BA_ "GenSigStartValue" SG_ 220 OBJ_Absolute_Speed_STD_37 1300;
BA_ "GenSigStartValue" SG_ 219 OBJ_Width_37 40;
BA_ "GenSigStartValue" SG_ 219 OBJ_Length_37 24;
BA_ "GenSigStartValue" SG_ 218 OBJ_Absolute_Speed_STD_36 1300;
BA_ "GenSigStartValue" SG_ 217 OBJ_Width_36 40;
BA_ "GenSigStartValue" SG_ 217 OBJ_Length_36 24;
VAL_ 82 FS_Free_Sight_9 1 "TRUE" 0 "FALSE" ;
VAL_ 82 FS_Splashes_9 5 "99" 4 "75" 3 "50" 2 "25" 1 "NONE" 0 "NOT_READY" ;
VAL_ 82 FS_Sun_Ray_9 5 "99" 4 "75" 3 "50" 2 "25" 1 "NONE" 0 "NOT_READY" ;
VAL_ 82 FS_Low_Sun_9 5 "99" 4 "75" 3 "50" 2 "25" 1 "NONE" 0 "NOT_READY" ;
VAL_ 82 FS_Blur_Image_9 5 "99" 4 "75" 3 "50" 2 "25" 1 "NONE" 0 "NOT_READY" ;
VAL_ 82 FS_Partial_Blockage_9 5 "99" 4 "75" 3 "50" 2 "25" 1 "NONE" 0 "NOT_READY" ;
VAL_ 82 FS_Full_Blockage_9 5 "99" 4 "75" 3 "50" 2 "25" 1 "NONE" 0 "NOT_READY" ;
VAL_ 82 FS_Out_Of_Focus_9 5 "99" 4 "75" 3 "50" 2 "25" 1 "NONE" 0 "NOT_READY" ;
VAL_ 82 FS_C2C_Out_Of_Calib_9 5 "99" 4 "75" 3 "50" 2 "25" 1 "NONE" 0 "NOT_READY" ;
VAL_ 82 FS_Free_Sight_10 1 "TRUE" 0 "FALSE" ;
VAL_ 82 FS_Splashes_10 5 "99" 4 "75" 3 "50" 2 "25" 1 "NONE" 0 "NOT_READY" ;
VAL_ 82 FS_Sun_Ray_10 5 "99" 4 "75" 3 "50" 2 "25" 1 "NONE" 0 "NOT_READY" ;
VAL_ 82 FS_Low_Sun_10 5 "99" 4 "75" 3 "50" 2 "25" 1 "NONE" 0 "NOT_READY" ;
VAL_ 82 FS_Blur_Image_10 5 "99" 4 "75" 3 "50" 2 "25" 1 "NONE" 0 "NOT_READY" ;
VAL_ 82 FS_Partial_Blockage_10 5 "99" 4 "75" 3 "50" 2 "25" 1 "NONE" 0 "NOT_READY" ;
VAL_ 82 FS_Full_Blockage_10 5 "99" 4 "75" 3 "50" 2 "25" 1 "NONE" 0 "NOT_READY" ;
VAL_ 82 FS_Out_Of_Focus_10 5 "99" 4 "75" 3 "50" 2 "25" 1 "NONE" 0 "NOT_READY" ;
VAL_ 82 FS_C2C_Out_Of_Calib_10 5 "99" 4 "75" 3 "50" 2 "25" 1 "NONE" 0 "NOT_READY" ;
VAL_ 82 FS_Free_Sight_11 1 "TRUE" 0 "FALSE" ;
VAL_ 82 FS_Splashes_11 5 "99" 4 "75" 3 "50" 2 "25" 1 "NONE" 0 "NOT_READY" ;
VAL_ 82 FS_Sun_Ray_11 5 "99" 4 "75" 3 "50" 2 "25" 1 "NONE" 0 "NOT_READY" ;
VAL_ 82 FS_Low_Sun_11 5 "99" 4 "75" 3 "50" 2 "25" 1 "NONE" 0 "NOT_READY" ;
VAL_ 82 FS_Blur_Image_11 5 "99" 4 "75" 3 "50" 2 "25" 1 "NONE" 0 "NOT_READY" ;
VAL_ 82 FS_Partial_Blockage_11 5 "99" 4 "75" 3 "50" 2 "25" 1 "NONE" 0 "NOT_READY" ;
VAL_ 82 FS_Full_Blockage_11 5 "99" 4 "75" 3 "50" 2 "25" 1 "NONE" 0 "NOT_READY" ;
VAL_ 82 FS_Out_Of_Focus_11 5 "99" 4 "75" 3 "50" 2 "25" 1 "NONE" 0 "NOT_READY" ;
VAL_ 82 FS_C2C_Out_Of_Calib_11 5 "99" 4 "75" 3 "50" 2 "25" 1 "NONE" 0 "NOT_READY" ;
VAL_ 82 FS_Free_Sight_12 1 "TRUE" 0 "FALSE" ;
VAL_ 82 FS_Splashes_12 5 "99" 4 "75" 3 "50" 2 "25" 1 "NONE" 0 "NOT_READY" ;
VAL_ 82 FS_Sun_Ray_12 5 "99" 4 "75" 3 "50" 2 "25" 1 "NONE" 0 "NOT_READY" ;
VAL_ 82 FS_Low_Sun_12 5 "99" 4 "75" 3 "50" 2 "25" 1 "NONE" 0 "NOT_READY" ;
VAL_ 82 FS_Blur_Image_12 5 "99" 4 "75" 3 "50" 2 "25" 1 "NONE" 0 "NOT_READY" ;
VAL_ 82 FS_Partial_Blockage_12 5 "99" 4 "75" 3 "50" 2 "25" 1 "NONE" 0 "NOT_READY" ;
VAL_ 82 FS_Full_Blockage_12 5 "99" 4 "75" 3 "50" 2 "25" 1 "NONE" 0 "NOT_READY" ;
VAL_ 82 FS_Out_Of_Focus_12 5 "99" 4 "75" 3 "50" 2 "25" 1 "NONE" 0 "NOT_READY" ;
VAL_ 82 FS_C2C_Out_Of_Calib_12 5 "99" 4 "75" 3 "50" 2 "25" 1 "NONE" 0 "NOT_READY" ;
VAL_ 82 FS_Free_Sight_13 1 "TRUE" 0 "FALSE" ;
VAL_ 82 FS_Splashes_13 5 "99" 4 "75" 3 "50" 2 "25" 1 "NONE" 0 "NOT_READY" ;
VAL_ 82 FS_Sun_Ray_13 5 "99" 4 "75" 3 "50" 2 "25" 1 "NONE" 0 "NOT_READY" ;
VAL_ 82 FS_Low_Sun_13 5 "99" 4 "75" 3 "50" 2 "25" 1 "NONE" 0 "NOT_READY" ;
VAL_ 82 FS_Blur_Image_13 5 "99" 4 "75" 3 "50" 2 "25" 1 "NONE" 0 "NOT_READY" ;
VAL_ 82 FS_Partial_Blockage_13 5 "99" 4 "75" 3 "50" 2 "25" 1 "NONE" 0 "NOT_READY" ;
VAL_ 82 FS_Full_Blockage_13 5 "99" 4 "75" 3 "50" 2 "25" 1 "NONE" 0 "NOT_READY" ;
VAL_ 82 FS_Out_Of_Focus_13 5 "99" 4 "75" 3 "50" 2 "25" 1 "NONE" 0 "NOT_READY" ;
VAL_ 82 FS_C2C_Out_Of_Calib_13 5 "99" 4 "75" 3 "50" 2 "25" 1 "NONE" 0 "NOT_READY" ;
VAL_ 82 FS_Free_Sight_14 1 "TRUE" 0 "FALSE" ;
VAL_ 82 FS_Splashes_14 5 "99" 4 "75" 3 "50" 2 "25" 1 "NONE" 0 "NOT_READY" ;
VAL_ 82 FS_Sun_Ray_14 5 "99" 4 "75" 3 "50" 2 "25" 1 "NONE" 0 "NOT_READY" ;
VAL_ 82 FS_Low_Sun_14 5 "99" 4 "75" 3 "50" 2 "25" 1 "NONE" 0 "NOT_READY" ;
VAL_ 82 FS_Blur_Image_14 5 "99" 4 "75" 3 "50" 2 "25" 1 "NONE" 0 "NOT_READY" ;
VAL_ 82 FS_Partial_Blockage_14 5 "99" 4 "75" 3 "50" 2 "25" 1 "NONE" 0 "NOT_READY" ;
VAL_ 82 FS_Full_Blockage_14 5 "99" 4 "75" 3 "50" 2 "25" 1 "NONE" 0 "NOT_READY" ;
VAL_ 82 FS_Out_Of_Focus_14 5 "99" 4 "75" 3 "50" 2 "25" 1 "NONE" 0 "NOT_READY" ;
VAL_ 82 FS_C2C_Out_Of_Calib_14 5 "99" 4 "75" 3 "50" 2 "25" 1 "NONE" 0 "NOT_READY" ;
VAL_ 81 FS_Free_Sight_3 1 "TRUE" 0 "FALSE" ;
VAL_ 81 FS_Splashes_3 5 "99" 4 "75" 3 "50" 2 "25" 1 "NONE" 0 "NOT_READY" ;
VAL_ 81 FS_Sun_Ray_3 5 "99" 4 "75" 3 "50" 2 "25" 1 "NONE" 0 "NOT_READY" ;
VAL_ 81 FS_Low_Sun_3 5 "99" 4 "75" 3 "50" 2 "25" 1 "NONE" 0 "NOT_READY" ;
VAL_ 81 FS_Blur_Image_3 5 "99" 4 "75" 3 "50" 2 "25" 1 "NONE" 0 "NOT_READY" ;
VAL_ 81 FS_Partial_Blockage_3 5 "99" 4 "75" 3 "50" 2 "25" 1 "NONE" 0 "NOT_READY" ;
VAL_ 81 FS_Full_Blockage_3 5 "99" 4 "75" 3 "50" 2 "25" 1 "NONE" 0 "NOT_READY" ;
VAL_ 81 FS_Out_Of_Focus_3 5 "99" 4 "75" 3 "50" 2 "25" 1 "NONE" 0 "NOT_READY" ;
VAL_ 81 FS_C2C_Out_Of_Calib_3 5 "99" 4 "75" 3 "50" 2 "25" 1 "NONE" 0 "NOT_READY" ;
VAL_ 81 FS_Free_Sight_4 1 "TRUE" 0 "FALSE" ;
VAL_ 81 FS_Splashes_4 5 "99" 4 "75" 3 "50" 2 "25" 1 "NONE" 0 "NOT_READY" ;
VAL_ 81 FS_Sun_Ray_4 5 "99" 4 "75" 3 "50" 2 "25" 1 "NONE" 0 "NOT_READY" ;
VAL_ 81 FS_Low_Sun_4 5 "99" 4 "75" 3 "50" 2 "25" 1 "NONE" 0 "NOT_READY" ;
VAL_ 81 FS_Blur_Image_4 5 "99" 4 "75" 3 "50" 2 "25" 1 "NONE" 0 "NOT_READY" ;
VAL_ 81 FS_Partial_Blockage_4 5 "99" 4 "75" 3 "50" 2 "25" 1 "NONE" 0 "NOT_READY" ;
VAL_ 81 FS_Full_Blockage_4 5 "99" 4 "75" 3 "50" 2 "25" 1 "NONE" 0 "NOT_READY" ;
VAL_ 81 FS_Out_Of_Focus_4 5 "99" 4 "75" 3 "50" 2 "25" 1 "NONE" 0 "NOT_READY" ;
VAL_ 81 FS_C2C_Out_Of_Calib_4 5 "99" 4 "75" 3 "50" 2 "25" 1 "NONE" 0 "NOT_READY" ;
VAL_ 81 FS_Free_Sight_5 1 "TRUE" 0 "FALSE" ;
VAL_ 81 FS_Splashes_5 5 "99" 4 "75" 3 "50" 2 "25" 1 "NONE" 0 "NOT_READY" ;
VAL_ 81 FS_Sun_Ray_5 5 "99" 4 "75" 3 "50" 2 "25" 1 "NONE" 0 "NOT_READY" ;
VAL_ 81 FS_Low_Sun_5 5 "99" 4 "75" 3 "50" 2 "25" 1 "NONE" 0 "NOT_READY" ;
VAL_ 81 FS_Blur_Image_5 5 "99" 4 "75" 3 "50" 2 "25" 1 "NONE" 0 "NOT_READY" ;
VAL_ 81 FS_Partial_Blockage_5 5 "99" 4 "75" 3 "50" 2 "25" 1 "NONE" 0 "NOT_READY" ;
VAL_ 81 FS_Full_Blockage_5 5 "99" 4 "75" 3 "50" 2 "25" 1 "NONE" 0 "NOT_READY" ;
VAL_ 81 FS_Out_Of_Focus_5 5 "99" 4 "75" 3 "50" 2 "25" 1 "NONE" 0 "NOT_READY" ;
VAL_ 81 FS_C2C_Out_Of_Calib_5 5 "99" 4 "75" 3 "50" 2 "25" 1 "NONE" 0 "NOT_READY" ;
VAL_ 81 FS_Free_Sight_6 1 "TRUE" 0 "FALSE" ;
VAL_ 81 FS_Splashes_6 5 "99" 4 "75" 3 "50" 2 "25" 1 "NONE" 0 "NOT_READY" ;
VAL_ 81 FS_Sun_Ray_6 5 "99" 4 "75" 3 "50" 2 "25" 1 "NONE" 0 "NOT_READY" ;
VAL_ 81 FS_Low_Sun_6 5 "99" 4 "75" 3 "50" 2 "25" 1 "NONE" 0 "NOT_READY" ;
VAL_ 81 FS_Blur_Image_6 5 "99" 4 "75" 3 "50" 2 "25" 1 "NONE" 0 "NOT_READY" ;
VAL_ 81 FS_Partial_Blockage_6 5 "99" 4 "75" 3 "50" 2 "25" 1 "NONE" 0 "NOT_READY" ;
VAL_ 81 FS_Full_Blockage_6 5 "99" 4 "75" 3 "50" 2 "25" 1 "NONE" 0 "NOT_READY" ;
VAL_ 81 FS_Out_Of_Focus_6 5 "99" 4 "75" 3 "50" 2 "25" 1 "NONE" 0 "NOT_READY" ;
VAL_ 81 FS_C2C_Out_Of_Calib_6 5 "99" 4 "75" 3 "50" 2 "25" 1 "NONE" 0 "NOT_READY" ;
VAL_ 81 FS_Free_Sight_7 1 "TRUE" 0 "FALSE" ;
VAL_ 81 FS_Splashes_7 5 "99" 4 "75" 3 "50" 2 "25" 1 "NONE" 0 "NOT_READY" ;
VAL_ 81 FS_Sun_Ray_7 5 "99" 4 "75" 3 "50" 2 "25" 1 "NONE" 0 "NOT_READY" ;
VAL_ 81 FS_Low_Sun_7 5 "99" 4 "75" 3 "50" 2 "25" 1 "NONE" 0 "NOT_READY" ;
VAL_ 81 FS_Blur_Image_7 5 "99" 4 "75" 3 "50" 2 "25" 1 "NONE" 0 "NOT_READY" ;
VAL_ 81 FS_Partial_Blockage_7 5 "99" 4 "75" 3 "50" 2 "25" 1 "NONE" 0 "NOT_READY" ;
VAL_ 81 FS_Full_Blockage_7 5 "99" 4 "75" 3 "50" 2 "25" 1 "NONE" 0 "NOT_READY" ;
VAL_ 81 FS_Out_Of_Focus_7 5 "99" 4 "75" 3 "50" 2 "25" 1 "NONE" 0 "NOT_READY" ;
VAL_ 81 FS_C2C_Out_Of_Calib_7 5 "99" 4 "75" 3 "50" 2 "25" 1 "NONE" 0 "NOT_READY" ;
VAL_ 81 FS_Free_Sight_8 1 "TRUE" 0 "FALSE" ;
VAL_ 81 FS_Splashes_8 5 "99" 4 "75" 3 "50" 2 "25" 1 "NONE" 0 "NOT_READY" ;
VAL_ 81 FS_Sun_Ray_8 5 "99" 4 "75" 3 "50" 2 "25" 1 "NONE" 0 "NOT_READY" ;
VAL_ 81 FS_Low_Sun_8 5 "99" 4 "75" 3 "50" 2 "25" 1 "NONE" 0 "NOT_READY" ;
VAL_ 81 FS_Blur_Image_8 5 "99" 4 "75" 3 "50" 2 "25" 1 "NONE" 0 "NOT_READY" ;
VAL_ 81 FS_Partial_Blockage_8 5 "99" 4 "75" 3 "50" 2 "25" 1 "NONE" 0 "NOT_READY" ;
VAL_ 81 FS_Full_Blockage_8 5 "99" 4 "75" 3 "50" 2 "25" 1 "NONE" 0 "NOT_READY" ;
VAL_ 81 FS_Out_Of_Focus_8 5 "99" 4 "75" 3 "50" 2 "25" 1 "NONE" 0 "NOT_READY" ;
VAL_ 81 FS_C2C_Out_Of_Calib_8 5 "99" 4 "75" 3 "50" 2 "25" 1 "NONE" 0 "NOT_READY" ;
VAL_ 80 FS_C2C_Out_Of_Calib_2 5 "99" 4 "75" 3 "50" 2 "25" 1 "NONE" 0 "NOT_READY" ;
VAL_ 80 FS_Out_Of_Focus_2 5 "99" 4 "75" 3 "50" 2 "25" 1 "NONE" 0 "NOT_READY" ;
VAL_ 80 FS_Full_Blockage_2 5 "99" 4 "75" 3 "50" 2 "25" 1 "NONE" 0 "NOT_READY" ;
VAL_ 80 FS_Partial_Blockage_2 5 "99" 4 "75" 3 "50" 2 "25" 1 "NONE" 0 "NOT_READY" ;
VAL_ 80 FS_Blur_Image_2 5 "99" 4 "75" 3 "50" 2 "25" 1 "NONE" 0 "NOT_READY" ;
VAL_ 80 FS_Low_Sun_2 5 "99" 4 "75" 3 "50" 2 "25" 1 "NONE" 0 "NOT_READY" ;
VAL_ 80 FS_Sun_Ray_2 5 "99" 4 "75" 3 "50" 2 "25" 1 "NONE" 0 "NOT_READY" ;
VAL_ 80 FS_Splashes_2 5 "99" 4 "75" 3 "50" 2 "25" 1 "NONE" 0 "NOT_READY" ;
VAL_ 80 FS_Free_Sight_2 1 "TRUE" 0 "FALSE" ;
VAL_ 80 FS_Camera_ID_2 11 "PARKING_RIGHT" 10 "PARKING_LEFT" 9 "PARKING_REAR" 8 "PARKING_FRONT" 7 "FRONT_CORNER_RIGHT" 6 "FRONT_CORNER_LEFT" 5 "REAR_CORNER_RIGHT" 4 "REAR_CORNER_LEFT" 3 "REAR" 2 "FRONT_FISHEYE" 1 "FRONT_NARROW" 0 "FRONT_MAIN" ;
VAL_ 80 FS_C2C_Out_Of_Calib_1 5 "99" 4 "75" 3 "50" 2 "25" 1 "NONE" 0 "NOT_READY" ;
VAL_ 80 FS_Out_Of_Focus_1 5 "99" 4 "75" 3 "50" 2 "25" 1 "NONE" 0 "NOT_READY" ;
VAL_ 80 FS_Full_Blockage_1 5 "99" 4 "75" 3 "50" 2 "25" 1 "NONE" 0 "NOT_READY" ;
VAL_ 80 FS_Partial_Blockage_1 5 "99" 4 "75" 3 "50" 2 "25" 1 "NONE" 0 "NOT_READY" ;
VAL_ 80 FS_Blur_Image_1 5 "99" 4 "75" 3 "50" 2 "25" 1 "NONE" 0 "NOT_READY" ;
VAL_ 80 FS_Low_Sun_1 5 "99" 4 "75" 3 "50" 2 "25" 1 "NONE" 0 "NOT_READY" ;
VAL_ 80 FS_Sun_Ray_1 5 "99" 4 "75" 3 "50" 2 "25" 1 "NONE" 0 "NOT_READY" ;
VAL_ 80 FS_Splashes_1 5 "99" 4 "75" 3 "50" 2 "25" 1 "NONE" 0 "NOT_READY" ;
VAL_ 80 FS_Free_Sight_1 1 "TRUE" 0 "FALSE" ;
VAL_ 80 FS_Camera_ID_1 11 "PARKING_RIGHT" 10 "PARKING_LEFT" 9 "PARKING_REAR" 8 "PARKING_FRONT" 7 "FRONT_CORNER_RIGHT" 6 "FRONT_CORNER_LEFT" 5 "REAR_CORNER_RIGHT" 4 "REAR_CORNER_LEFT" 3 "REAR" 2 "FRONT_FISHEYE" 1 "FRONT_NARROW" 0 "FRONT_MAIN" ;
VAL_ 80 FS_C2C_Out_Of_Calib_0 5 "99" 4 "75" 3 "50" 2 "25" 1 "NONE" 0 "NOT_READY" ;
VAL_ 80 FS_Out_Of_Focus_0 5 "99" 4 "75" 3 "50" 2 "25" 1 "NONE" 0 "NOT_READY" ;
VAL_ 80 FS_Full_Blockage_0 5 "99" 4 "75" 3 "50" 2 "25" 1 "NONE" 0 "NOT_READY" ;
VAL_ 80 FS_Partial_Blockage_0 5 "99" 4 "75" 3 "50" 2 "25" 1 "NONE" 0 "NOT_READY" ;
VAL_ 80 FS_Blur_Image_0 5 "99" 4 "75" 3 "50" 2 "25" 1 "NONE" 0 "NOT_READY" ;
VAL_ 80 FS_Low_Sun_0 5 "99" 4 "75" 3 "50" 2 "25" 1 "NONE" 0 "NOT_READY" ;
VAL_ 80 FS_Sun_Ray_0 5 "99" 4 "75" 3 "50" 2 "25" 1 "NONE" 0 "NOT_READY" ;
VAL_ 80 FS_Splashes_0 5 "99" 4 "75" 3 "50" 2 "25" 1 "NONE" 0 "NOT_READY" ;
VAL_ 80 FS_Free_Sight_0 1 "TRUE" 0 "FALSE" ;
VAL_ 80 FS_Camera_ID_0 11 "PARKING_RIGHT" 10 "PARKING_LEFT" 9 "PARKING_REAR" 8 "PARKING_FRONT" 7 "FRONT_CORNER_RIGHT" 6 "FRONT_CORNER_LEFT" 5 "REAR_CORNER_RIGHT" 4 "REAR_CORNER_LEFT" 3 "REAR" 2 "FRONT_FISHEYE" 1 "FRONT_NARROW" 0 "FRONT_MAIN" ;
VAL_ 80 FS_Out_Of_Calib 5 "99" 4 "75" 3 "50" 2 "25" 1 "NONE" 0 "NOT_READY" ;
VAL_ 80 FS_Calibration_Misalignment 5 "99" 4 "75" 3 "50" 2 "25" 1 "NONE" 0 "NOT_READY" ;
VAL_ 80 FS_Frozen_Windshield_0 5 "99" 4 "75" 3 "50" 2 "25" 1 "NONE" 0 "NOT_READY" ;
VAL_ 80 FS_Fog 5 "99" 4 "75" 3 "50" 2 "25" 1 "NONE" 0 "NOT_READY" ;
VAL_ 80 FS_Rain 5 "99" 4 "75" 3 "50" 2 "25" 1 "NONE" 0 "NOT_READY" ;
VAL_ 80 FS_Impacted_Technologies 15 "RESERVED_7" 14 "RESERVED_6" 13 "RESERVED_5" 12 "RESERVED_4" 11 "RESERVED_3" 10 "(BIT_10)VD-FCW" 9 "(BIT_9)PED_FCW" 8 "(BIT_8)HEATER" 7 "(BIT_7)FREE_SPACE" 6 "(BIT_6)RPE" 5 "(BIT_5)VD-AEB" 4 "(BIT_4)LD-LC" 3 "(BIT_3)PED-AEB" 2 "(BIT_2)HLB" 1 "(BIT_1)TSR" 0 "(BIT_0)VBACC" ;
VAL_ 78 LH_Prediction_Source_1 5 "(BIT_5)MERGE" 4 "(BIT_4)GR_SHADOW" 3 "(BIT_3)DIVERGING" 2 "(BIT_2)OCCLUDED" 1 "(BIT_1)HEADWAY" 0 "(BIT_0)LOSS" ;
VAL_ 78 LH_Prediction_Type_1 1 "(BIT_1)PARTIAL" 0 "(BIT_0)OTHER_SIDE" ;
VAL_ 78 LH_Color_1 3 "BLUE_GREEN" 2 "YELLOW_ORANGE_RED" 1 "WHITE" 0 "UNDECIDED" ;
VAL_ 78 LH_Lanemark_Type_1 6 "HOV_LANE" 5 "DECELERATION" 4 "BOTTS" 3 "DLM" 2 "DASHED" 1 "SOLID" 0 "UNDECIDED" ;
VAL_ 78 LH_DLM_Type_1 5 "UNDECIDED" 4 "DASHED_DASHED" 3 "SOLID_SOLID" 2 "DASHED_SOLID" 1 "SOLID_DASHED" 0 "NOT_DLM" ;
VAL_ 78 LH_DECEL_Type_1 5 "RESERVED_3" 4 "RESERVED_2" 3 "RESERVED_1" 2 "DASHED" 1 "SOLID" 0 "NO_DECEL" ;
VAL_ 78 LH_Side_1 2 "RIGHT" 1 "LEFT" 0 "UNKNOWN" ;
VAL_ 78 LH_Crossing_1 1 "TRUE" 0 "FALSE" ;
VAL_ 78 LH_Is_Multi_Clothoid_1 1 "TRUE" 0 "FALSE" ;
VAL_ 76 LH_Prediction_Source_0 5 "(BIT_5)MERGE" 4 "(BIT_4)GR_SHADOW" 3 "(BIT_3)DIVERGING" 2 "(BIT_2)OCCLUDED" 1 "(BIT_1)HEADWAY" 0 "(BIT_0)LOSS" ;
VAL_ 76 LH_Prediction_Type_0 1 "(BIT_1)PARTIAL" 0 "(BIT_0)OTHER_SIDE" ;
VAL_ 76 LH_Color_0 3 "BLUE_GREEN" 2 "YELLOW_ORANGE_RED" 1 "WHITE" 0 "UNDECIDED" ;
VAL_ 76 LH_Lanemark_Type_0 6 "HOV_LANE" 5 "DECELERATION" 4 "BOTTS" 3 "DLM" 2 "DASHED" 1 "SOLID" 0 "UNDECIDED" ;
VAL_ 76 LH_DLM_Type_0 5 "UNDECIDED" 4 "DASHED_DASHED" 3 "SOLID_SOLID" 2 "DASHED_SOLID" 1 "SOLID_DASHED" 0 "NOT_DLM" ;
VAL_ 76 LH_DECEL_Type_0 5 "RESERVED_3" 4 "RESERVED_2" 3 "RESERVED_1" 2 "DASHED" 1 "SOLID" 0 "NO_DECEL" ;
VAL_ 76 LH_Side_0 2 "RIGHT" 1 "LEFT" 0 "UNKNOWN" ;
VAL_ 76 LH_Crossing_0 1 "TRUE" 0 "FALSE" ;
VAL_ 76 LH_Is_Multi_Clothoid_0 1 "TRUE" 0 "FALSE" ;
VAL_ 131 TSR_Camera_Source_19 11 "PARKING_RIGHT" 10 "PARKING_LEFT" 9 "PARKING_REAR" 8 "PARKING_FRONT" 7 "FRONT_CORNER_RIGHT" 6 "FRONT_CORNER_LEFT" 5 "REAR_CORNER_RIGHT" 4 "REAR_CORNER_LEFT" 3 "REAR" 2 "FRONT_FISHEYE" 1 "FRONT_NARROW" 0 "FRONT_MAIN" ;
VAL_ 131 TSR_Relevancy_19 10 "OTHER_FILTER_REASON" 9 "CONTRADICT_ARROW_SIGN" 8 "CIPV_IN_FRONT" 7 "ERROR_SIGN_CODE" 6 "INTERNAL_SIGN_CONTRADICTION" 5 "FAR_IRRELEVANT_SIGN" 4 "SIGN_ON_TURN" 3 "PARALLEL_ROAD_SIGN" 2 "LANE_ASSIGNMENT_SIGN" 1 "HIGHWAY_EXIT_SIGN" 0 "RELEVANT_SIGN" ;
VAL_ 131 TSR_Filter_Type_19 7 "RESERVED_3" 6 "RESERVED_2" 5 "RESERVED_1" 4 "ROAD_NUMBER" 3 "MINIMUM" 2 "EMBEDDED" 1 "TRUCK" 0 "NO_SLI_FILTER" ;
VAL_ 131 TSR_Sign_Shape_19 8 "RESERVED_3" 7 "RESERVED_2" 6 "PENTAGON" 5 "DIAMOND" 4 "TRIANGLE_DOWN" 3 "TRIANGLE_UP" 2 "RECTANGLE" 1 "CIRCLE" 0 "UNKNON" ;
VAL_ 131 TSR_Sign_Structure_19 3 "ELECTRONIC" 2 "VARIABLE" 1 "STANDARD" 0 "UNKNOWN" ;
VAL_ 130 TSR_Camera_Source_18 11 "PARKING_RIGHT" 10 "PARKING_LEFT" 9 "PARKING_REAR" 8 "PARKING_FRONT" 7 "FRONT_CORNER_RIGHT" 6 "FRONT_CORNER_LEFT" 5 "REAR_CORNER_RIGHT" 4 "REAR_CORNER_LEFT" 3 "REAR" 2 "FRONT_FISHEYE" 1 "FRONT_NARROW" 0 "FRONT_MAIN" ;
VAL_ 130 TSR_Relevancy_18 10 "OTHER_FILTER_REASON" 9 "CONTRADICT_ARROW_SIGN" 8 "CIPV_IN_FRONT" 7 "ERROR_SIGN_CODE" 6 "INTERNAL_SIGN_CONTRADICTION" 5 "FAR_IRRELEVANT_SIGN" 4 "SIGN_ON_TURN" 3 "PARALLEL_ROAD_SIGN" 2 "LANE_ASSIGNMENT_SIGN" 1 "HIGHWAY_EXIT_SIGN" 0 "RELEVANT_SIGN" ;
VAL_ 130 TSR_Filter_Type_18 7 "RESERVED_3" 6 "RESERVED_2" 5 "RESERVED_1" 4 "ROAD_NUMBER" 3 "MINIMUM" 2 "EMBEDDED" 1 "TRUCK" 0 "NO_SLI_FILTER" ;
VAL_ 130 TSR_Sign_Shape_18 8 "RESERVED_3" 7 "RESERVED_2" 6 "PENTAGON" 5 "DIAMOND" 4 "TRIANGLE_DOWN" 3 "TRIANGLE_UP" 2 "RECTANGLE" 1 "CIRCLE" 0 "UNKNON" ;
VAL_ 130 TSR_Sign_Structure_18 3 "ELECTRONIC" 2 "VARIABLE" 1 "STANDARD" 0 "UNKNOWN" ;
VAL_ 129 TSR_Camera_Source_17 11 "PARKING_RIGHT" 10 "PARKING_LEFT" 9 "PARKING_REAR" 8 "PARKING_FRONT" 7 "FRONT_CORNER_RIGHT" 6 "FRONT_CORNER_LEFT" 5 "REAR_CORNER_RIGHT" 4 "REAR_CORNER_LEFT" 3 "REAR" 2 "FRONT_FISHEYE" 1 "FRONT_NARROW" 0 "FRONT_MAIN" ;
VAL_ 129 TSR_Relevancy_17 10 "OTHER_FILTER_REASON" 9 "CONTRADICT_ARROW_SIGN" 8 "CIPV_IN_FRONT" 7 "ERROR_SIGN_CODE" 6 "INTERNAL_SIGN_CONTRADICTION" 5 "FAR_IRRELEVANT_SIGN" 4 "SIGN_ON_TURN" 3 "PARALLEL_ROAD_SIGN" 2 "LANE_ASSIGNMENT_SIGN" 1 "HIGHWAY_EXIT_SIGN" 0 "RELEVANT_SIGN" ;
VAL_ 129 TSR_Filter_Type_17 7 "RESERVED_3" 6 "RESERVED_2" 5 "RESERVED_1" 4 "ROAD_NUMBER" 3 "MINIMUM" 2 "EMBEDDED" 1 "TRUCK" 0 "NO_SLI_FILTER" ;
VAL_ 129 TSR_Sign_Shape_17 8 "RESERVED_3" 7 "RESERVED_2" 6 "PENTAGON" 5 "DIAMOND" 4 "TRIANGLE_DOWN" 3 "TRIANGLE_UP" 2 "RECTANGLE" 1 "CIRCLE" 0 "UNKNON" ;
VAL_ 129 TSR_Sign_Structure_17 3 "ELECTRONIC" 2 "VARIABLE" 1 "STANDARD" 0 "UNKNOWN" ;
VAL_ 128 TSR_Camera_Source_16 11 "PARKING_RIGHT" 10 "PARKING_LEFT" 9 "PARKING_REAR" 8 "PARKING_FRONT" 7 "FRONT_CORNER_RIGHT" 6 "FRONT_CORNER_LEFT" 5 "REAR_CORNER_RIGHT" 4 "REAR_CORNER_LEFT" 3 "REAR" 2 "FRONT_FISHEYE" 1 "FRONT_NARROW" 0 "FRONT_MAIN" ;
VAL_ 128 TSR_Relevancy_16 10 "OTHER_FILTER_REASON" 9 "CONTRADICT_ARROW_SIGN" 8 "CIPV_IN_FRONT" 7 "ERROR_SIGN_CODE" 6 "INTERNAL_SIGN_CONTRADICTION" 5 "FAR_IRRELEVANT_SIGN" 4 "SIGN_ON_TURN" 3 "PARALLEL_ROAD_SIGN" 2 "LANE_ASSIGNMENT_SIGN" 1 "HIGHWAY_EXIT_SIGN" 0 "RELEVANT_SIGN" ;
VAL_ 128 TSR_Filter_Type_16 7 "RESERVED_3" 6 "RESERVED_2" 5 "RESERVED_1" 4 "ROAD_NUMBER" 3 "MINIMUM" 2 "EMBEDDED" 1 "TRUCK" 0 "NO_SLI_FILTER" ;
VAL_ 128 TSR_Sign_Shape_16 8 "RESERVED_3" 7 "RESERVED_2" 6 "PENTAGON" 5 "DIAMOND" 4 "TRIANGLE_DOWN" 3 "TRIANGLE_UP" 2 "RECTANGLE" 1 "CIRCLE" 0 "UNKNON" ;
VAL_ 128 TSR_Sign_Structure_16 3 "ELECTRONIC" 2 "VARIABLE" 1 "STANDARD" 0 "UNKNOWN" ;
VAL_ 127 TSR_Camera_Source_15 11 "PARKING_RIGHT" 10 "PARKING_LEFT" 9 "PARKING_REAR" 8 "PARKING_FRONT" 7 "FRONT_CORNER_RIGHT" 6 "FRONT_CORNER_LEFT" 5 "REAR_CORNER_RIGHT" 4 "REAR_CORNER_LEFT" 3 "REAR" 2 "FRONT_FISHEYE" 1 "FRONT_NARROW" 0 "FRONT_MAIN" ;
VAL_ 127 TSR_Relevancy_15 10 "OTHER_FILTER_REASON" 9 "CONTRADICT_ARROW_SIGN" 8 "CIPV_IN_FRONT" 7 "ERROR_SIGN_CODE" 6 "INTERNAL_SIGN_CONTRADICTION" 5 "FAR_IRRELEVANT_SIGN" 4 "SIGN_ON_TURN" 3 "PARALLEL_ROAD_SIGN" 2 "LANE_ASSIGNMENT_SIGN" 1 "HIGHWAY_EXIT_SIGN" 0 "RELEVANT_SIGN" ;
VAL_ 127 TSR_Filter_Type_15 7 "RESERVED_3" 6 "RESERVED_2" 5 "RESERVED_1" 4 "ROAD_NUMBER" 3 "MINIMUM" 2 "EMBEDDED" 1 "TRUCK" 0 "NO_SLI_FILTER" ;
VAL_ 127 TSR_Sign_Shape_15 8 "RESERVED_3" 7 "RESERVED_2" 6 "PENTAGON" 5 "DIAMOND" 4 "TRIANGLE_DOWN" 3 "TRIANGLE_UP" 2 "RECTANGLE" 1 "CIRCLE" 0 "UNKNON" ;
VAL_ 127 TSR_Sign_Structure_15 3 "ELECTRONIC" 2 "VARIABLE" 1 "STANDARD" 0 "UNKNOWN" ;
VAL_ 126 TSR_Camera_Source_14 11 "PARKING_RIGHT" 10 "PARKING_LEFT" 9 "PARKING_REAR" 8 "PARKING_FRONT" 7 "FRONT_CORNER_RIGHT" 6 "FRONT_CORNER_LEFT" 5 "REAR_CORNER_RIGHT" 4 "REAR_CORNER_LEFT" 3 "REAR" 2 "FRONT_FISHEYE" 1 "FRONT_NARROW" 0 "FRONT_MAIN" ;
VAL_ 126 TSR_Relevancy_14 10 "OTHER_FILTER_REASON" 9 "CONTRADICT_ARROW_SIGN" 8 "CIPV_IN_FRONT" 7 "ERROR_SIGN_CODE" 6 "INTERNAL_SIGN_CONTRADICTION" 5 "FAR_IRRELEVANT_SIGN" 4 "SIGN_ON_TURN" 3 "PARALLEL_ROAD_SIGN" 2 "LANE_ASSIGNMENT_SIGN" 1 "HIGHWAY_EXIT_SIGN" 0 "RELEVANT_SIGN" ;
VAL_ 126 TSR_Filter_Type_14 7 "RESERVED_3" 6 "RESERVED_2" 5 "RESERVED_1" 4 "ROAD_NUMBER" 3 "MINIMUM" 2 "EMBEDDED" 1 "TRUCK" 0 "NO_SLI_FILTER" ;
VAL_ 126 TSR_Sign_Shape_14 8 "RESERVED_3" 7 "RESERVED_2" 6 "PENTAGON" 5 "DIAMOND" 4 "TRIANGLE_DOWN" 3 "TRIANGLE_UP" 2 "RECTANGLE" 1 "CIRCLE" 0 "UNKNON" ;
VAL_ 126 TSR_Sign_Structure_14 3 "ELECTRONIC" 2 "VARIABLE" 1 "STANDARD" 0 "UNKNOWN" ;
VAL_ 125 TSR_Camera_Source_13 11 "PARKING_RIGHT" 10 "PARKING_LEFT" 9 "PARKING_REAR" 8 "PARKING_FRONT" 7 "FRONT_CORNER_RIGHT" 6 "FRONT_CORNER_LEFT" 5 "REAR_CORNER_RIGHT" 4 "REAR_CORNER_LEFT" 3 "REAR" 2 "FRONT_FISHEYE" 1 "FRONT_NARROW" 0 "FRONT_MAIN" ;
VAL_ 125 TSR_Relevancy_13 10 "OTHER_FILTER_REASON" 9 "CONTRADICT_ARROW_SIGN" 8 "CIPV_IN_FRONT" 7 "ERROR_SIGN_CODE" 6 "INTERNAL_SIGN_CONTRADICTION" 5 "FAR_IRRELEVANT_SIGN" 4 "SIGN_ON_TURN" 3 "PARALLEL_ROAD_SIGN" 2 "LANE_ASSIGNMENT_SIGN" 1 "HIGHWAY_EXIT_SIGN" 0 "RELEVANT_SIGN" ;
VAL_ 125 TSR_Filter_Type_13 7 "RESERVED_3" 6 "RESERVED_2" 5 "RESERVED_1" 4 "ROAD_NUMBER" 3 "MINIMUM" 2 "EMBEDDED" 1 "TRUCK" 0 "NO_SLI_FILTER" ;
VAL_ 125 TSR_Sign_Shape_13 8 "RESERVED_3" 7 "RESERVED_2" 6 "PENTAGON" 5 "DIAMOND" 4 "TRIANGLE_DOWN" 3 "TRIANGLE_UP" 2 "RECTANGLE" 1 "CIRCLE" 0 "UNKNON" ;
VAL_ 125 TSR_Sign_Structure_13 3 "ELECTRONIC" 2 "VARIABLE" 1 "STANDARD" 0 "UNKNOWN" ;
VAL_ 124 TSR_Camera_Source_12 11 "PARKING_RIGHT" 10 "PARKING_LEFT" 9 "PARKING_REAR" 8 "PARKING_FRONT" 7 "FRONT_CORNER_RIGHT" 6 "FRONT_CORNER_LEFT" 5 "REAR_CORNER_RIGHT" 4 "REAR_CORNER_LEFT" 3 "REAR" 2 "FRONT_FISHEYE" 1 "FRONT_NARROW" 0 "FRONT_MAIN" ;
VAL_ 124 TSR_Relevancy_12 10 "OTHER_FILTER_REASON" 9 "CONTRADICT_ARROW_SIGN" 8 "CIPV_IN_FRONT" 7 "ERROR_SIGN_CODE" 6 "INTERNAL_SIGN_CONTRADICTION" 5 "FAR_IRRELEVANT_SIGN" 4 "SIGN_ON_TURN" 3 "PARALLEL_ROAD_SIGN" 2 "LANE_ASSIGNMENT_SIGN" 1 "HIGHWAY_EXIT_SIGN" 0 "RELEVANT_SIGN" ;
VAL_ 124 TSR_Filter_Type_12 7 "RESERVED_3" 6 "RESERVED_2" 5 "RESERVED_1" 4 "ROAD_NUMBER" 3 "MINIMUM" 2 "EMBEDDED" 1 "TRUCK" 0 "NO_SLI_FILTER" ;
VAL_ 124 TSR_Sign_Shape_12 8 "RESERVED_3" 7 "RESERVED_2" 6 "PENTAGON" 5 "DIAMOND" 4 "TRIANGLE_DOWN" 3 "TRIANGLE_UP" 2 "RECTANGLE" 1 "CIRCLE" 0 "UNKNON" ;
VAL_ 124 TSR_Sign_Structure_12 3 "ELECTRONIC" 2 "VARIABLE" 1 "STANDARD" 0 "UNKNOWN" ;
VAL_ 123 TSR_Camera_Source_11 11 "PARKING_RIGHT" 10 "PARKING_LEFT" 9 "PARKING_REAR" 8 "PARKING_FRONT" 7 "FRONT_CORNER_RIGHT" 6 "FRONT_CORNER_LEFT" 5 "REAR_CORNER_RIGHT" 4 "REAR_CORNER_LEFT" 3 "REAR" 2 "FRONT_FISHEYE" 1 "FRONT_NARROW" 0 "FRONT_MAIN" ;
VAL_ 123 TSR_Relevancy_11 10 "OTHER_FILTER_REASON" 9 "CONTRADICT_ARROW_SIGN" 8 "CIPV_IN_FRONT" 7 "ERROR_SIGN_CODE" 6 "INTERNAL_SIGN_CONTRADICTION" 5 "FAR_IRRELEVANT_SIGN" 4 "SIGN_ON_TURN" 3 "PARALLEL_ROAD_SIGN" 2 "LANE_ASSIGNMENT_SIGN" 1 "HIGHWAY_EXIT_SIGN" 0 "RELEVANT_SIGN" ;
VAL_ 123 TSR_Filter_Type_11 7 "RESERVED_3" 6 "RESERVED_2" 5 "RESERVED_1" 4 "ROAD_NUMBER" 3 "MINIMUM" 2 "EMBEDDED" 1 "TRUCK" 0 "NO_SLI_FILTER" ;
VAL_ 123 TSR_Sign_Shape_11 8 "RESERVED_3" 7 "RESERVED_2" 6 "PENTAGON" 5 "DIAMOND" 4 "TRIANGLE_DOWN" 3 "TRIANGLE_UP" 2 "RECTANGLE" 1 "CIRCLE" 0 "UNKNON" ;
VAL_ 123 TSR_Sign_Structure_11 3 "ELECTRONIC" 2 "VARIABLE" 1 "STANDARD" 0 "UNKNOWN" ;
VAL_ 122 TSR_Camera_Source_10 11 "PARKING_RIGHT" 10 "PARKING_LEFT" 9 "PARKING_REAR" 8 "PARKING_FRONT" 7 "FRONT_CORNER_RIGHT" 6 "FRONT_CORNER_LEFT" 5 "REAR_CORNER_RIGHT" 4 "REAR_CORNER_LEFT" 3 "REAR" 2 "FRONT_FISHEYE" 1 "FRONT_NARROW" 0 "FRONT_MAIN" ;
VAL_ 122 TSR_Relevancy_10 10 "OTHER_FILTER_REASON" 9 "CONTRADICT_ARROW_SIGN" 8 "CIPV_IN_FRONT" 7 "ERROR_SIGN_CODE" 6 "INTERNAL_SIGN_CONTRADICTION" 5 "FAR_IRRELEVANT_SIGN" 4 "SIGN_ON_TURN" 3 "PARALLEL_ROAD_SIGN" 2 "LANE_ASSIGNMENT_SIGN" 1 "HIGHWAY_EXIT_SIGN" 0 "RELEVANT_SIGN" ;
VAL_ 122 TSR_Filter_Type_10 7 "RESERVED_3" 6 "RESERVED_2" 5 "RESERVED_1" 4 "ROAD_NUMBER" 3 "MINIMUM" 2 "EMBEDDED" 1 "TRUCK" 0 "NO_SLI_FILTER" ;
VAL_ 122 TSR_Sign_Shape_10 8 "RESERVED_3" 7 "RESERVED_2" 6 "PENTAGON" 5 "DIAMOND" 4 "TRIANGLE_DOWN" 3 "TRIANGLE_UP" 2 "RECTANGLE" 1 "CIRCLE" 0 "UNKNON" ;
VAL_ 122 TSR_Sign_Structure_10 3 "ELECTRONIC" 2 "VARIABLE" 1 "STANDARD" 0 "UNKNOWN" ;
VAL_ 121 TSR_Camera_Source_9 11 "PARKING_RIGHT" 10 "PARKING_LEFT" 9 "PARKING_REAR" 8 "PARKING_FRONT" 7 "FRONT_CORNER_RIGHT" 6 "FRONT_CORNER_LEFT" 5 "REAR_CORNER_RIGHT" 4 "REAR_CORNER_LEFT" 3 "REAR" 2 "FRONT_FISHEYE" 1 "FRONT_NARROW" 0 "FRONT_MAIN" ;
VAL_ 121 TSR_Relevancy_9 10 "OTHER_FILTER_REASON" 9 "CONTRADICT_ARROW_SIGN" 8 "CIPV_IN_FRONT" 7 "ERROR_SIGN_CODE" 6 "INTERNAL_SIGN_CONTRADICTION" 5 "FAR_IRRELEVANT_SIGN" 4 "SIGN_ON_TURN" 3 "PARALLEL_ROAD_SIGN" 2 "LANE_ASSIGNMENT_SIGN" 1 "HIGHWAY_EXIT_SIGN" 0 "RELEVANT_SIGN" ;
VAL_ 121 TSR_Filter_Type_9 7 "RESERVED_3" 6 "RESERVED_2" 5 "RESERVED_1" 4 "ROAD_NUMBER" 3 "MINIMUM" 2 "EMBEDDED" 1 "TRUCK" 0 "NO_SLI_FILTER" ;
VAL_ 121 TSR_Sign_Shape_9 8 "RESERVED_3" 7 "RESERVED_2" 6 "PENTAGON" 5 "DIAMOND" 4 "TRIANGLE_DOWN" 3 "TRIANGLE_UP" 2 "RECTANGLE" 1 "CIRCLE" 0 "UNKNON" ;
VAL_ 121 TSR_Sign_Structure_9 3 "ELECTRONIC" 2 "VARIABLE" 1 "STANDARD" 0 "UNKNOWN" ;
VAL_ 120 TSR_Camera_Source_8 11 "PARKING_RIGHT" 10 "PARKING_LEFT" 9 "PARKING_REAR" 8 "PARKING_FRONT" 7 "FRONT_CORNER_RIGHT" 6 "FRONT_CORNER_LEFT" 5 "REAR_CORNER_RIGHT" 4 "REAR_CORNER_LEFT" 3 "REAR" 2 "FRONT_FISHEYE" 1 "FRONT_NARROW" 0 "FRONT_MAIN" ;
VAL_ 120 TSR_Relevancy_8 10 "OTHER_FILTER_REASON" 9 "CONTRADICT_ARROW_SIGN" 8 "CIPV_IN_FRONT" 7 "ERROR_SIGN_CODE" 6 "INTERNAL_SIGN_CONTRADICTION" 5 "FAR_IRRELEVANT_SIGN" 4 "SIGN_ON_TURN" 3 "PARALLEL_ROAD_SIGN" 2 "LANE_ASSIGNMENT_SIGN" 1 "HIGHWAY_EXIT_SIGN" 0 "RELEVANT_SIGN" ;
VAL_ 120 TSR_Filter_Type_8 7 "RESERVED_3" 6 "RESERVED_2" 5 "RESERVED_1" 4 "ROAD_NUMBER" 3 "MINIMUM" 2 "EMBEDDED" 1 "TRUCK" 0 "NO_SLI_FILTER" ;
VAL_ 120 TSR_Sign_Shape_8 8 "RESERVED_3" 7 "RESERVED_2" 6 "PENTAGON" 5 "DIAMOND" 4 "TRIANGLE_DOWN" 3 "TRIANGLE_UP" 2 "RECTANGLE" 1 "CIRCLE" 0 "UNKNON" ;
VAL_ 120 TSR_Sign_Structure_8 3 "ELECTRONIC" 2 "VARIABLE" 1 "STANDARD" 0 "UNKNOWN" ;
VAL_ 119 TSR_Camera_Source_7 11 "PARKING_RIGHT" 10 "PARKING_LEFT" 9 "PARKING_REAR" 8 "PARKING_FRONT" 7 "FRONT_CORNER_RIGHT" 6 "FRONT_CORNER_LEFT" 5 "REAR_CORNER_RIGHT" 4 "REAR_CORNER_LEFT" 3 "REAR" 2 "FRONT_FISHEYE" 1 "FRONT_NARROW" 0 "FRONT_MAIN" ;
VAL_ 119 TSR_Relevancy_7 10 "OTHER_FILTER_REASON" 9 "CONTRADICT_ARROW_SIGN" 8 "CIPV_IN_FRONT" 7 "ERROR_SIGN_CODE" 6 "INTERNAL_SIGN_CONTRADICTION" 5 "FAR_IRRELEVANT_SIGN" 4 "SIGN_ON_TURN" 3 "PARALLEL_ROAD_SIGN" 2 "LANE_ASSIGNMENT_SIGN" 1 "HIGHWAY_EXIT_SIGN" 0 "RELEVANT_SIGN" ;
VAL_ 119 TSR_Filter_Type_7 7 "RESERVED_3" 6 "RESERVED_2" 5 "RESERVED_1" 4 "ROAD_NUMBER" 3 "MINIMUM" 2 "EMBEDDED" 1 "TRUCK" 0 "NO_SLI_FILTER" ;
VAL_ 119 TSR_Sign_Shape_7 8 "RESERVED_3" 7 "RESERVED_2" 6 "PENTAGON" 5 "DIAMOND" 4 "TRIANGLE_DOWN" 3 "TRIANGLE_UP" 2 "RECTANGLE" 1 "CIRCLE" 0 "UNKNON" ;
VAL_ 119 TSR_Sign_Structure_7 3 "ELECTRONIC" 2 "VARIABLE" 1 "STANDARD" 0 "UNKNOWN" ;
VAL_ 118 TSR_Camera_Source_6 11 "PARKING_RIGHT" 10 "PARKING_LEFT" 9 "PARKING_REAR" 8 "PARKING_FRONT" 7 "FRONT_CORNER_RIGHT" 6 "FRONT_CORNER_LEFT" 5 "REAR_CORNER_RIGHT" 4 "REAR_CORNER_LEFT" 3 "REAR" 2 "FRONT_FISHEYE" 1 "FRONT_NARROW" 0 "FRONT_MAIN" ;
VAL_ 118 TSR_Relevancy_6 10 "OTHER_FILTER_REASON" 9 "CONTRADICT_ARROW_SIGN" 8 "CIPV_IN_FRONT" 7 "ERROR_SIGN_CODE" 6 "INTERNAL_SIGN_CONTRADICTION" 5 "FAR_IRRELEVANT_SIGN" 4 "SIGN_ON_TURN" 3 "PARALLEL_ROAD_SIGN" 2 "LANE_ASSIGNMENT_SIGN" 1 "HIGHWAY_EXIT_SIGN" 0 "RELEVANT_SIGN" ;
VAL_ 118 TSR_Filter_Type_6 7 "RESERVED_3" 6 "RESERVED_2" 5 "RESERVED_1" 4 "ROAD_NUMBER" 3 "MINIMUM" 2 "EMBEDDED" 1 "TRUCK" 0 "NO_SLI_FILTER" ;
VAL_ 118 TSR_Sign_Shape_6 8 "RESERVED_3" 7 "RESERVED_2" 6 "PENTAGON" 5 "DIAMOND" 4 "TRIANGLE_DOWN" 3 "TRIANGLE_UP" 2 "RECTANGLE" 1 "CIRCLE" 0 "UNKNON" ;
VAL_ 118 TSR_Sign_Structure_6 3 "ELECTRONIC" 2 "VARIABLE" 1 "STANDARD" 0 "UNKNOWN" ;
VAL_ 117 TSR_Camera_Source_5 11 "PARKING_RIGHT" 10 "PARKING_LEFT" 9 "PARKING_REAR" 8 "PARKING_FRONT" 7 "FRONT_CORNER_RIGHT" 6 "FRONT_CORNER_LEFT" 5 "REAR_CORNER_RIGHT" 4 "REAR_CORNER_LEFT" 3 "REAR" 2 "FRONT_FISHEYE" 1 "FRONT_NARROW" 0 "FRONT_MAIN" ;
VAL_ 117 TSR_Relevancy_5 10 "OTHER_FILTER_REASON" 9 "CONTRADICT_ARROW_SIGN" 8 "CIPV_IN_FRONT" 7 "ERROR_SIGN_CODE" 6 "INTERNAL_SIGN_CONTRADICTION" 5 "FAR_IRRELEVANT_SIGN" 4 "SIGN_ON_TURN" 3 "PARALLEL_ROAD_SIGN" 2 "LANE_ASSIGNMENT_SIGN" 1 "HIGHWAY_EXIT_SIGN" 0 "RELEVANT_SIGN" ;
VAL_ 117 TSR_Filter_Type_5 7 "RESERVED_3" 6 "RESERVED_2" 5 "RESERVED_1" 4 "ROAD_NUMBER" 3 "MINIMUM" 2 "EMBEDDED" 1 "TRUCK" 0 "NO_SLI_FILTER" ;
VAL_ 117 TSR_Sign_Shape_5 8 "RESERVED_3" 7 "RESERVED_2" 6 "PENTAGON" 5 "DIAMOND" 4 "TRIANGLE_DOWN" 3 "TRIANGLE_UP" 2 "RECTANGLE" 1 "CIRCLE" 0 "UNKNON" ;
VAL_ 117 TSR_Sign_Structure_5 3 "ELECTRONIC" 2 "VARIABLE" 1 "STANDARD" 0 "UNKNOWN" ;
VAL_ 116 TSR_Camera_Source_4 11 "PARKING_RIGHT" 10 "PARKING_LEFT" 9 "PARKING_REAR" 8 "PARKING_FRONT" 7 "FRONT_CORNER_RIGHT" 6 "FRONT_CORNER_LEFT" 5 "REAR_CORNER_RIGHT" 4 "REAR_CORNER_LEFT" 3 "REAR" 2 "FRONT_FISHEYE" 1 "FRONT_NARROW" 0 "FRONT_MAIN" ;
VAL_ 116 TSR_Relevancy_4 10 "OTHER_FILTER_REASON" 9 "CONTRADICT_ARROW_SIGN" 8 "CIPV_IN_FRONT" 7 "ERROR_SIGN_CODE" 6 "INTERNAL_SIGN_CONTRADICTION" 5 "FAR_IRRELEVANT_SIGN" 4 "SIGN_ON_TURN" 3 "PARALLEL_ROAD_SIGN" 2 "LANE_ASSIGNMENT_SIGN" 1 "HIGHWAY_EXIT_SIGN" 0 "RELEVANT_SIGN" ;
VAL_ 116 TSR_Filter_Type_4 7 "RESERVED_3" 6 "RESERVED_2" 5 "RESERVED_1" 4 "ROAD_NUMBER" 3 "MINIMUM" 2 "EMBEDDED" 1 "TRUCK" 0 "NO_SLI_FILTER" ;
VAL_ 116 TSR_Sign_Shape_4 8 "RESERVED_3" 7 "RESERVED_2" 6 "PENTAGON" 5 "DIAMOND" 4 "TRIANGLE_DOWN" 3 "TRIANGLE_UP" 2 "RECTANGLE" 1 "CIRCLE" 0 "UNKNON" ;
VAL_ 116 TSR_Sign_Structure_4 3 "ELECTRONIC" 2 "VARIABLE" 1 "STANDARD" 0 "UNKNOWN" ;
VAL_ 115 TSR_Camera_Source_3 11 "PARKING_RIGHT" 10 "PARKING_LEFT" 9 "PARKING_REAR" 8 "PARKING_FRONT" 7 "FRONT_CORNER_RIGHT" 6 "FRONT_CORNER_LEFT" 5 "REAR_CORNER_RIGHT" 4 "REAR_CORNER_LEFT" 3 "REAR" 2 "FRONT_FISHEYE" 1 "FRONT_NARROW" 0 "FRONT_MAIN" ;
VAL_ 115 TSR_Relevancy_3 10 "OTHER_FILTER_REASON" 9 "CONTRADICT_ARROW_SIGN" 8 "CIPV_IN_FRONT" 7 "ERROR_SIGN_CODE" 6 "INTERNAL_SIGN_CONTRADICTION" 5 "FAR_IRRELEVANT_SIGN" 4 "SIGN_ON_TURN" 3 "PARALLEL_ROAD_SIGN" 2 "LANE_ASSIGNMENT_SIGN" 1 "HIGHWAY_EXIT_SIGN" 0 "RELEVANT_SIGN" ;
VAL_ 115 TSR_Filter_Type_3 7 "RESERVED_3" 6 "RESERVED_2" 5 "RESERVED_1" 4 "ROAD_NUMBER" 3 "MINIMUM" 2 "EMBEDDED" 1 "TRUCK" 0 "NO_SLI_FILTER" ;
VAL_ 115 TSR_Sign_Shape_3 8 "RESERVED_3" 7 "RESERVED_2" 6 "PENTAGON" 5 "DIAMOND" 4 "TRIANGLE_DOWN" 3 "TRIANGLE_UP" 2 "RECTANGLE" 1 "CIRCLE" 0 "UNKNON" ;
VAL_ 115 TSR_Sign_Structure_3 3 "ELECTRONIC" 2 "VARIABLE" 1 "STANDARD" 0 "UNKNOWN" ;
VAL_ 114 TSR_Camera_Source_2 11 "PARKING_RIGHT" 10 "PARKING_LEFT" 9 "PARKING_REAR" 8 "PARKING_FRONT" 7 "FRONT_CORNER_RIGHT" 6 "FRONT_CORNER_LEFT" 5 "REAR_CORNER_RIGHT" 4 "REAR_CORNER_LEFT" 3 "REAR" 2 "FRONT_FISHEYE" 1 "FRONT_NARROW" 0 "FRONT_MAIN" ;
VAL_ 114 TSR_Relevancy_2 10 "OTHER_FILTER_REASON" 9 "CONTRADICT_ARROW_SIGN" 8 "CIPV_IN_FRONT" 7 "ERROR_SIGN_CODE" 6 "INTERNAL_SIGN_CONTRADICTION" 5 "FAR_IRRELEVANT_SIGN" 4 "SIGN_ON_TURN" 3 "PARALLEL_ROAD_SIGN" 2 "LANE_ASSIGNMENT_SIGN" 1 "HIGHWAY_EXIT_SIGN" 0 "RELEVANT_SIGN" ;
VAL_ 114 TSR_Filter_Type_2 7 "RESERVED_3" 6 "RESERVED_2" 5 "RESERVED_1" 4 "ROAD_NUMBER" 3 "MINIMUM" 2 "EMBEDDED" 1 "TRUCK" 0 "NO_SLI_FILTER" ;
VAL_ 114 TSR_Sign_Shape_2 8 "RESERVED_3" 7 "RESERVED_2" 6 "PENTAGON" 5 "DIAMOND" 4 "TRIANGLE_DOWN" 3 "TRIANGLE_UP" 2 "RECTANGLE" 1 "CIRCLE" 0 "UNKNON" ;
VAL_ 114 TSR_Sign_Structure_2 3 "ELECTRONIC" 2 "VARIABLE" 1 "STANDARD" 0 "UNKNOWN" ;
VAL_ 113 TSR_Camera_Source_1 11 "PARKING_RIGHT" 10 "PARKING_LEFT" 9 "PARKING_REAR" 8 "PARKING_FRONT" 7 "FRONT_CORNER_RIGHT" 6 "FRONT_CORNER_LEFT" 5 "REAR_CORNER_RIGHT" 4 "REAR_CORNER_LEFT" 3 "REAR" 2 "FRONT_FISHEYE" 1 "FRONT_NARROW" 0 "FRONT_MAIN" ;
VAL_ 113 TSR_Relevancy_1 10 "OTHER_FILTER_REASON" 9 "CONTRADICT_ARROW_SIGN" 8 "CIPV_IN_FRONT" 7 "ERROR_SIGN_CODE" 6 "INTERNAL_SIGN_CONTRADICTION" 5 "FAR_IRRELEVANT_SIGN" 4 "SIGN_ON_TURN" 3 "PARALLEL_ROAD_SIGN" 2 "LANE_ASSIGNMENT_SIGN" 1 "HIGHWAY_EXIT_SIGN" 0 "RELEVANT_SIGN" ;
VAL_ 113 TSR_Filter_Type_1 7 "RESERVED_3" 6 "RESERVED_2" 5 "RESERVED_1" 4 "ROAD_NUMBER" 3 "MINIMUM" 2 "EMBEDDED" 1 "TRUCK" 0 "NO_SLI_FILTER" ;
VAL_ 113 TSR_Sign_Shape_1 8 "RESERVED_3" 7 "RESERVED_2" 6 "PENTAGON" 5 "DIAMOND" 4 "TRIANGLE_DOWN" 3 "TRIANGLE_UP" 2 "RECTANGLE" 1 "CIRCLE" 0 "UNKNON" ;
VAL_ 113 TSR_Sign_Structure_1 3 "ELECTRONIC" 2 "VARIABLE" 1 "STANDARD" 0 "UNKNOWN" ;
VAL_ 112 TSR_Camera_Source_0 11 "PARKING_RIGHT" 10 "PARKING_LEFT" 9 "PARKING_REAR" 8 "PARKING_FRONT" 7 "FRONT_CORNER_RIGHT" 6 "FRONT_CORNER_LEFT" 5 "REAR_CORNER_RIGHT" 4 "REAR_CORNER_LEFT" 3 "REAR" 2 "FRONT_FISHEYE" 1 "FRONT_NARROW" 0 "FRONT_MAIN" ;
VAL_ 112 TSR_Relevancy_0 10 "OTHER_FILTER_REASON" 9 "CONTRADICT_ARROW_SIGN" 8 "CIPV_IN_FRONT" 7 "ERROR_SIGN_CODE" 6 "INTERNAL_SIGN_CONTRADICTION" 5 "FAR_IRRELEVANT_SIGN" 4 "SIGN_ON_TURN" 3 "PARALLEL_ROAD_SIGN" 2 "LANE_ASSIGNMENT_SIGN" 1 "HIGHWAY_EXIT_SIGN" 0 "RELEVANT_SIGN" ;
VAL_ 112 TSR_Filter_Type_0 7 "RESERVED_3" 6 "RESERVED_2" 5 "RESERVED_1" 4 "ROAD_NUMBER" 3 "MINIMUM" 2 "EMBEDDED" 1 "TRUCK" 0 "NO_SLI_FILTER" ;
VAL_ 112 TSR_Sign_Shape_0 8 "RESERVED_3" 7 "RESERVED_2" 6 "PENTAGON" 5 "DIAMOND" 4 "TRIANGLE_DOWN" 3 "TRIANGLE_UP" 2 "RECTANGLE" 1 "CIRCLE" 0 "UNKNON" ;
VAL_ 112 TSR_Sign_Structure_0 3 "ELECTRONIC" 2 "VARIABLE" 1 "STANDARD" 0 "UNKNOWN" ;
VAL_ 224 OBJ_Relative_Long_Velocity_V_39 1 "VALID" 0 "INVALID" ;
VAL_ 224 OBJ_Rel_Long_Vel_STD_V_39 1 "VALID" 0 "INVALID" ;
VAL_ 224 OBJ_Relative_Lat_Velocity_V_39 1 "VALID" 0 "INVALID" ;
VAL_ 224 OBJ_Rel_Lat_Vel_STD_V_39 1 "VALID" 0 "INVALID" ;
VAL_ 224 OBJ_Long_Distance_V_39 1 "VALID" 0 "INVALID" ;
VAL_ 224 OBJ_Long_Distance_STD_V_39 1 "VALID" 0 "INVALID" ;
VAL_ 224 OBJ_Lat_Distance_V_39 1 "VALID" 0 "INVALID" ;
VAL_ 224 OBJ_Lat_Distance_STD_V_39 1 "VALID" 0 "INVALID" ;
VAL_ 224 OBJ_Absolute_Speed_V_39 1 "VALID" 0 "INVALID" ;
VAL_ 224 OBJ_Absolute_Speed_STD_V_39 1 "VALID" 0 "INVALID" ;
VAL_ 224 OBJ_Heading_V_39 1 "VALID" 0 "INVALID" ;
VAL_ 224 OBJ_Heading_STD_V_39 1 "VALID" 0 "INVALID" ;
VAL_ 224 OBJ_Angle_Rate_STD_V_39 1 "VALID" 0 "INVALID" ;
VAL_ 224 OBJ_Angle_Rate_V_39 1 "VALID" 0 "INVALID" ;
VAL_ 224 OBJ_Angle_Right_V_39 1 "VALID" 0 "INVALID" ;
VAL_ 224 OBJ_Angle_Right_STD_V_39 1 "VALID" 0 "INVALID" ;
VAL_ 224 OBJ_Angle_Left_V_39 1 "VALID" 0 "INVALID" ;
VAL_ 224 OBJ_Angle_Left_STD_V_39 1 "VALID" 0 "INVALID" ;
VAL_ 224 OBJ_Angle_Side_V_39 1 "VALID" 0 "INVALID" ;
VAL_ 224 OBJ_Angle_Side_STD_V_39 1 "VALID" 0 "INVALID" ;
VAL_ 224 OBJ_Angle_Mid_V_39 1 "VALID" 0 "INVALID" ;
VAL_ 224 OBJ_Angle_Mid_STD_V_39 1 "VALID" 0 "INVALID" ;
VAL_ 224 OBJ_Angle_Bottom_V_39 1 "VALID" 0 "INVALID" ;
VAL_ 224 OBJ_Angle_Bottom_STD_V_39 1 "VALID" 0 "INVALID" ;
VAL_ 224 OBJ_Visibility_Side_V_39 1 "VALID" 0 "INVALID" ;
VAL_ 224 OBJ_Visibility_Side_39 2 "REAR" 1 "FRONT" 0 "NOT_VISIBLE" ;
VAL_ 224 OBJ_Is_In_Drivable_Area_39 1 "TRUE" 0 "FALSE" ;
VAL_ 224 OBJ_Is_In_Drivable_Area_V_39 1 "VALID" 0 "INVALID" ;
VAL_ 224 OBJ_Is_VeryClose_39 1 "TRUE" 0 "FALSE" ;
VAL_ 224 OBJ_Is_VeryClose_V_39 1 "VALID" 0 "INVALID" ;
VAL_ 223 OBJ_Triggered_SDM_39 2 "NOT_TRIGGERED" 1 "TRIGGERED" 0 "NOT_AVAILABLE" ;
VAL_ 223 OBJ_Motion_Category_39 13 "ONCOMING" 12 "PRECEEDING" 11 "MOVING" 10 "RTAP" 9 "LTAP" 8 "CROSSING" 7 "MOVING_OUT" 6 "MOVING_IN" 5 "CLOSE_CUT_IN" 4 "PASSING_OUT" 3 "PASSING_IN" 2 "PASSING" 1 "UNDEFINED" 0 "INVALID" ;
VAL_ 223 OBJ_Measuring_Status_39 2 "(BIT_2)NOT_VALID_OR_VALID" 1 "(BIT_1)PREDICTED_OR_MEASURED" 0 "(BIT_0)OLD_OR_NEW" ;
VAL_ 223 OBJ_Object_Class_39 8 "UNCERTAIN_VCL" 7 "ANIMAL" 6 "GENERAL_OBJECT" 5 "PEDESTRIAN" 4 "BICYCLE" 3 "MOTOR_BIKE" 2 "TRUCK" 1 "CAR" 0 "INVALID" ;
VAL_ 223 OBJ_Camera_Source_39 11 "PARKING_RIGHT" 10 "PARKING_LEFT" 9 "PARKING_REAR" 8 "PARKING_FRONT" 7 "FRONT_CORNER_RIGHT" 6 "FRONT_CORNER_LEFT" 5 "REAR_CORNER_RIGHT" 4 "REAR_CORNER_LEFT" 3 "REAR" 2 "FRONT_FISHEYE" 1 "FRONT_NARROW" 0 "FRONT_MAIN" ;
VAL_ 223 OBJ_Motion_Status_39 5 "MOVING_SLOWLY" 4 "STOPPED" 3 "STATIONARY" 2 "MOVING" 1 "UNKNOWN" 0 "INVALID" ;
VAL_ 223 OBJ_Motion_Orientation_39 13 "UNKNOWN" 12 "PRECEEDING" 11 "DRIFTING_LEFT" 9 "CROSSING_LEFT" 7 "OC_DRIFTING_LEFT" 6 "ONCOMING" 5 "OC_DRIFTING_RIGHT" 3 "CROSSING_RIGHT" 1 "DRIFTING_RIGHT" 0 "INVALID" ;
VAL_ 223 OBJ_Has_Cut_Lane_39 1 "TRUE" 0 "FALSE" ;
VAL_ 223 OBJ_Has_Cut_Path_39 1 "TRUE" 0 "FALSE" ;
VAL_ 223 OBJ_Brake_Light_39 1 "TRUE" 0 "FALSE" ;
VAL_ 223 OBJ_Turn_Indicator_Right_39 1 "TRUE" 0 "FALSE" ;
VAL_ 223 OBJ_Turn_Indicator_Left_39 1 "TRUE" 0 "FALSE" ;
VAL_ 223 OBJ_Light_Indicator_Validity_39 1 "TRUE" 0 "FALSE" ;
VAL_ 223 OBJ_Right_Out_Of_Image_39 1 "TRUE" 0 "FALSE" ;
VAL_ 223 OBJ_Left_Out_Of_Image_39 1 "TRUE" 0 "FALSE" ;
VAL_ 223 OBJ_Right_Out_Of_Image_V_39 1 "TRUE" 0 "FALSE" ;
VAL_ 223 OBJ_Left_Out_Of_Image_V_39 1 "TRUE" 0 "FALSE" ;
VAL_ 223 OBJ_Top_Out_Of_Image_39 1 "TRUE" 0 "FALSE" ;
VAL_ 223 OBJ_Bottom_Out_Of_Image_39 1 "TRUE" 0 "FALSE" ;
VAL_ 223 OBJ_Top_Out_Of_Image_V_39 1 "VALID" 0 "INVALID" ;
VAL_ 223 OBJ_Bottom_Out_Of_Image_V_39 1 "VALID" 0 "INVALID" ;
VAL_ 223 OBJ_Lane_Assignment_39 5 "RIGHT_RIGHT" 4 "RIGHT" 3 "HOST" 2 "LEFT" 1 "LEFT_LEFT" 0 "UNKNOWN" ;
VAL_ 223 OBJ_Lane_Assignment_V_39 1 "VALID" 0 "INVALID" ;
VAL_ 223 OBJ_Age_Seconds_V_39 1 "VALID" 0 "INVALID" ;
VAL_ 223 OBJ_Width_V_39 1 "VALID" 0 "INVALID" ;
VAL_ 223 OBJ_Width_STD_V_39 1 "VALID" 0 "INVALID" ;
VAL_ 223 OBJ_Length_V_39 1 "VALID" 0 "INVALID" ;
VAL_ 223 OBJ_Length_STD_V_39 1 "VALID" 0 "INVALID" ;
VAL_ 223 OBJ_Height_V_39 1 "VALID" 0 "INVALID" ;
VAL_ 223 OBJ_Height_STD_V_39 1 "VALID" 0 "INVALID" ;
VAL_ 223 OBJ_Abs_Long_Velocity_V_39 1 "VALID" 0 "INVALID" ;
VAL_ 223 OBJ_Abs_Long_Vel_STD_V_39 1 "VALID" 0 "INVALID" ;
VAL_ 223 OBJ_Abs_Lat_Velocity_V_39 1 "VALID" 0 "INVALID" ;
VAL_ 223 OBJ_Abs_Lat_Vel_STD_V_39 1 "VALID" 0 "INVALID" ;
VAL_ 223 OBJ_Abs_Long_Acc_V_39 1 "VALID" 0 "INVALID" ;
VAL_ 223 OBJ_Abs_Long_Acc_STD_V_39 1 "VALID" 0 "INVALID" ;
VAL_ 223 OBJ_Abs_Lat_Acc_V_39 1 "VALID" 0 "INVALID" ;
VAL_ 223 OBJ_Abs_Lat_Acc_STD_V_39 1 "VALID" 0 "INVALID" ;
VAL_ 223 OBJ_Abs_Acceleration_V_39 1 "VALID" 0 "INVALID" ;
VAL_ 223 OBJ_Abs_Acc_STD_V_39 1 "VALID" 0 "INVALID" ;
VAL_ 223 OBJ_Inv_TTC_V_39 1 "VALID" 0 "INVALID" ;
VAL_ 223 OBJ_Inv_TTC_STD_V_39 1 "VALID" 0 "INVALID" ;
VAL_ 223 OBJ_Relative_Long_Acc_V_39 1 "VALID" 0 "INVALID" ;
VAL_ 223 OBJ_Rel_Long_Acc_STD_V_39 1 "VALID" 0 "INVALID" ;
VAL_ 222 OBJ_Relative_Long_Velocity_V_38 1 "VALID" 0 "INVALID" ;
VAL_ 222 OBJ_Rel_Long_Vel_STD_V_38 1 "VALID" 0 "INVALID" ;
VAL_ 222 OBJ_Relative_Lat_Velocity_V_38 1 "VALID" 0 "INVALID" ;
VAL_ 222 OBJ_Rel_Lat_Vel_STD_V_38 1 "VALID" 0 "INVALID" ;
VAL_ 222 OBJ_Long_Distance_V_38 1 "VALID" 0 "INVALID" ;
VAL_ 222 OBJ_Long_Distance_STD_V_38 1 "VALID" 0 "INVALID" ;
VAL_ 222 OBJ_Lat_Distance_V_38 1 "VALID" 0 "INVALID" ;
VAL_ 222 OBJ_Lat_Distance_STD_V_38 1 "VALID" 0 "INVALID" ;
VAL_ 222 OBJ_Absolute_Speed_V_38 1 "VALID" 0 "INVALID" ;
VAL_ 222 OBJ_Absolute_Speed_STD_V_38 1 "VALID" 0 "INVALID" ;
VAL_ 222 OBJ_Heading_V_38 1 "VALID" 0 "INVALID" ;
VAL_ 222 OBJ_Heading_STD_V_38 1 "VALID" 0 "INVALID" ;
VAL_ 222 OBJ_Angle_Rate_STD_V_38 1 "VALID" 0 "INVALID" ;
VAL_ 222 OBJ_Angle_Rate_V_38 1 "VALID" 0 "INVALID" ;
VAL_ 222 OBJ_Angle_Right_V_38 1 "VALID" 0 "INVALID" ;
VAL_ 222 OBJ_Angle_Right_STD_V_38 1 "VALID" 0 "INVALID" ;
VAL_ 222 OBJ_Angle_Left_V_38 1 "VALID" 0 "INVALID" ;
VAL_ 222 OBJ_Angle_Left_STD_V_38 1 "VALID" 0 "INVALID" ;
VAL_ 222 OBJ_Angle_Side_V_38 1 "VALID" 0 "INVALID" ;
VAL_ 222 OBJ_Angle_Side_STD_V_38 1 "VALID" 0 "INVALID" ;
VAL_ 222 OBJ_Angle_Mid_V_38 1 "VALID" 0 "INVALID" ;
VAL_ 222 OBJ_Angle_Mid_STD_V_38 1 "VALID" 0 "INVALID" ;
VAL_ 222 OBJ_Angle_Bottom_V_38 1 "VALID" 0 "INVALID" ;
VAL_ 222 OBJ_Angle_Bottom_STD_V_38 1 "VALID" 0 "INVALID" ;
VAL_ 222 OBJ_Visibility_Side_V_38 1 "VALID" 0 "INVALID" ;
VAL_ 222 OBJ_Visibility_Side_38 2 "REAR" 1 "FRONT" 0 "NOT_VISIBLE" ;
VAL_ 222 OBJ_Is_In_Drivable_Area_38 1 "TRUE" 0 "FALSE" ;
VAL_ 222 OBJ_Is_In_Drivable_Area_V_38 1 "VALID" 0 "INVALID" ;
VAL_ 222 OBJ_Is_VeryClose_38 1 "TRUE" 0 "FALSE" ;
VAL_ 222 OBJ_Is_VeryClose_V_38 1 "VALID" 0 "INVALID" ;
VAL_ 221 OBJ_Triggered_SDM_38 2 "NOT_TRIGGERED" 1 "TRIGGERED" 0 "NOT_AVAILABLE" ;
VAL_ 221 OBJ_Motion_Category_38 13 "ONCOMING" 12 "PRECEEDING" 11 "MOVING" 10 "RTAP" 9 "LTAP" 8 "CROSSING" 7 "MOVING_OUT" 6 "MOVING_IN" 5 "CLOSE_CUT_IN" 4 "PASSING_OUT" 3 "PASSING_IN" 2 "PASSING" 1 "UNDEFINED" 0 "INVALID" ;
VAL_ 221 OBJ_Measuring_Status_38 2 "(BIT_2)NOT_VALID_OR_VALID" 1 "(BIT_1)PREDICTED_OR_MEASURED" 0 "(BIT_0)OLD_OR_NEW" ;
VAL_ 221 OBJ_Object_Class_38 8 "UNCERTAIN_VCL" 7 "ANIMAL" 6 "GENERAL_OBJECT" 5 "PEDESTRIAN" 4 "BICYCLE" 3 "MOTOR_BIKE" 2 "TRUCK" 1 "CAR" 0 "INVALID" ;
VAL_ 221 OBJ_Camera_Source_38 11 "PARKING_RIGHT" 10 "PARKING_LEFT" 9 "PARKING_REAR" 8 "PARKING_FRONT" 7 "FRONT_CORNER_RIGHT" 6 "FRONT_CORNER_LEFT" 5 "REAR_CORNER_RIGHT" 4 "REAR_CORNER_LEFT" 3 "REAR" 2 "FRONT_FISHEYE" 1 "FRONT_NARROW" 0 "FRONT_MAIN" ;
VAL_ 221 OBJ_Motion_Status_38 5 "MOVING_SLOWLY" 4 "STOPPED" 3 "STATIONARY" 2 "MOVING" 1 "UNKNOWN" 0 "INVALID" ;
VAL_ 221 OBJ_Motion_Orientation_38 13 "UNKNOWN" 12 "PRECEEDING" 11 "DRIFTING_LEFT" 9 "CROSSING_LEFT" 7 "OC_DRIFTING_LEFT" 6 "ONCOMING" 5 "OC_DRIFTING_RIGHT" 3 "CROSSING_RIGHT" 1 "DRIFTING_RIGHT" 0 "INVALID" ;
VAL_ 221 OBJ_Has_Cut_Lane_38 1 "TRUE" 0 "FALSE" ;
VAL_ 221 OBJ_Has_Cut_Path_38 1 "TRUE" 0 "FALSE" ;
VAL_ 221 OBJ_Brake_Light_38 1 "TRUE" 0 "FALSE" ;
VAL_ 221 OBJ_Turn_Indicator_Right_38 1 "TRUE" 0 "FALSE" ;
VAL_ 221 OBJ_Turn_Indicator_Left_38 1 "TRUE" 0 "FALSE" ;
VAL_ 221 OBJ_Light_Indicator_Validity_38 1 "TRUE" 0 "FALSE" ;
VAL_ 221 OBJ_Right_Out_Of_Image_38 1 "TRUE" 0 "FALSE" ;
VAL_ 221 OBJ_Left_Out_Of_Image_38 1 "TRUE" 0 "FALSE" ;
VAL_ 221 OBJ_Right_Out_Of_Image_V_38 1 "TRUE" 0 "FALSE" ;
VAL_ 221 OBJ_Left_Out_Of_Image_V_38 1 "TRUE" 0 "FALSE" ;
VAL_ 221 OBJ_Top_Out_Of_Image_38 1 "TRUE" 0 "FALSE" ;
VAL_ 221 OBJ_Bottom_Out_Of_Image_38 1 "TRUE" 0 "FALSE" ;
VAL_ 221 OBJ_Top_Out_Of_Image_V_38 1 "VALID" 0 "INVALID" ;
VAL_ 221 OBJ_Bottom_Out_Of_Image_V_38 1 "VALID" 0 "INVALID" ;
VAL_ 221 OBJ_Lane_Assignment_38 5 "RIGHT_RIGHT" 4 "RIGHT" 3 "HOST" 2 "LEFT" 1 "LEFT_LEFT" 0 "UNKNOWN" ;
VAL_ 221 OBJ_Lane_Assignment_V_38 1 "VALID" 0 "INVALID" ;
VAL_ 221 OBJ_Age_Seconds_V_38 1 "VALID" 0 "INVALID" ;
VAL_ 221 OBJ_Width_V_38 1 "VALID" 0 "INVALID" ;
VAL_ 221 OBJ_Width_STD_V_38 1 "VALID" 0 "INVALID" ;
VAL_ 221 OBJ_Length_V_38 1 "VALID" 0 "INVALID" ;
VAL_ 221 OBJ_Length_STD_V_38 1 "VALID" 0 "INVALID" ;
VAL_ 221 OBJ_Height_V_38 1 "VALID" 0 "INVALID" ;
VAL_ 221 OBJ_Height_STD_V_38 1 "VALID" 0 "INVALID" ;
VAL_ 221 OBJ_Abs_Long_Velocity_V_38 1 "VALID" 0 "INVALID" ;
VAL_ 221 OBJ_Abs_Long_Vel_STD_V_38 1 "VALID" 0 "INVALID" ;
VAL_ 221 OBJ_Abs_Lat_Velocity_V_38 1 "VALID" 0 "INVALID" ;
VAL_ 221 OBJ_Abs_Lat_Vel_STD_V_38 1 "VALID" 0 "INVALID" ;
VAL_ 221 OBJ_Abs_Long_Acc_V_38 1 "VALID" 0 "INVALID" ;
VAL_ 221 OBJ_Abs_Long_Acc_STD_V_38 1 "VALID" 0 "INVALID" ;
VAL_ 221 OBJ_Abs_Lat_Acc_V_38 1 "VALID" 0 "INVALID" ;
VAL_ 221 OBJ_Abs_Lat_Acc_STD_V_38 1 "VALID" 0 "INVALID" ;
VAL_ 221 OBJ_Abs_Acceleration_V_38 1 "VALID" 0 "INVALID" ;
VAL_ 221 OBJ_Abs_Acc_STD_V_38 1 "VALID" 0 "INVALID" ;
VAL_ 221 OBJ_Inv_TTC_V_38 1 "VALID" 0 "INVALID" ;
VAL_ 221 OBJ_Inv_TTC_STD_V_38 1 "VALID" 0 "INVALID" ;
VAL_ 221 OBJ_Relative_Long_Acc_V_38 1 "VALID" 0 "INVALID" ;
VAL_ 221 OBJ_Rel_Long_Acc_STD_V_38 1 "VALID" 0 "INVALID" ;
VAL_ 220 OBJ_Relative_Long_Velocity_V_37 1 "VALID" 0 "INVALID" ;
VAL_ 220 OBJ_Rel_Long_Vel_STD_V_37 1 "VALID" 0 "INVALID" ;
VAL_ 220 OBJ_Relative_Lat_Velocity_V_37 1 "VALID" 0 "INVALID" ;
VAL_ 220 OBJ_Rel_Lat_Vel_STD_V_37 1 "VALID" 0 "INVALID" ;
VAL_ 220 OBJ_Long_Distance_V_37 1 "VALID" 0 "INVALID" ;
VAL_ 220 OBJ_Long_Distance_STD_V_37 1 "VALID" 0 "INVALID" ;
VAL_ 220 OBJ_Lat_Distance_V_37 1 "VALID" 0 "INVALID" ;
VAL_ 220 OBJ_Lat_Distance_STD_V_37 1 "VALID" 0 "INVALID" ;
VAL_ 220 OBJ_Absolute_Speed_V_37 1 "VALID" 0 "INVALID" ;
VAL_ 220 OBJ_Absolute_Speed_STD_V_37 1 "VALID" 0 "INVALID" ;
VAL_ 220 OBJ_Heading_V_37 1 "VALID" 0 "INVALID" ;
VAL_ 220 OBJ_Heading_STD_V_37 1 "VALID" 0 "INVALID" ;
VAL_ 220 OBJ_Angle_Rate_STD_V_37 1 "VALID" 0 "INVALID" ;
VAL_ 220 OBJ_Angle_Rate_V_37 1 "VALID" 0 "INVALID" ;
VAL_ 220 OBJ_Angle_Right_V_37 1 "VALID" 0 "INVALID" ;
VAL_ 220 OBJ_Angle_Right_STD_V_37 1 "VALID" 0 "INVALID" ;
VAL_ 220 OBJ_Angle_Left_V_37 1 "VALID" 0 "INVALID" ;
VAL_ 220 OBJ_Angle_Left_STD_V_37 1 "VALID" 0 "INVALID" ;
VAL_ 220 OBJ_Angle_Side_V_37 1 "VALID" 0 "INVALID" ;
VAL_ 220 OBJ_Angle_Side_STD_V_37 1 "VALID" 0 "INVALID" ;
VAL_ 220 OBJ_Angle_Mid_V_37 1 "VALID" 0 "INVALID" ;
VAL_ 220 OBJ_Angle_Mid_STD_V_37 1 "VALID" 0 "INVALID" ;
VAL_ 220 OBJ_Angle_Bottom_V_37 1 "VALID" 0 "INVALID" ;
VAL_ 220 OBJ_Angle_Bottom_STD_V_37 1 "VALID" 0 "INVALID" ;
VAL_ 220 OBJ_Visibility_Side_V_37 1 "VALID" 0 "INVALID" ;
VAL_ 220 OBJ_Visibility_Side_37 2 "REAR" 1 "FRONT" 0 "NOT_VISIBLE" ;
VAL_ 220 OBJ_Is_In_Drivable_Area_37 1 "TRUE" 0 "FALSE" ;
VAL_ 220 OBJ_Is_In_Drivable_Area_V_37 1 "VALID" 0 "INVALID" ;
VAL_ 220 OBJ_Is_VeryClose_37 1 "TRUE" 0 "FALSE" ;
VAL_ 220 OBJ_Is_VeryClose_V_37 1 "VALID" 0 "INVALID" ;
VAL_ 219 OBJ_Triggered_SDM_37 2 "NOT_TRIGGERED" 1 "TRIGGERED" 0 "NOT_AVAILABLE" ;
VAL_ 219 OBJ_Motion_Category_37 13 "ONCOMING" 12 "PRECEEDING" 11 "MOVING" 10 "RTAP" 9 "LTAP" 8 "CROSSING" 7 "MOVING_OUT" 6 "MOVING_IN" 5 "CLOSE_CUT_IN" 4 "PASSING_OUT" 3 "PASSING_IN" 2 "PASSING" 1 "UNDEFINED" 0 "INVALID" ;
VAL_ 219 OBJ_Measuring_Status_37 2 "(BIT_2)NOT_VALID_OR_VALID" 1 "(BIT_1)PREDICTED_OR_MEASURED" 0 "(BIT_0)OLD_OR_NEW" ;
VAL_ 219 OBJ_Object_Class_37 8 "UNCERTAIN_VCL" 7 "ANIMAL" 6 "GENERAL_OBJECT" 5 "PEDESTRIAN" 4 "BICYCLE" 3 "MOTOR_BIKE" 2 "TRUCK" 1 "CAR" 0 "INVALID" ;
VAL_ 219 OBJ_Camera_Source_37 11 "PARKING_RIGHT" 10 "PARKING_LEFT" 9 "PARKING_REAR" 8 "PARKING_FRONT" 7 "FRONT_CORNER_RIGHT" 6 "FRONT_CORNER_LEFT" 5 "REAR_CORNER_RIGHT" 4 "REAR_CORNER_LEFT" 3 "REAR" 2 "FRONT_FISHEYE" 1 "FRONT_NARROW" 0 "FRONT_MAIN" ;
VAL_ 219 OBJ_Motion_Status_37 5 "MOVING_SLOWLY" 4 "STOPPED" 3 "STATIONARY" 2 "MOVING" 1 "UNKNOWN" 0 "INVALID" ;
VAL_ 219 OBJ_Motion_Orientation_37 13 "UNKNOWN" 12 "PRECEEDING" 11 "DRIFTING_LEFT" 9 "CROSSING_LEFT" 7 "OC_DRIFTING_LEFT" 6 "ONCOMING" 5 "OC_DRIFTING_RIGHT" 3 "CROSSING_RIGHT" 1 "DRIFTING_RIGHT" 0 "INVALID" ;
VAL_ 219 OBJ_Has_Cut_Lane_37 1 "TRUE" 0 "FALSE" ;
VAL_ 219 OBJ_Has_Cut_Path_37 1 "TRUE" 0 "FALSE" ;
VAL_ 219 OBJ_Brake_Light_37 1 "TRUE" 0 "FALSE" ;
VAL_ 219 OBJ_Turn_Indicator_Right_37 1 "TRUE" 0 "FALSE" ;
VAL_ 219 OBJ_Turn_Indicator_Left_37 1 "TRUE" 0 "FALSE" ;
VAL_ 219 OBJ_Light_Indicator_Validity_37 1 "TRUE" 0 "FALSE" ;
VAL_ 219 OBJ_Right_Out_Of_Image_37 1 "TRUE" 0 "FALSE" ;
VAL_ 219 OBJ_Left_Out_Of_Image_37 1 "TRUE" 0 "FALSE" ;
VAL_ 219 OBJ_Right_Out_Of_Image_V_37 1 "TRUE" 0 "FALSE" ;
VAL_ 219 OBJ_Left_Out_Of_Image_V_37 1 "TRUE" 0 "FALSE" ;
VAL_ 219 OBJ_Top_Out_Of_Image_37 1 "TRUE" 0 "FALSE" ;
VAL_ 219 OBJ_Bottom_Out_Of_Image_37 1 "TRUE" 0 "FALSE" ;
VAL_ 219 OBJ_Top_Out_Of_Image_V_37 1 "VALID" 0 "INVALID" ;
VAL_ 219 OBJ_Bottom_Out_Of_Image_V_37 1 "VALID" 0 "INVALID" ;
VAL_ 219 OBJ_Lane_Assignment_37 5 "RIGHT_RIGHT" 4 "RIGHT" 3 "HOST" 2 "LEFT" 1 "LEFT_LEFT" 0 "UNKNOWN" ;
VAL_ 219 OBJ_Lane_Assignment_V_37 1 "VALID" 0 "INVALID" ;
VAL_ 219 OBJ_Age_Seconds_V_37 1 "VALID" 0 "INVALID" ;
VAL_ 219 OBJ_Width_V_37 1 "VALID" 0 "INVALID" ;
VAL_ 219 OBJ_Width_STD_V_37 1 "VALID" 0 "INVALID" ;
VAL_ 219 OBJ_Length_V_37 1 "VALID" 0 "INVALID" ;
VAL_ 219 OBJ_Length_STD_V_37 1 "VALID" 0 "INVALID" ;
VAL_ 219 OBJ_Height_V_37 1 "VALID" 0 "INVALID" ;
VAL_ 219 OBJ_Height_STD_V_37 1 "VALID" 0 "INVALID" ;
VAL_ 219 OBJ_Abs_Long_Velocity_V_37 1 "VALID" 0 "INVALID" ;
VAL_ 219 OBJ_Abs_Long_Vel_STD_V_37 1 "VALID" 0 "INVALID" ;
VAL_ 219 OBJ_Abs_Lat_Velocity_V_37 1 "VALID" 0 "INVALID" ;
VAL_ 219 OBJ_Abs_Lat_Vel_STD_V_37 1 "VALID" 0 "INVALID" ;
VAL_ 219 OBJ_Abs_Long_Acc_V_37 1 "VALID" 0 "INVALID" ;
VAL_ 219 OBJ_Abs_Long_Acc_STD_V_37 1 "VALID" 0 "INVALID" ;
VAL_ 219 OBJ_Abs_Lat_Acc_V_37 1 "VALID" 0 "INVALID" ;
VAL_ 219 OBJ_Abs_Lat_Acc_STD_V_37 1 "VALID" 0 "INVALID" ;
VAL_ 219 OBJ_Abs_Acceleration_V_37 1 "VALID" 0 "INVALID" ;
VAL_ 219 OBJ_Abs_Acc_STD_V_37 1 "VALID" 0 "INVALID" ;
VAL_ 219 OBJ_Inv_TTC_V_37 1 "VALID" 0 "INVALID" ;
VAL_ 219 OBJ_Inv_TTC_STD_V_37 1 "VALID" 0 "INVALID" ;
VAL_ 219 OBJ_Relative_Long_Acc_V_37 1 "VALID" 0 "INVALID" ;
VAL_ 219 OBJ_Rel_Long_Acc_STD_V_37 1 "VALID" 0 "INVALID" ;
VAL_ 218 OBJ_Relative_Long_Velocity_V_36 1 "VALID" 0 "INVALID" ;
VAL_ 218 OBJ_Rel_Long_Vel_STD_V_36 1 "VALID" 0 "INVALID" ;
VAL_ 218 OBJ_Relative_Lat_Velocity_V_36 1 "VALID" 0 "INVALID" ;
VAL_ 218 OBJ_Rel_Lat_Vel_STD_V_36 1 "VALID" 0 "INVALID" ;
VAL_ 218 OBJ_Long_Distance_V_36 1 "VALID" 0 "INVALID" ;
VAL_ 218 OBJ_Long_Distance_STD_V_36 1 "VALID" 0 "INVALID" ;
VAL_ 218 OBJ_Lat_Distance_V_36 1 "VALID" 0 "INVALID" ;
VAL_ 218 OBJ_Lat_Distance_STD_V_36 1 "VALID" 0 "INVALID" ;
VAL_ 218 OBJ_Absolute_Speed_V_36 1 "VALID" 0 "INVALID" ;
VAL_ 218 OBJ_Absolute_Speed_STD_V_36 1 "VALID" 0 "INVALID" ;
VAL_ 218 OBJ_Heading_V_36 1 "VALID" 0 "INVALID" ;
VAL_ 218 OBJ_Heading_STD_V_36 1 "VALID" 0 "INVALID" ;
VAL_ 218 OBJ_Angle_Rate_STD_V_36 1 "VALID" 0 "INVALID" ;
VAL_ 218 OBJ_Angle_Rate_V_36 1 "VALID" 0 "INVALID" ;
VAL_ 218 OBJ_Angle_Right_V_36 1 "VALID" 0 "INVALID" ;
VAL_ 218 OBJ_Angle_Right_STD_V_36 1 "VALID" 0 "INVALID" ;
VAL_ 218 OBJ_Angle_Left_V_36 1 "VALID" 0 "INVALID" ;
VAL_ 218 OBJ_Angle_Left_STD_V_36 1 "VALID" 0 "INVALID" ;
VAL_ 218 OBJ_Angle_Side_V_36 1 "VALID" 0 "INVALID" ;
VAL_ 218 OBJ_Angle_Side_STD_V_36 1 "VALID" 0 "INVALID" ;
VAL_ 218 OBJ_Angle_Mid_V_36 1 "VALID" 0 "INVALID" ;
VAL_ 218 OBJ_Angle_Mid_STD_V_36 1 "VALID" 0 "INVALID" ;
VAL_ 218 OBJ_Angle_Bottom_V_36 1 "VALID" 0 "INVALID" ;
VAL_ 218 OBJ_Angle_Bottom_STD_V_36 1 "VALID" 0 "INVALID" ;
VAL_ 218 OBJ_Visibility_Side_V_36 1 "VALID" 0 "INVALID" ;
VAL_ 218 OBJ_Visibility_Side_36 2 "REAR" 1 "FRONT" 0 "NOT_VISIBLE" ;
VAL_ 218 OBJ_Is_In_Drivable_Area_36 1 "TRUE" 0 "FALSE" ;
VAL_ 218 OBJ_Is_In_Drivable_Area_V_36 1 "VALID" 0 "INVALID" ;
VAL_ 218 OBJ_Is_VeryClose_36 1 "TRUE" 0 "FALSE" ;
VAL_ 218 OBJ_Is_VeryClose_V_36 1 "VALID" 0 "INVALID" ;
VAL_ 217 OBJ_Triggered_SDM_36 2 "NOT_TRIGGERED" 1 "TRIGGERED" 0 "NOT_AVAILABLE" ;
VAL_ 217 OBJ_Motion_Category_36 13 "ONCOMING" 12 "PRECEEDING" 11 "MOVING" 10 "RTAP" 9 "LTAP" 8 "CROSSING" 7 "MOVING_OUT" 6 "MOVING_IN" 5 "CLOSE_CUT_IN" 4 "PASSING_OUT" 3 "PASSING_IN" 2 "PASSING" 1 "UNDEFINED" 0 "INVALID" ;
VAL_ 217 OBJ_Measuring_Status_36 2 "(BIT_2)NOT_VALID_OR_VALID" 1 "(BIT_1)PREDICTED_OR_MEASURED" 0 "(BIT_0)OLD_OR_NEW" ;
VAL_ 217 OBJ_Object_Class_36 8 "UNCERTAIN_VCL" 7 "ANIMAL" 6 "GENERAL_OBJECT" 5 "PEDESTRIAN" 4 "BICYCLE" 3 "MOTOR_BIKE" 2 "TRUCK" 1 "CAR" 0 "INVALID" ;
VAL_ 217 OBJ_Camera_Source_36 11 "PARKING_RIGHT" 10 "PARKING_LEFT" 9 "PARKING_REAR" 8 "PARKING_FRONT" 7 "FRONT_CORNER_RIGHT" 6 "FRONT_CORNER_LEFT" 5 "REAR_CORNER_RIGHT" 4 "REAR_CORNER_LEFT" 3 "REAR" 2 "FRONT_FISHEYE" 1 "FRONT_NARROW" 0 "FRONT_MAIN" ;
VAL_ 217 OBJ_Motion_Status_36 5 "MOVING_SLOWLY" 4 "STOPPED" 3 "STATIONARY" 2 "MOVING" 1 "UNKNOWN" 0 "INVALID" ;
VAL_ 217 OBJ_Motion_Orientation_36 13 "UNKNOWN" 12 "PRECEEDING" 11 "DRIFTING_LEFT" 9 "CROSSING_LEFT" 7 "OC_DRIFTING_LEFT" 6 "ONCOMING" 5 "OC_DRIFTING_RIGHT" 3 "CROSSING_RIGHT" 1 "DRIFTING_RIGHT" 0 "INVALID" ;
VAL_ 217 OBJ_Has_Cut_Lane_36 1 "TRUE" 0 "FALSE" ;
VAL_ 217 OBJ_Has_Cut_Path_36 1 "TRUE" 0 "FALSE" ;
VAL_ 217 OBJ_Brake_Light_36 1 "TRUE" 0 "FALSE" ;
VAL_ 217 OBJ_Turn_Indicator_Right_36 1 "TRUE" 0 "FALSE" ;
VAL_ 217 OBJ_Turn_Indicator_Left_36 1 "TRUE" 0 "FALSE" ;
VAL_ 217 OBJ_Light_Indicator_Validity_36 1 "TRUE" 0 "FALSE" ;
VAL_ 217 OBJ_Right_Out_Of_Image_36 1 "TRUE" 0 "FALSE" ;
VAL_ 217 OBJ_Left_Out_Of_Image_36 1 "TRUE" 0 "FALSE" ;
VAL_ 217 OBJ_Right_Out_Of_Image_V_36 1 "TRUE" 0 "FALSE" ;
VAL_ 217 OBJ_Left_Out_Of_Image_V_36 1 "TRUE" 0 "FALSE" ;
VAL_ 217 OBJ_Top_Out_Of_Image_36 1 "TRUE" 0 "FALSE" ;
VAL_ 217 OBJ_Bottom_Out_Of_Image_36 1 "TRUE" 0 "FALSE" ;
VAL_ 217 OBJ_Top_Out_Of_Image_V_36 1 "VALID" 0 "INVALID" ;
VAL_ 217 OBJ_Bottom_Out_Of_Image_V_36 1 "VALID" 0 "INVALID" ;
VAL_ 217 OBJ_Lane_Assignment_36 5 "RIGHT_RIGHT" 4 "RIGHT" 3 "HOST" 2 "LEFT" 1 "LEFT_LEFT" 0 "UNKNOWN" ;
VAL_ 217 OBJ_Lane_Assignment_V_36 1 "VALID" 0 "INVALID" ;
VAL_ 217 OBJ_Age_Seconds_V_36 1 "VALID" 0 "INVALID" ;
VAL_ 217 OBJ_Width_V_36 1 "VALID" 0 "INVALID" ;
VAL_ 217 OBJ_Width_STD_V_36 1 "VALID" 0 "INVALID" ;
VAL_ 217 OBJ_Length_V_36 1 "VALID" 0 "INVALID" ;
VAL_ 217 OBJ_Length_STD_V_36 1 "VALID" 0 "INVALID" ;
VAL_ 217 OBJ_Height_V_36 1 "VALID" 0 "INVALID" ;
VAL_ 217 OBJ_Height_STD_V_36 1 "VALID" 0 "INVALID" ;
VAL_ 217 OBJ_Abs_Long_Velocity_V_36 1 "VALID" 0 "INVALID" ;
VAL_ 217 OBJ_Abs_Long_Vel_STD_V_36 1 "VALID" 0 "INVALID" ;
VAL_ 217 OBJ_Abs_Lat_Velocity_V_36 1 "VALID" 0 "INVALID" ;
VAL_ 217 OBJ_Abs_Lat_Vel_STD_V_36 1 "VALID" 0 "INVALID" ;
VAL_ 217 OBJ_Abs_Long_Acc_V_36 1 "VALID" 0 "INVALID" ;
VAL_ 217 OBJ_Abs_Long_Acc_STD_V_36 1 "VALID" 0 "INVALID" ;
VAL_ 217 OBJ_Abs_Lat_Acc_V_36 1 "VALID" 0 "INVALID" ;
VAL_ 217 OBJ_Abs_Lat_Acc_STD_V_36 1 "VALID" 0 "INVALID" ;
VAL_ 217 OBJ_Abs_Acceleration_V_36 1 "VALID" 0 "INVALID" ;
VAL_ 217 OBJ_Abs_Acc_STD_V_36 1 "VALID" 0 "INVALID" ;
VAL_ 217 OBJ_Inv_TTC_V_36 1 "VALID" 0 "INVALID" ;
VAL_ 217 OBJ_Inv_TTC_STD_V_36 1 "VALID" 0 "INVALID" ;
VAL_ 217 OBJ_Relative_Long_Acc_V_36 1 "VALID" 0 "INVALID" ;
VAL_ 217 OBJ_Rel_Long_Acc_STD_V_36 1 "VALID" 0 "INVALID" ;
SIG_GROUP_ 48 SystemSyncTimer 1 : SysSyncTmr SysSyncTmrCrc;
SIG_GROUP_ 82 ICM_Failsafe_Prot_C 1 : ICM_Failsafe_Prot_C_CRC ICM_Failsafe_Prot_C_Header FS_CRC_9 FS_Camera_ID_9 FS_Free_Sight_9 FS_Splashes_9 FS_Sun_Ray_9 FS_Low_Sun_9 FS_Blur_Image_9 FS_Partial_Blockage_9 FS_Full_Blockage_9 FS_Frozen_Windshield_9 FS_Out_Of_Focus_9 FS_C2C_Out_Of_Calib_9 FS_CRC_10 FS_Camera_ID_10 FS_Free_Sight_10 FS_Splashes_10 FS_Sun_Ray_10 FS_Low_Sun_10 FS_Blur_Image_10 FS_Partial_Blockage_10 FS_Full_Blockage_10 FS_Frozen_Windshield_10 FS_Out_Of_Focus_10 FS_C2C_Out_Of_Calib_10 FS_CRC_11 FS_Camera_ID_11 FS_Free_Sight_11 FS_Splashes_11 FS_Sun_Ray_11 FS_Low_Sun_11 FS_Blur_Image_11 FS_Partial_Blockage_11 FS_Full_Blockage_11 FS_Frozen_Windshield_11 FS_Out_Of_Focus_11 FS_C2C_Out_Of_Calib_11 FS_CRC_12 FS_Camera_ID_12 FS_Free_Sight_12 FS_Splashes_12 FS_Sun_Ray_12 FS_Low_Sun_12 FS_Blur_Image_12 FS_Partial_Blockage_12 FS_Full_Blockage_12 FS_Frozen_Windshield_12 FS_Out_Of_Focus_12 FS_C2C_Out_Of_Calib_12 FS_CRC_13 FS_Camera_ID_13 FS_Free_Sight_13 FS_Splashes_13 FS_Sun_Ray_13 FS_Low_Sun_13 FS_Blur_Image_13 FS_Partial_Blockage_13 FS_Full_Blockage_13 FS_Frozen_Windshield_13 FS_Out_Of_Focus_13 FS_C2C_Out_Of_Calib_13 FS_CRC_14 FS_Camera_ID_14 FS_Free_Sight_14 FS_Splashes_14 FS_Sun_Ray_14 FS_Low_Sun_14 FS_Blur_Image_14 FS_Partial_Blockage_14 FS_Full_Blockage_14 FS_Frozen_Windshield_14 FS_Out_Of_Focus_14 FS_C2C_Out_Of_Calib_14;
SIG_GROUP_ 81 ICM_Failsafe_Prot_B 1 : ICM_Failsafe_Prot_B_Header FS_CRC_3 FS_Camera_ID_3 FS_Free_Sight_3 FS_Splashes_3 FS_Sun_Ray_3 FS_Low_Sun_3 FS_Blur_Image_3 FS_Partial_Blockage_3 FS_Full_Blockage_3 FS_Frozen_Windshield_3 FS_Out_Of_Focus_3 FS_C2C_Out_Of_Calib_3 FS_CRC_4 FS_Camera_ID_4 FS_Free_Sight_4 FS_Splashes_4 FS_Sun_Ray_4 FS_Low_Sun_4 FS_Blur_Image_4 FS_Partial_Blockage_4 FS_Full_Blockage_4 FS_Frozen_Windshield_4 FS_Out_Of_Focus_4 FS_C2C_Out_Of_Calib_4 FS_CRC_5 FS_Camera_ID_5 FS_Free_Sight_5 FS_Splashes_5 FS_Sun_Ray_5 FS_Low_Sun_5 FS_Blur_Image_5 FS_Partial_Blockage_5 FS_Full_Blockage_5 FS_Frozen_Windshield_5 FS_Out_Of_Focus_5 FS_C2C_Out_Of_Calib_5 FS_CRC_6 FS_Camera_ID_6 FS_Free_Sight_6 FS_Splashes_6 FS_Sun_Ray_6 FS_Low_Sun_6 FS_Blur_Image_6 FS_Partial_Blockage_6 FS_Full_Blockage_6 FS_Frozen_Windshield_6 FS_Out_Of_Focus_6 FS_C2C_Out_Of_Calib_6 FS_CRC_7 FS_Camera_ID_7 FS_Free_Sight_7 FS_Splashes_7 FS_Sun_Ray_7 FS_Low_Sun_7 FS_Blur_Image_7 FS_Partial_Blockage_7 FS_Full_Blockage_7 FS_Frozen_Windshield_7 FS_Out_Of_Focus_7 FS_C2C_Out_Of_Calib_7 FS_CRC_8 FS_Camera_ID_8 FS_Free_Sight_8 FS_Splashes_8 FS_Sun_Ray_8 FS_Low_Sun_8 FS_Blur_Image_8 FS_Partial_Blockage_8 FS_Full_Blockage_8 FS_Frozen_Windshield_8 FS_Out_Of_Focus_8 FS_C2C_Out_Of_Calib_8;
SIG_GROUP_ 80 ICM_Failsafe_Prot_A 1 : FS_Frozen_Windshield_1 FS_Frozen_Windshield_2 ICM_Failsafe_Prot_A_Header FS_TSR_Out_OF_Calib FS_Zero_byte FS_Header_CRC FS_Protocol_Version FS_Sync_ID FS_Cameras_Number FS_Impacted_Technologies FS_Rain FS_Fog FS_Frozen_Windshield_0 FS_Calibration_Misalignment FS_Out_Of_Calib FS_Header_Buffer FS_CRC_0 FS_Camera_ID_0 FS_Free_Sight_0 FS_Splashes_0 FS_Sun_Ray_0 FS_Low_Sun_0 FS_Blur_Image_0 FS_Partial_Blockage_0 FS_Full_Blockage_0 FS_Out_Of_Focus_0 FS_C2C_Out_Of_Calib_0 FS_CRC_1 FS_Camera_ID_1 FS_Free_Sight_1 FS_Splashes_1 FS_Sun_Ray_1 FS_Low_Sun_1 FS_Blur_Image_1 FS_Partial_Blockage_1 FS_Full_Blockage_1 FS_Out_Of_Focus_1 FS_C2C_Out_Of_Calib_1 FS_CRC_2 FS_Camera_ID_2 FS_Free_Sight_2 FS_Splashes_2 FS_Sun_Ray_2 FS_Low_Sun_2 FS_Blur_Image_2 FS_Partial_Blockage_2 FS_Full_Blockage_2 FS_Out_Of_Focus_2 FS_C2C_Out_Of_Calib_2;
SIG_GROUP_ 79 ICM_Lanes_Host_Prot_B_2 1 : LH_Line_Second_C1_1 LH_Line_Second_C0_1 LH_Second_VR_End_1 LH_Second_VR_Start_1 LH_Line_Second_C3_1 LH_Line_Second_C2_1 ICM_La_Host_Prot_B_2_Header ICM_La_Host_Prot_B_2_CRC LH_Buffer_1;
SIG_GROUP_ 78 ICM_Lanes_Host_Prot_B_1 1 : LH_Second_Measured_VR_End_1 LH_First_Measured_VR_End_1 LH_First_VR_End_1 LH_First_VR_Start_1 LH_Line_First_C3_1 LH_Line_First_C2_1 LH_Line_First_C1_1 LH_Line_First_C0_1 LH_Is_Multi_Clothoid_1 LH_Dash_Average_Gap_1 LH_Dash_Average_Length_1 LH_Marker_Width_STD_1 LH_Marker_Width_1 LH_Crossing_1 LH_Side_1 LH_Lanemark_Type_Conf_1 LH_DECEL_Type_1 LH_DLM_Type_1 LH_Lanemark_Type_1 LH_Color_Confidence_1 LH_Color_1 LH_Prediction_Type_1 LH_Prediction_Source_1 LH_Existence_Probability_1 LH_Age_1 LH_Track_ID_1 LH_CRC_1 ICM_La_Host_Prot_B_1_Header LH_Is_Triggered_SDM_Type_1 LH_Is_Triggered_SDM_Model_1;
SIG_GROUP_ 77 ICM_Lanes_Host_Prot_A_2 1 : LH_Line_Second_C1_0 LH_Line_Second_C0_0 LH_Second_VR_End_0 LH_Second_VR_Start_0 LH_Line_Second_C3_0 LH_Line_Second_C2_0 ICM_La_Host_Prot_A_2_Header LH_Buffer_0;
SIG_GROUP_ 76 ICM_Lanes_Host_Prot_A_1 1 : LH_Second_Measured_VR_End_0 LH_First_Measured_VR_End_0 LH_First_VR_End_0 LH_First_VR_Start_0 LH_Line_First_C3_0 LH_Line_First_C2_0 LH_Line_First_C1_0 LH_Line_First_C0_0 LH_Is_Multi_Clothoid_0 LH_Dash_Average_Gap_0 LH_Dash_Average_Length_0 LH_Marker_Width_STD_0 LH_Marker_Width_0 LH_Crossing_0 LH_Side_0 LH_Lanemark_Type_Conf_0 LH_DECEL_Type_0 LH_DLM_Type_0 LH_Lanemark_Type_0 LH_Color_Confidence_0 LH_Color_0 LH_Prediction_Type_0 LH_Prediction_Source_0 LH_Existence_Probability_0 LH_Age_0 LH_Track_ID_0 LH_CRC_0 ICM_La_Host_Prot_A_1_Header LH_Is_Triggered_SDM_Type_0 LH_Is_Triggered_SDM_Model_0;
SIG_GROUP_ 131 ICM_Traffic_Signs19 1 : ICM_Traffic_Signs19_CRC TSR_Buffer_19 TSR_Sign_Panel_Width_STD_19 TSR_Sign_Panel_Height_19 TSR_Sign_Panel_Width_19 TSR_Sign_Height_STD_19 TSR_Sign_Panel_Height_STD_19 TSR_Sign_Height_19 TSR_Sign_Lat_Distance_STD_19 TSR_Sign_Lateral_Distance_19 TSR_Sign_Long_Distance_STD_19 TSR_Sign_Long_Distance_19 TSR_Tracking_Age_19 TSR_Sign_Structure_19 TSR_Sign_Shape_19 TSR_Confidence_19 TSR_Sup2_Confidence_19 TSR_Sup2_SignName_19 TSR_Sup1_Confidence_19 TSR_Sup1_SignName_19 TSR_Filter_Type_19 TSR_Relevancy_19 TSR_Sign_Name_19 TSR_Camera_Source_19 TSR_ID_19 ICM_Traffic_Signs19_Header;
SIG_GROUP_ 130 ICM_Traffic_Signs18 1 : TSR_Buffer_18 TSR_Sign_Panel_Width_STD_18 TSR_Sign_Panel_Height_18 TSR_Sign_Panel_Width_18 TSR_Sign_Height_STD_18 TSR_Sign_Panel_Height_STD_18 TSR_Sign_Height_18 TSR_Sign_Lat_Distance_STD_18 TSR_Sign_Lateral_Distance_18 TSR_Sign_Long_Distance_STD_18 TSR_Sign_Long_Distance_18 TSR_Tracking_Age_18 TSR_Sign_Structure_18 TSR_Sign_Shape_18 TSR_Confidence_18 TSR_Sup2_Confidence_18 TSR_Sup2_SignName_18 TSR_Sup1_Confidence_18 TSR_Sup1_SignName_18 TSR_Filter_Type_18 TSR_Relevancy_18 TSR_Sign_Name_18 TSR_Camera_Source_18 TSR_ID_18 ICM_Traffic_Signs18_Header;
SIG_GROUP_ 129 ICM_Traffic_Signs17 1 : TSR_Buffer_17 TSR_Sign_Panel_Width_STD_17 TSR_Sign_Panel_Height_17 TSR_Sign_Panel_Width_17 TSR_Sign_Height_STD_17 TSR_Sign_Panel_Height_STD_17 TSR_Sign_Height_17 TSR_Sign_Lat_Distance_STD_17 TSR_Sign_Lateral_Distance_17 TSR_Sign_Long_Distance_STD_17 TSR_Sign_Long_Distance_17 TSR_Tracking_Age_17 TSR_Sign_Structure_17 TSR_Sign_Shape_17 TSR_Confidence_17 TSR_Sup2_Confidence_17 TSR_Sup2_SignName_17 TSR_Sup1_Confidence_17 TSR_Sup1_SignName_17 TSR_Filter_Type_17 TSR_Relevancy_17 TSR_Sign_Name_17 TSR_Camera_Source_17 TSR_ID_17 ICM_Traffic_Signs17_Header;
SIG_GROUP_ 128 ICM_Traffic_Signs16 1 : TSR_Buffer_16 TSR_Sign_Panel_Width_STD_16 TSR_Sign_Panel_Height_16 TSR_Sign_Panel_Width_16 TSR_Sign_Height_STD_16 TSR_Sign_Panel_Height_STD_16 TSR_Sign_Height_16 TSR_Sign_Lat_Distance_STD_16 TSR_Sign_Lateral_Distance_16 TSR_Sign_Long_Distance_STD_16 TSR_Sign_Long_Distance_16 TSR_Tracking_Age_16 TSR_Sign_Structure_16 TSR_Sign_Shape_16 TSR_Confidence_16 TSR_Sup2_Confidence_16 TSR_Sup2_SignName_16 TSR_Sup1_Confidence_16 TSR_Sup1_SignName_16 TSR_Filter_Type_16 TSR_Relevancy_16 TSR_Sign_Name_16 TSR_Camera_Source_16 TSR_ID_16 ICM_Traffic_Signs16_Header;
SIG_GROUP_ 127 ICM_Traffic_Signs15 1 : TSR_Buffer_15 TSR_Sign_Panel_Width_STD_15 TSR_Sign_Panel_Height_15 TSR_Sign_Panel_Width_15 TSR_Sign_Height_STD_15 TSR_Sign_Panel_Height_STD_15 TSR_Sign_Height_15 TSR_Sign_Lat_Distance_STD_15 TSR_Sign_Lateral_Distance_15 TSR_Sign_Long_Distance_STD_15 TSR_Sign_Long_Distance_15 TSR_Tracking_Age_15 TSR_Sign_Structure_15 TSR_Sign_Shape_15 TSR_Confidence_15 TSR_Sup2_Confidence_15 TSR_Sup2_SignName_15 TSR_Sup1_Confidence_15 TSR_Sup1_SignName_15 TSR_Filter_Type_15 TSR_Relevancy_15 TSR_Sign_Name_15 TSR_Camera_Source_15 TSR_ID_15 ICM_Traffic_Signs15_Header;
SIG_GROUP_ 126 ICM_Traffic_Signs14 1 : TSR_Buffer_14 TSR_Sign_Panel_Width_STD_14 TSR_Sign_Panel_Height_14 TSR_Sign_Panel_Width_14 TSR_Sign_Height_STD_14 TSR_Sign_Panel_Height_STD_14 TSR_Sign_Height_14 TSR_Sign_Lat_Distance_STD_14 TSR_Sign_Lateral_Distance_14 TSR_Sign_Long_Distance_STD_14 TSR_Sign_Long_Distance_14 TSR_Tracking_Age_14 TSR_Sign_Structure_14 TSR_Sign_Shape_14 TSR_Confidence_14 TSR_Sup2_Confidence_14 TSR_Sup2_SignName_14 TSR_Sup1_Confidence_14 TSR_Sup1_SignName_14 TSR_Filter_Type_14 TSR_Relevancy_14 TSR_Sign_Name_14 TSR_Camera_Source_14 TSR_ID_14 ICM_Traffic_Signs14_Header;
SIG_GROUP_ 125 ICM_Traffic_Signs13 1 : TSR_Buffer_13 TSR_Sign_Panel_Width_STD_13 TSR_Sign_Panel_Height_13 TSR_Sign_Panel_Width_13 TSR_Sign_Height_STD_13 TSR_Sign_Panel_Height_STD_13 TSR_Sign_Height_13 TSR_Sign_Lat_Distance_STD_13 TSR_Sign_Lateral_Distance_13 TSR_Sign_Long_Distance_STD_13 TSR_Sign_Long_Distance_13 TSR_Tracking_Age_13 TSR_Sign_Structure_13 TSR_Sign_Shape_13 TSR_Confidence_13 TSR_Sup2_Confidence_13 TSR_Sup2_SignName_13 TSR_Sup1_Confidence_13 TSR_Sup1_SignName_13 TSR_Filter_Type_13 TSR_Relevancy_13 TSR_Sign_Name_13 TSR_Camera_Source_13 TSR_ID_13 ICM_Traffic_Signs13_Header;
SIG_GROUP_ 124 ICM_Traffic_Signs12 1 : TSR_Buffer_12 TSR_Sign_Panel_Width_STD_12 TSR_Sign_Panel_Height_12 TSR_Sign_Panel_Width_12 TSR_Sign_Height_STD_12 TSR_Sign_Panel_Height_STD_12 TSR_Sign_Height_12 TSR_Sign_Lat_Distance_STD_12 TSR_Sign_Lateral_Distance_12 TSR_Sign_Long_Distance_STD_12 TSR_Sign_Long_Distance_12 TSR_Tracking_Age_12 TSR_Sign_Structure_12 TSR_Sign_Shape_12 TSR_Confidence_12 TSR_Sup2_Confidence_12 TSR_Sup2_SignName_12 TSR_Sup1_Confidence_12 TSR_Sup1_SignName_12 TSR_Filter_Type_12 TSR_Relevancy_12 TSR_Sign_Name_12 TSR_Camera_Source_12 TSR_ID_12 ICM_Traffic_Signs12_Header;
SIG_GROUP_ 123 ICM_Traffic_Signs11 1 : TSR_Buffer_11 TSR_Sign_Panel_Width_STD_11 TSR_Sign_Panel_Height_11 TSR_Sign_Panel_Width_11 TSR_Sign_Height_STD_11 TSR_Sign_Panel_Height_STD_11 TSR_Sign_Height_11 TSR_Sign_Lat_Distance_STD_11 TSR_Sign_Lateral_Distance_11 TSR_Sign_Long_Distance_STD_11 TSR_Sign_Long_Distance_11 TSR_Tracking_Age_11 TSR_Sign_Structure_11 TSR_Sign_Shape_11 TSR_Confidence_11 TSR_Sup2_Confidence_11 TSR_Sup2_SignName_11 TSR_Sup1_Confidence_11 TSR_Sup1_SignName_11 TSR_Filter_Type_11 TSR_Relevancy_11 TSR_Sign_Name_11 TSR_Camera_Source_11 TSR_ID_11 ICM_Traffic_Signs11_Header;
SIG_GROUP_ 122 ICM_Traffic_Signs10 1 : TSR_Buffer_10 TSR_Sign_Panel_Width_STD_10 TSR_Sign_Panel_Height_10 TSR_Sign_Panel_Width_10 TSR_Sign_Height_STD_10 TSR_Sign_Panel_Height_STD_10 TSR_Sign_Height_10 TSR_Sign_Lat_Distance_STD_10 TSR_Sign_Lateral_Distance_10 TSR_Sign_Long_Distance_STD_10 TSR_Sign_Long_Distance_10 TSR_Tracking_Age_10 TSR_Sign_Structure_10 TSR_Sign_Shape_10 TSR_Confidence_10 TSR_Sup2_Confidence_10 TSR_Sup2_SignName_10 TSR_Sup1_Confidence_10 TSR_Sup1_SignName_10 TSR_Filter_Type_10 TSR_Relevancy_10 TSR_Sign_Name_10 TSR_Camera_Source_10 TSR_ID_10 ICM_Traffic_Signs10_Header;
SIG_GROUP_ 121 ICM_Traffic_Signs9 1 : TSR_Buffer_9 TSR_Sign_Panel_Width_STD_9 TSR_Sign_Panel_Height_9 TSR_Sign_Panel_Width_9 TSR_Sign_Height_STD_9 TSR_Sign_Panel_Height_STD_9 TSR_Sign_Height_9 TSR_Sign_Lat_Distance_STD_9 TSR_Sign_Lateral_Distance_9 TSR_Sign_Long_Distance_STD_9 TSR_Sign_Long_Distance_9 TSR_Tracking_Age_9 TSR_Sign_Structure_9 TSR_Sign_Shape_9 TSR_Confidence_9 TSR_Sup2_Confidence_9 TSR_Sup2_SignName_9 TSR_Sup1_Confidence_9 TSR_Sup1_SignName_9 TSR_Filter_Type_9 TSR_Relevancy_9 TSR_Sign_Name_9 TSR_Camera_Source_9 TSR_ID_9 ICM_Traffic_Signs9_Header;
SIG_GROUP_ 120 ICM_Traffic_Signs8 1 : TSR_Buffer_8 TSR_Sign_Panel_Width_STD_8 TSR_Sign_Panel_Height_8 TSR_Sign_Panel_Width_8 TSR_Sign_Height_STD_8 TSR_Sign_Panel_Height_STD_8 TSR_Sign_Height_8 TSR_Sign_Lat_Distance_STD_8 TSR_Sign_Lateral_Distance_8 TSR_Sign_Long_Distance_STD_8 TSR_Sign_Long_Distance_8 TSR_Tracking_Age_8 TSR_Sign_Structure_8 TSR_Sign_Shape_8 TSR_Confidence_8 TSR_Sup2_Confidence_8 TSR_Sup2_SignName_8 TSR_Sup1_Confidence_8 TSR_Sup1_SignName_8 TSR_Filter_Type_8 TSR_Relevancy_8 TSR_Sign_Name_8 TSR_Camera_Source_8 TSR_ID_8 ICM_Traffic_Signs8_Header;
SIG_GROUP_ 119 ICM_Traffic_Signs7 1 : TSR_Buffer_7 TSR_Sign_Panel_Width_STD_7 TSR_Sign_Panel_Height_7 TSR_Sign_Panel_Width_7 TSR_Sign_Height_STD_7 TSR_Sign_Panel_Height_STD_7 TSR_Sign_Height_7 TSR_Sign_Lat_Distance_STD_7 TSR_Sign_Lateral_Distance_7 TSR_Sign_Long_Distance_STD_7 TSR_Sign_Long_Distance_7 TSR_Tracking_Age_7 TSR_Sign_Structure_7 TSR_Sign_Shape_7 TSR_Confidence_7 TSR_Sup2_Confidence_7 TSR_Sup2_SignName_7 TSR_Sup1_Confidence_7 TSR_Sup1_SignName_7 TSR_Filter_Type_7 TSR_Relevancy_7 TSR_Sign_Name_7 TSR_Camera_Source_7 TSR_ID_7 ICM_Traffic_Signs7_Header;
SIG_GROUP_ 118 ICM_Traffic_Signs6 1 : TSR_Buffer_6 TSR_Sign_Panel_Width_STD_6 TSR_Sign_Panel_Height_6 TSR_Sign_Panel_Width_6 TSR_Sign_Height_STD_6 TSR_Sign_Panel_Height_STD_6 TSR_Sign_Height_6 TSR_Sign_Lat_Distance_STD_6 TSR_Sign_Lateral_Distance_6 TSR_Sign_Long_Distance_STD_6 TSR_Sign_Long_Distance_6 TSR_Tracking_Age_6 TSR_Sign_Structure_6 TSR_Sign_Shape_6 TSR_Confidence_6 TSR_Sup2_Confidence_6 TSR_Sup2_SignName_6 TSR_Sup1_Confidence_6 TSR_Sup1_SignName_6 TSR_Filter_Type_6 TSR_Relevancy_6 TSR_Sign_Name_6 TSR_Camera_Source_6 TSR_ID_6 ICM_Traffic_Signs6_Header;
SIG_GROUP_ 117 ICM_Traffic_Signs5 1 : TSR_Buffer_5 TSR_Sign_Panel_Width_STD_5 TSR_Sign_Panel_Height_5 TSR_Sign_Panel_Width_5 TSR_Sign_Height_STD_5 TSR_Sign_Panel_Height_STD_5 TSR_Sign_Height_5 TSR_Sign_Lat_Distance_STD_5 TSR_Sign_Lateral_Distance_5 TSR_Sign_Long_Distance_STD_5 TSR_Sign_Long_Distance_5 TSR_Tracking_Age_5 TSR_Sign_Structure_5 TSR_Sign_Shape_5 TSR_Confidence_5 TSR_Sup2_Confidence_5 TSR_Sup2_SignName_5 TSR_Sup1_Confidence_5 TSR_Sup1_SignName_5 TSR_Filter_Type_5 TSR_Relevancy_5 TSR_Sign_Name_5 TSR_Camera_Source_5 TSR_ID_5 ICM_Traffic_Signs5_Header;
SIG_GROUP_ 116 ICM_Traffic_Signs4 1 : TSR_Buffer_4 TSR_Sign_Panel_Width_STD_4 TSR_Sign_Panel_Height_4 TSR_Sign_Panel_Width_4 TSR_Sign_Height_STD_4 TSR_Sign_Panel_Height_STD_4 TSR_Sign_Height_4 TSR_Sign_Lat_Distance_STD_4 TSR_Sign_Lateral_Distance_4 TSR_Sign_Long_Distance_STD_4 TSR_Sign_Long_Distance_4 TSR_Tracking_Age_4 TSR_Sign_Structure_4 TSR_Sign_Shape_4 TSR_Confidence_4 TSR_Sup2_Confidence_4 TSR_Sup2_SignName_4 TSR_Sup1_Confidence_4 TSR_Sup1_SignName_4 TSR_Filter_Type_4 TSR_Relevancy_4 TSR_Sign_Name_4 TSR_Camera_Source_4 TSR_ID_4 ICM_Traffic_Signs4_Header;
SIG_GROUP_ 115 ICM_Traffic_Signs3 1 : TSR_Buffer_3 TSR_Sign_Panel_Width_STD_3 TSR_Sign_Panel_Height_3 TSR_Sign_Panel_Width_3 TSR_Sign_Height_STD_3 TSR_Sign_Panel_Height_STD_3 TSR_Sign_Height_3 TSR_Sign_Lat_Distance_STD_3 TSR_Sign_Lateral_Distance_3 TSR_Sign_Long_Distance_STD_3 TSR_Sign_Long_Distance_3 TSR_Tracking_Age_3 TSR_Sign_Structure_3 TSR_Sign_Shape_3 TSR_Confidence_3 TSR_Sup2_Confidence_3 TSR_Sup2_SignName_3 TSR_Sup1_Confidence_3 TSR_Sup1_SignName_3 TSR_Filter_Type_3 TSR_Relevancy_3 TSR_Sign_Name_3 TSR_Camera_Source_3 TSR_ID_3 ICM_Traffic_Signs3_Header;
SIG_GROUP_ 114 ICM_Traffic_Signs2 1 : TSR_Buffer_2 TSR_Sign_Panel_Width_STD_2 TSR_Sign_Panel_Height_2 TSR_Sign_Panel_Width_2 TSR_Sign_Height_STD_2 TSR_Sign_Panel_Height_STD_2 TSR_Sign_Height_2 TSR_Sign_Lat_Distance_STD_2 TSR_Sign_Lateral_Distance_2 TSR_Sign_Long_Distance_STD_2 TSR_Sign_Long_Distance_2 TSR_Tracking_Age_2 TSR_Sign_Structure_2 TSR_Sign_Shape_2 TSR_Confidence_2 TSR_Sup2_Confidence_2 TSR_Sup2_SignName_2 TSR_Sup1_Confidence_2 TSR_Sup1_SignName_2 TSR_Filter_Type_2 TSR_Relevancy_2 TSR_Sign_Name_2 TSR_Camera_Source_2 TSR_ID_2 ICM_Traffic_Signs2_Header;
SIG_GROUP_ 113 ICM_Traffic_Signs1 1 : TSR_Buffer_1 TSR_Sign_Panel_Width_STD_1 TSR_Sign_Panel_Height_1 TSR_Sign_Panel_Width_1 TSR_Sign_Height_STD_1 TSR_Sign_Panel_Height_STD_1 TSR_Sign_Height_1 TSR_Sign_Lat_Distance_STD_1 TSR_Sign_Lateral_Distance_1 TSR_Sign_Long_Distance_STD_1 TSR_Sign_Long_Distance_1 TSR_Tracking_Age_1 TSR_Sign_Structure_1 TSR_Sign_Shape_1 TSR_Confidence_1 TSR_Sup2_Confidence_1 TSR_Sup2_SignName_1 TSR_Sup1_Confidence_1 TSR_Sup1_SignName_1 TSR_Filter_Type_1 TSR_Relevancy_1 TSR_Sign_Name_1 TSR_Camera_Source_1 TSR_ID_1 ICM_Traffic_Signs1_Header;
SIG_GROUP_ 112 ICM_Traffic_Signs_Head_Header 1 : TSR_Header_Buffer TSR_UnderTracking_Sign_Count TSR_Filtered_Sign_Count TSR_Approved_Sign_Count TSR_Sync_ID TSR_Protocol_Version ICM_Traffic_Signs_Header_Header TSR_Zero_byte TSR_Buffer_0 TSR_Sign_Panel_Width_STD_0 TSR_Sign_Panel_Height_0 TSR_Sign_Panel_Width_0 TSR_Sign_Height_STD_0 TSR_Sign_Panel_Height_STD_0 TSR_Sign_Height_0 TSR_Sign_Lat_Distance_STD_0 TSR_Sign_Lateral_Distance_0 TSR_Sign_Long_Distance_STD_0 TSR_Sign_Long_Distance_0 TSR_Tracking_Age_0 TSR_Sign_Structure_0 TSR_Sign_Shape_0 TSR_Confidence_0 TSR_Sup2_Confidence_0 TSR_Sup2_SignName_0 TSR_Sup1_Confidence_0 TSR_Sup1_SignName_0 TSR_Filter_Type_0 TSR_Relevancy_0 TSR_Sign_Name_0 TSR_Camera_Source_0 TSR_ID_0;
SIG_GROUP_ 224 ICM_Object_Prot39_B 1 : ICM_Object_Prot39_B_CRC OBJ_Buffer_39 OBJ_Is_VeryClose_V_39 OBJ_Is_VeryClose_39 OBJ_Is_In_Drivable_Area_V_39 OBJ_Is_In_Drivable_Area_39 OBJ_Visibility_Side_39 OBJ_Visibility_Side_V_39 OBJ_Angle_Bottom_STD_V_39 OBJ_Angle_Bottom_STD_39 OBJ_Angle_Bottom_39 OBJ_Angle_Bottom_V_39 OBJ_Angle_Mid_STD_V_39 OBJ_Angle_Mid_STD_39 OBJ_Angle_Mid_39 OBJ_Angle_Mid_V_39 OBJ_Angle_Side_STD_V_39 OBJ_Angle_Side_STD_39 OBJ_Angle_Side_V_39 OBJ_Angle_Side_39 OBJ_Angle_Left_STD_V_39 OBJ_Angle_Left_STD_39 OBJ_Angle_Left_V_39 OBJ_Angle_Left_39 OBJ_Angle_Right_STD_V_39 OBJ_Angle_Right_STD_39 OBJ_Angle_Right_V_39 OBJ_Angle_Right_39 OBJ_Angle_Rate_V_39 OBJ_Angle_Rate_39 OBJ_Angle_Rate_STD_V_39 OBJ_Angle_Rate_STD_39 OBJ_Heading_STD_V_39 OBJ_Heading_STD_39 OBJ_Heading_V_39 OBJ_Heading_39 OBJ_Absolute_Speed_STD_V_39 OBJ_Absolute_Speed_STD_39 OBJ_Absolute_Speed_V_39 OBJ_Absolute_Speed_39 OBJ_Lat_Distance_STD_V_39 OBJ_Lat_Distance_STD_39 OBJ_Lat_Distance_V_39 OBJ_Lat_Distance_39 OBJ_Long_Distance_STD_V_39 OBJ_Long_Distance_STD_39 OBJ_Long_Distance_V_39 OBJ_Long_Distance_39 OBJ_Rel_Lat_Vel_STD_V_39 OBJ_Relative_Lat_Velocity_STD_39 OBJ_Relative_Lat_Velocity_V_39 OBJ_Relative_Lat_Velocity_39 OBJ_Rel_Long_Vel_STD_V_39 OBJ_Relative_Long_Vel_STD_39 OBJ_Relative_Long_Velocity_V_39 OBJ_Relative_Long_Velocity_39 ICM_Object_Prot39_B_Header;
SIG_GROUP_ 223 ICM_Object_Prot39_A 1 : OBJ_Rel_Long_Acc_STD_V_39 OBJ_Relative_Long_Acc_STD_39 OBJ_Relative_Long_Acc_V_39 OBJ_Relative_Long_Acc_39 OBJ_Inv_TTC_STD_V_39 OBJ_Inv_TTC_STD_39 OBJ_Inv_TTC_V_39 OBJ_Inv_TTC_39 OBJ_Abs_Acc_STD_V_39 OBJ_Abs_Acc_STD_39 OBJ_Abs_Acceleration_V_39 OBJ_Abs_Acceleration_39 OBJ_Abs_Lat_Acc_STD_V_39 OBJ_Abs_Lat_Acc_STD_39 OBJ_Abs_Lat_Acc_V_39 OBJ_Abs_Lat_Acc_39 OBJ_Abs_Long_Acc_STD_V_39 OBJ_Abs_Long_Acc_STD_39 OBJ_Abs_Long_Acc_V_39 OBJ_Abs_Long_Acc_39 OBJ_Abs_Lat_Vel_STD_V_39 OBJ_Abs_Lat_Velocity_STD_39 OBJ_Abs_Lat_Velocity_V_39 OBJ_Abs_Lat_Velocity_39 OBJ_Abs_Long_Vel_STD_V_39 OBJ_Abs_Long_Velocity_STD_39 OBJ_Abs_Long_Velocity_V_39 OBJ_Abs_Long_Velocity_39 OBJ_Height_STD_V_39 OBJ_Height_STD_39 OBJ_Height_V_39 OBJ_Height_39 OBJ_Length_STD_V_39 OBJ_Length_STD_39 OBJ_Length_V_39 OBJ_Length_39 OBJ_Width_STD_V_39 OBJ_Width_STD_39 OBJ_Width_V_39 OBJ_Width_39 OBJ_Age_Seconds_V_39 OBJ_Age_Seconds_39 OBJ_Lane_Assignment_V_39 OBJ_Lane_Assignment_39 OBJ_Bottom_Out_Of_Image_V_39 OBJ_Top_Out_Of_Image_V_39 OBJ_Bottom_Out_Of_Image_39 OBJ_Top_Out_Of_Image_39 OBJ_Left_Out_Of_Image_V_39 OBJ_Right_Out_Of_Image_V_39 OBJ_Left_Out_Of_Image_39 OBJ_Right_Out_Of_Image_39 OBJ_Light_Indicator_Validity_39 OBJ_Turn_Indicator_Left_39 OBJ_Turn_Indicator_Right_39 OBJ_Brake_Light_39 OBJ_Has_Cut_Path_39 OBJ_Has_Cut_Lane_39 OBJ_Motion_Orientation_39 OBJ_Motion_Status_39 OBJ_Camera_Source_39 OBJ_Bike_Probability_39 OBJ_Truck_Probability_39 OBJ_Car_Probability_39 OBJ_Class_Probability_39 OBJ_Object_Class_39 OBJ_Measuring_Status_39 OBJ_Object_Age_39 OBJ_Moving_IN_Probability_39 OBJ_Motion_Category_39 OBJ_Triggered_SDM_39 OBJ_Fusion_Source_39 OBJ_Existence_Probability_39 OBJ_ID_39 OBJ_CRC_39 ICM_Object_Prot39_A_Header;
SIG_GROUP_ 222 ICM_Object_Prot38_B 1 : OBJ_Buffer_38 OBJ_Is_VeryClose_V_38 OBJ_Is_VeryClose_38 OBJ_Is_In_Drivable_Area_V_38 OBJ_Is_In_Drivable_Area_38 OBJ_Visibility_Side_38 OBJ_Visibility_Side_V_38 OBJ_Angle_Bottom_STD_V_38 OBJ_Angle_Bottom_STD_38 OBJ_Angle_Bottom_38 OBJ_Angle_Bottom_V_38 OBJ_Angle_Mid_STD_V_38 OBJ_Angle_Mid_STD_38 OBJ_Angle_Mid_38 OBJ_Angle_Mid_V_38 OBJ_Angle_Side_STD_V_38 OBJ_Angle_Side_STD_38 OBJ_Angle_Side_V_38 OBJ_Angle_Side_38 OBJ_Angle_Left_STD_V_38 OBJ_Angle_Left_STD_38 OBJ_Angle_Left_V_38 OBJ_Angle_Left_38 OBJ_Angle_Right_STD_V_38 OBJ_Angle_Right_STD_38 OBJ_Angle_Right_V_38 OBJ_Angle_Right_38 OBJ_Angle_Rate_V_38 OBJ_Angle_Rate_38 OBJ_Angle_Rate_STD_V_38 OBJ_Angle_Rate_STD_38 OBJ_Heading_STD_V_38 OBJ_Heading_STD_38 OBJ_Heading_V_38 OBJ_Heading_38 OBJ_Absolute_Speed_STD_V_38 OBJ_Absolute_Speed_STD_38 OBJ_Absolute_Speed_V_38 OBJ_Absolute_Speed_38 OBJ_Lat_Distance_STD_V_38 OBJ_Lat_Distance_STD_38 OBJ_Lat_Distance_V_38 OBJ_Lat_Distance_38 OBJ_Long_Distance_STD_V_38 OBJ_Long_Distance_STD_38 OBJ_Long_Distance_V_38 OBJ_Long_Distance_38 OBJ_Rel_Lat_Vel_STD_V_38 OBJ_Relative_Lat_Velocity_STD_38 OBJ_Relative_Lat_Velocity_V_38 OBJ_Relative_Lat_Velocity_38 OBJ_Rel_Long_Vel_STD_V_38 OBJ_Relative_Long_Vel_STD_38 OBJ_Relative_Long_Velocity_V_38 OBJ_Relative_Long_Velocity_38 ICM_Object_Prot38_B_Header;
SIG_GROUP_ 221 ICM_Object_Prot38_A 1 : OBJ_Rel_Long_Acc_STD_V_38 OBJ_Relative_Long_Acc_STD_38 OBJ_Relative_Long_Acc_V_38 OBJ_Relative_Long_Acc_38 OBJ_Inv_TTC_STD_V_38 OBJ_Inv_TTC_STD_38 OBJ_Inv_TTC_V_38 OBJ_Inv_TTC_38 OBJ_Abs_Acc_STD_V_38 OBJ_Abs_Acc_STD_38 OBJ_Abs_Acceleration_V_38 OBJ_Abs_Acceleration_38 OBJ_Abs_Lat_Acc_STD_V_38 OBJ_Abs_Lat_Acc_STD_38 OBJ_Abs_Lat_Acc_V_38 OBJ_Abs_Lat_Acc_38 OBJ_Abs_Long_Acc_STD_V_38 OBJ_Abs_Long_Acc_STD_38 OBJ_Abs_Long_Acc_V_38 OBJ_Abs_Long_Acc_38 OBJ_Abs_Lat_Vel_STD_V_38 OBJ_Abs_Lat_Velocity_STD_38 OBJ_Abs_Lat_Velocity_V_38 OBJ_Abs_Lat_Velocity_38 OBJ_Abs_Long_Vel_STD_V_38 OBJ_Abs_Long_Velocity_STD_38 OBJ_Abs_Long_Velocity_V_38 OBJ_Abs_Long_Velocity_38 OBJ_Height_STD_V_38 OBJ_Height_STD_38 OBJ_Height_V_38 OBJ_Height_38 OBJ_Length_STD_V_38 OBJ_Length_STD_38 OBJ_Length_V_38 OBJ_Length_38 OBJ_Width_STD_V_38 OBJ_Width_STD_38 OBJ_Width_V_38 OBJ_Width_38 OBJ_Age_Seconds_V_38 OBJ_Age_Seconds_38 OBJ_Lane_Assignment_V_38 OBJ_Lane_Assignment_38 OBJ_Bottom_Out_Of_Image_V_38 OBJ_Top_Out_Of_Image_V_38 OBJ_Bottom_Out_Of_Image_38 OBJ_Top_Out_Of_Image_38 OBJ_Left_Out_Of_Image_V_38 OBJ_Right_Out_Of_Image_V_38 OBJ_Left_Out_Of_Image_38 OBJ_Right_Out_Of_Image_38 OBJ_Light_Indicator_Validity_38 OBJ_Turn_Indicator_Left_38 OBJ_Turn_Indicator_Right_38 OBJ_Brake_Light_38 OBJ_Has_Cut_Path_38 OBJ_Has_Cut_Lane_38 OBJ_Motion_Orientation_38 OBJ_Motion_Status_38 OBJ_Camera_Source_38 OBJ_Bike_Probability_38 OBJ_Truck_Probability_38 OBJ_Car_Probability_38 OBJ_Class_Probability_38 OBJ_Object_Class_38 OBJ_Measuring_Status_38 OBJ_Object_Age_38 OBJ_Moving_IN_Probability_38 OBJ_Motion_Category_38 OBJ_Triggered_SDM_38 OBJ_Fusion_Source_38 OBJ_Existence_Probability_38 OBJ_ID_38 OBJ_CRC_38 ICM_Object_Prot38_A_Header;
SIG_GROUP_ 220 ICM_Object_Prot37_B 1 : OBJ_Buffer_37 OBJ_Is_VeryClose_V_37 OBJ_Is_VeryClose_37 OBJ_Is_In_Drivable_Area_V_37 OBJ_Is_In_Drivable_Area_37 OBJ_Visibility_Side_37 OBJ_Visibility_Side_V_37 OBJ_Angle_Bottom_STD_V_37 OBJ_Angle_Bottom_STD_37 OBJ_Angle_Bottom_37 OBJ_Angle_Bottom_V_37 OBJ_Angle_Mid_STD_V_37 OBJ_Angle_Mid_STD_37 OBJ_Angle_Mid_37 OBJ_Angle_Mid_V_37 OBJ_Angle_Side_STD_V_37 OBJ_Angle_Side_STD_37 OBJ_Angle_Side_V_37 OBJ_Angle_Side_37 OBJ_Angle_Left_STD_V_37 OBJ_Angle_Left_STD_37 OBJ_Angle_Left_V_37 OBJ_Angle_Left_37 OBJ_Angle_Right_STD_V_37 OBJ_Angle_Right_STD_37 OBJ_Angle_Right_V_37 OBJ_Angle_Right_37 OBJ_Angle_Rate_V_37 OBJ_Angle_Rate_37 OBJ_Angle_Rate_STD_V_37 OBJ_Angle_Rate_STD_37 OBJ_Heading_STD_V_37 OBJ_Heading_STD_37 OBJ_Heading_V_37 OBJ_Heading_37 OBJ_Absolute_Speed_STD_V_37 OBJ_Absolute_Speed_STD_37 OBJ_Absolute_Speed_V_37 OBJ_Absolute_Speed_37 OBJ_Lat_Distance_STD_V_37 OBJ_Lat_Distance_STD_37 OBJ_Lat_Distance_V_37 OBJ_Lat_Distance_37 OBJ_Long_Distance_STD_V_37 OBJ_Long_Distance_STD_37 OBJ_Long_Distance_V_37 OBJ_Long_Distance_37 OBJ_Rel_Lat_Vel_STD_V_37 OBJ_Relative_Lat_Velocity_STD_37 OBJ_Relative_Lat_Velocity_V_37 OBJ_Relative_Lat_Velocity_37 OBJ_Rel_Long_Vel_STD_V_37 OBJ_Relative_Long_Vel_STD_37 OBJ_Relative_Long_Velocity_V_37 OBJ_Relative_Long_Velocity_37 ICM_Object_Prot37_B_Header;
SIG_GROUP_ 219 ICM_Object_Prot37_A 1 : OBJ_Rel_Long_Acc_STD_V_37 OBJ_Relative_Long_Acc_STD_37 OBJ_Relative_Long_Acc_V_37 OBJ_Relative_Long_Acc_37 OBJ_Inv_TTC_STD_V_37 OBJ_Inv_TTC_STD_37 OBJ_Inv_TTC_V_37 OBJ_Inv_TTC_37 OBJ_Abs_Acc_STD_V_37 OBJ_Abs_Acc_STD_37 OBJ_Abs_Acceleration_V_37 OBJ_Abs_Acceleration_37 OBJ_Abs_Lat_Acc_STD_V_37 OBJ_Abs_Lat_Acc_STD_37 OBJ_Abs_Lat_Acc_V_37 OBJ_Abs_Lat_Acc_37 OBJ_Abs_Long_Acc_STD_V_37 OBJ_Abs_Long_Acc_STD_37 OBJ_Abs_Long_Acc_V_37 OBJ_Abs_Long_Acc_37 OBJ_Abs_Lat_Vel_STD_V_37 OBJ_Abs_Lat_Velocity_STD_37 OBJ_Abs_Lat_Velocity_V_37 OBJ_Abs_Lat_Velocity_37 OBJ_Abs_Long_Vel_STD_V_37 OBJ_Abs_Long_Velocity_STD_37 OBJ_Abs_Long_Velocity_V_37 OBJ_Abs_Long_Velocity_37 OBJ_Height_STD_V_37 OBJ_Height_STD_37 OBJ_Height_V_37 OBJ_Height_37 OBJ_Length_STD_V_37 OBJ_Length_STD_37 OBJ_Length_V_37 OBJ_Length_37 OBJ_Width_STD_V_37 OBJ_Width_STD_37 OBJ_Width_V_37 OBJ_Width_37 OBJ_Age_Seconds_V_37 OBJ_Age_Seconds_37 OBJ_Lane_Assignment_V_37 OBJ_Lane_Assignment_37 OBJ_Bottom_Out_Of_Image_V_37 OBJ_Top_Out_Of_Image_V_37 OBJ_Bottom_Out_Of_Image_37 OBJ_Top_Out_Of_Image_37 OBJ_Left_Out_Of_Image_V_37 OBJ_Right_Out_Of_Image_V_37 OBJ_Left_Out_Of_Image_37 OBJ_Right_Out_Of_Image_37 OBJ_Light_Indicator_Validity_37 OBJ_Turn_Indicator_Left_37 OBJ_Turn_Indicator_Right_37 OBJ_Brake_Light_37 OBJ_Has_Cut_Path_37 OBJ_Has_Cut_Lane_37 OBJ_Motion_Orientation_37 OBJ_Motion_Status_37 OBJ_Camera_Source_37 OBJ_Bike_Probability_37 OBJ_Truck_Probability_37 OBJ_Car_Probability_37 OBJ_Class_Probability_37 OBJ_Object_Class_37 OBJ_Measuring_Status_37 OBJ_Object_Age_37 OBJ_Moving_IN_Probability_37 OBJ_Motion_Category_37 OBJ_Triggered_SDM_37 OBJ_Fusion_Source_37 OBJ_Existence_Probability_37 OBJ_ID_37 OBJ_CRC_37 ICM_Object_Prot37_A_Header;
SIG_GROUP_ 218 ICM_Object_Prot36_B 1 : OBJ_Buffer_36 OBJ_Is_VeryClose_V_36 OBJ_Is_VeryClose_36 OBJ_Is_In_Drivable_Area_V_36 OBJ_Is_In_Drivable_Area_36 OBJ_Visibility_Side_36 OBJ_Visibility_Side_V_36 OBJ_Angle_Bottom_STD_V_36 OBJ_Angle_Bottom_STD_36 OBJ_Angle_Bottom_36 OBJ_Angle_Bottom_V_36 OBJ_Angle_Mid_STD_V_36 OBJ_Angle_Mid_STD_36 OBJ_Angle_Mid_36 OBJ_Angle_Mid_V_36 OBJ_Angle_Side_STD_V_36 OBJ_Angle_Side_STD_36 OBJ_Angle_Side_V_36 OBJ_Angle_Side_36 OBJ_Angle_Left_STD_V_36 OBJ_Angle_Left_STD_36 OBJ_Angle_Left_V_36 OBJ_Angle_Left_36 OBJ_Angle_Right_STD_V_36 OBJ_Angle_Right_STD_36 OBJ_Angle_Right_V_36 OBJ_Angle_Right_36 OBJ_Angle_Rate_V_36 OBJ_Angle_Rate_36 OBJ_Angle_Rate_STD_V_36 OBJ_Angle_Rate_STD_36 OBJ_Heading_STD_V_36 OBJ_Heading_STD_36 OBJ_Heading_V_36 OBJ_Heading_36 OBJ_Absolute_Speed_STD_V_36 OBJ_Absolute_Speed_STD_36 OBJ_Absolute_Speed_V_36 OBJ_Absolute_Speed_36 OBJ_Lat_Distance_STD_V_36 OBJ_Lat_Distance_STD_36 OBJ_Lat_Distance_V_36 OBJ_Lat_Distance_36 OBJ_Long_Distance_STD_V_36 OBJ_Long_Distance_STD_36 OBJ_Long_Distance_V_36 OBJ_Long_Distance_36 OBJ_Rel_Lat_Vel_STD_V_36 OBJ_Relative_Lat_Velocity_STD_36 OBJ_Relative_Lat_Velocity_V_36 OBJ_Relative_Lat_Velocity_36 OBJ_Rel_Long_Vel_STD_V_36 OBJ_Relative_Long_Vel_STD_36 OBJ_Relative_Long_Velocity_V_36 OBJ_Relative_Long_Velocity_36 ICM_Object_Prot36_B_Header;
SIG_GROUP_ 217 ICM_Object_Prot36_A 1 : OBJ_Rel_Long_Acc_STD_V_36 OBJ_Relative_Long_Acc_STD_36 OBJ_Relative_Long_Acc_V_36 OBJ_Relative_Long_Acc_36 OBJ_Inv_TTC_STD_V_36 OBJ_Inv_TTC_STD_36 OBJ_Inv_TTC_V_36 OBJ_Inv_TTC_36 OBJ_Abs_Acc_STD_V_36 OBJ_Abs_Acc_STD_36 OBJ_Abs_Acceleration_V_36 OBJ_Abs_Acceleration_36 OBJ_Abs_Lat_Acc_STD_V_36 OBJ_Abs_Lat_Acc_STD_36 OBJ_Abs_Lat_Acc_V_36 OBJ_Abs_Lat_Acc_36 OBJ_Abs_Long_Acc_STD_V_36 OBJ_Abs_Long_Acc_STD_36 OBJ_Abs_Long_Acc_V_36 OBJ_Abs_Long_Acc_36 OBJ_Abs_Lat_Vel_STD_V_36 OBJ_Abs_Lat_Velocity_STD_36 OBJ_Abs_Lat_Velocity_V_36 OBJ_Abs_Lat_Velocity_36 OBJ_Abs_Long_Vel_STD_V_36 OBJ_Abs_Long_Velocity_STD_36 OBJ_Abs_Long_Velocity_V_36 OBJ_Abs_Long_Velocity_36 OBJ_Height_STD_V_36 OBJ_Height_STD_36 OBJ_Height_V_36 OBJ_Height_36 OBJ_Length_STD_V_36 OBJ_Length_STD_36 OBJ_Length_V_36 OBJ_Length_36 OBJ_Width_STD_V_36 OBJ_Width_STD_36 OBJ_Width_V_36 OBJ_Width_36 OBJ_Age_Seconds_V_36 OBJ_Age_Seconds_36 OBJ_Lane_Assignment_V_36 OBJ_Lane_Assignment_36 OBJ_Bottom_Out_Of_Image_V_36 OBJ_Top_Out_Of_Image_V_36 OBJ_Bottom_Out_Of_Image_36 OBJ_Top_Out_Of_Image_36 OBJ_Left_Out_Of_Image_V_36 OBJ_Right_Out_Of_Image_V_36 OBJ_Left_Out_Of_Image_36 OBJ_Right_Out_Of_Image_36 OBJ_Light_Indicator_Validity_36 OBJ_Turn_Indicator_Left_36 OBJ_Turn_Indicator_Right_36 OBJ_Brake_Light_36 OBJ_Has_Cut_Path_36 OBJ_Has_Cut_Lane_36 OBJ_Motion_Orientation_36 OBJ_Motion_Status_36 OBJ_Camera_Source_36 OBJ_Bike_Probability_36 OBJ_Truck_Probability_36 OBJ_Car_Probability_36 OBJ_Class_Probability_36 OBJ_Object_Class_36 OBJ_Measuring_Status_36 OBJ_Object_Age_36 OBJ_Moving_IN_Probability_36 OBJ_Motion_Category_36 OBJ_Triggered_SDM_36 OBJ_Fusion_Source_36 OBJ_Existence_Probability_36 OBJ_ID_36 OBJ_CRC_36 ICM_Object_Prot36_A_Header;
